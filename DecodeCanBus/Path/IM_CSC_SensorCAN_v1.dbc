VERSION ""

NS_ :

BS_:

BU_: CSC01 CSC02 CSC03 CSC04 CSC05 CSC06 CSC07 CSC08 CSC09 CSC10 CSC11 CSC12 CSC13 CSC14 CSC15
VAL_TABLE_ Index_Balance 1 "BalanceState02" 0 "BalanceState01" ;
VAL_TABLE_ IndexFaults 3 "IC4_Faults" 2 "IC3_Faults" 1 "IC2_Faults" 0 "IC1_Faults" ;
VAL_TABLE_ IndexTemps 7 "IC4_Temps_PCB" 6 "IC4_Temps_1_6" 5 "IC3_Temps_PCB" 4 "IC3_Temps_1_6" 3 "IC2_Temps_PCB" 2 "IC2_Temps_1_6" 1 "IC1_Temps_PCB" 0 "IC1_Temps_1_6" ;
VAL_TABLE_ IndexCell 19 "Cell_55_56" 18 "Cell_52_54" 17 "Cell_49_51" 16 "Cell_46_48" 15 "Cell_43_45" 14 "Cell_41_42" 13 "Cell_38_40" 12 "Cell_35_37" 11 "Cell_32_34" 10 "Cell_29_31" 9 "Cell_27_28" 8 "Cell_24_26" 7 "Cell_21_23" 6 "Cell_18_20" 5 "Cell_15_17" 4 "Cell_13_14" 3 "Cell_10_12" 2 "Cell_7_9" 1 "Cell_4_6" 0 "Cell_1_3" ;
VAL_TABLE_ Assign 15 "CSC_15" 14 "CSC_14" 13 "CSC_13" 12 "CSC_12" 11 "CSC_11" 10 "CSC_10" 9 "CSC_09" 8 "CSC_08" 7 "CSC_07" 6 "CSC_06" 5 "CSC_05" 4 "CSC_04" 3 "CSC_03" 2 "CSC_02" 1 "CSC_01" ;
VAL_TABLE_ CSC_Reset 1 "INACTIVE" 0 "ACTIVE" ;

BO_ 2550202368 CSC01_CELL_VOLTS: 8 CSC01
 SG_ CSC01_Voltage_U56 m19 : 31|16@0+ (1,0) [0|6000] "mV" Vector__XXX
 SG_ CSC01_Voltage_U55 m19 : 15|16@0+ (1,0) [0|6000] "mV" Vector__XXX
 SG_ CSC01_Voltage_U54 m18 : 47|16@0+ (1,0) [0|6000] "mV" Vector__XXX
 SG_ CSC01_Voltage_U53 m18 : 31|16@0+ (1,0) [0|6000] "mV" Vector__XXX
 SG_ CSC01_Voltage_U52 m18 : 15|16@0+ (1,0) [0|6000] "mV" Vector__XXX
 SG_ CSC01_Voltage_U51 m17 : 47|16@0+ (1,0) [0|6000] "mV" Vector__XXX
 SG_ CSC01_Voltage_U50 m17 : 31|16@0+ (1,0) [0|6000] "mV" Vector__XXX
 SG_ CSC01_Voltage_U49 m17 : 15|16@0+ (1,0) [0|6000] "mV" Vector__XXX
 SG_ CSC01_Voltage_U48 m16 : 47|16@0+ (1,0) [0|6000] "mV" Vector__XXX
 SG_ CSC01_Voltage_U47 m16 : 31|16@0+ (1,0) [0|6000] "mV" Vector__XXX
 SG_ CSC01_Voltage_U46 m16 : 15|16@0+ (1,0) [0|6000] "mV" Vector__XXX
 SG_ CSC01_Voltage_U45 m15 : 47|16@0+ (1,0) [0|6000] "mV" Vector__XXX
 SG_ CSC01_Voltage_U44 m15 : 31|16@0+ (1,0) [0|6000] "mV" Vector__XXX
 SG_ CSC01_Voltage_U43 m15 : 15|16@0+ (1,0) [0|6000] "mV" Vector__XXX
 SG_ CSC01_Voltage_U42 m14 : 31|16@0+ (1,0) [0|6000] "mV" Vector__XXX
 SG_ CSC01_Voltage_U41 m14 : 15|16@0+ (1,0) [0|6000] "mV" Vector__XXX
 SG_ CSC01_Voltage_U40 m13 : 47|16@0+ (1,0) [0|6000] "mV" Vector__XXX
 SG_ CSC01_Voltage_U39 m13 : 31|16@0+ (1,0) [0|6000] "mV" Vector__XXX
 SG_ CSC01_Voltage_U38 m13 : 15|16@0+ (1,0) [0|6000] "mV" Vector__XXX
 SG_ CSC01_Voltage_U37 m12 : 47|16@0+ (1,0) [0|6000] "mV" Vector__XXX
 SG_ CSC01_Voltage_U36 m12 : 31|16@0+ (1,0) [0|6000] "mV" Vector__XXX
 SG_ CSC01_Voltage_U35 m12 : 15|16@0+ (1,0) [0|6000] "mV" Vector__XXX
 SG_ CSC01_Voltage_U34 m11 : 47|16@0+ (1,0) [0|6000] "mV" Vector__XXX
 SG_ CSC01_Voltage_U33 m11 : 31|16@0+ (1,0) [0|6000] "mV" Vector__XXX
 SG_ CSC01_Voltage_U32 m11 : 15|16@0+ (1,0) [0|6000] "mV" Vector__XXX
 SG_ CSC01_Voltage_U31 m10 : 47|16@0+ (1,0) [0|6000] "mV" Vector__XXX
 SG_ CSC01_Voltage_U30 m10 : 31|16@0+ (1,0) [0|6000] "mV" Vector__XXX
 SG_ CSC01_Voltage_U29 m10 : 15|16@0+ (1,0) [0|6000] "mV" Vector__XXX
 SG_ CSC01_Voltage_U28 m9 : 31|16@0+ (1,0) [0|6000] "mV" Vector__XXX
 SG_ CSC01_Voltage_U27 m9 : 15|16@0+ (1,0) [0|6000] "mV" Vector__XXX
 SG_ CSC01_Voltage_U26 m8 : 47|16@0+ (1,0) [0|6000] "mV" Vector__XXX
 SG_ CSC01_Voltage_U25 m8 : 31|16@0+ (1,0) [0|6000] "mV" Vector__XXX
 SG_ CSC01_Voltage_U24 m8 : 15|16@0+ (1,0) [0|6000] "mV" Vector__XXX
 SG_ CSC01_Voltage_U23 m7 : 47|16@0+ (1,0) [0|6000] "mV" Vector__XXX
 SG_ CSC01_Voltage_U22 m7 : 31|16@0+ (1,0) [0|6000] "mV" Vector__XXX
 SG_ CSC01_Voltage_U21 m7 : 15|16@0+ (1,0) [0|6000] "mV" Vector__XXX
 SG_ CSC01_Voltage_U20 m6 : 47|16@0+ (1,0) [0|6000] "mV" Vector__XXX
 SG_ CSC01_Voltage_U19 m6 : 31|16@0+ (1,0) [0|6000] "mV" Vector__XXX
 SG_ CSC01_Voltage_U18 m6 : 15|16@0+ (1,0) [0|6000] "mV" Vector__XXX
 SG_ CSC01_Voltage_U17 m5 : 47|16@0+ (1,0) [0|6000] "mV" Vector__XXX
 SG_ CSC01_Voltage_U16 m5 : 31|16@0+ (1,0) [0|6000] "mV" Vector__XXX
 SG_ CSC01_Voltage_U15 m5 : 15|16@0+ (1,0) [0|6000] "mV" Vector__XXX
 SG_ CSC01_Voltage_U14 m4 : 31|16@0+ (1,0) [0|6000] "mV" Vector__XXX
 SG_ CSC01_Voltage_U13 m4 : 15|16@0+ (1,0) [0|6000] "mV" Vector__XXX
 SG_ CSC01_Voltage_U12 m3 : 47|16@0+ (1,0) [0|6000] "mV" Vector__XXX
 SG_ CSC01_Voltage_U11 m3 : 31|16@0+ (1,0) [0|6000] "mV" Vector__XXX
 SG_ CSC01_Voltage_U10 m3 : 15|16@0+ (1,0) [0|6000] "mV" Vector__XXX
 SG_ CSC01_Voltage_U9 m2 : 47|16@0+ (1,0) [0|6000] "mV" Vector__XXX
 SG_ CSC01_Voltage_U8 m2 : 31|16@0+ (1,0) [0|6000] "mV" Vector__XXX
 SG_ CSC01_Voltage_U7 m2 : 15|16@0+ (1,0) [0|6000] "mV" Vector__XXX
 SG_ CSC01_Voltage_U6 m1 : 47|16@0+ (1,0) [0|6000] "mV" Vector__XXX
 SG_ CSC01_Voltage_U5 m1 : 31|16@0+ (1,0) [0|6000] "mV" Vector__XXX
 SG_ CSC01_Voltage_U4 m1 : 15|16@0+ (1,0) [0|6000] "mV" Vector__XXX
 SG_ CSC01_Voltage_U3 m0 : 47|16@0+ (1,0) [0|6000] "mV" Vector__XXX
 SG_ CSC01_Voltage_U2 m0 : 31|16@0+ (1,0) [0|6000] "mV" Vector__XXX
 SG_ CSC01_Voltage_U1 m0 : 15|16@0+ (1,0) [0|6000] "mV" Vector__XXX
 SG_ CSC01_IndexCell M : 7|8@0+ (1,0) [0|255] "" Vector__XXX

BO_ 2550267904 CSC02_CELL_VOLTS: 8 CSC02
 SG_ CSC02_Voltage_U56 m19 : 31|16@0+ (1,0) [0|6000] "mV" Vector__XXX
 SG_ CSC02_Voltage_U55 m19 : 15|16@0+ (1,0) [0|6000] "mV" Vector__XXX
 SG_ CSC02_Voltage_U54 m18 : 47|16@0+ (1,0) [0|6000] "mV" Vector__XXX
 SG_ CSC02_Voltage_U53 m18 : 31|16@0+ (1,0) [0|6000] "mV" Vector__XXX
 SG_ CSC02_Voltage_U52 m18 : 15|16@0+ (1,0) [0|6000] "mV" Vector__XXX
 SG_ CSC02_Voltage_U51 m17 : 47|16@0+ (1,0) [0|6000] "mV" Vector__XXX
 SG_ CSC02_Voltage_U50 m17 : 31|16@0+ (1,0) [0|6000] "mV" Vector__XXX
 SG_ CSC02_Voltage_U49 m17 : 15|16@0+ (1,0) [0|6000] "mV" Vector__XXX
 SG_ CSC02_Voltage_U48 m16 : 47|16@0+ (1,0) [0|6000] "mV" Vector__XXX
 SG_ CSC02_Voltage_U47 m16 : 31|16@0+ (1,0) [0|6000] "mV" Vector__XXX
 SG_ CSC02_Voltage_U46 m16 : 15|16@0+ (1,0) [0|6000] "mV" Vector__XXX
 SG_ CSC02_Voltage_U45 m15 : 47|16@0+ (1,0) [0|6000] "mV" Vector__XXX
 SG_ CSC02_Voltage_U44 m15 : 31|16@0+ (1,0) [0|6000] "mV" Vector__XXX
 SG_ CSC02_Voltage_U43 m15 : 15|16@0+ (1,0) [0|6000] "mV" Vector__XXX
 SG_ CSC02_Voltage_U42 m14 : 31|16@0+ (1,0) [0|6000] "mV" Vector__XXX
 SG_ CSC02_Voltage_U41 m14 : 15|16@0+ (1,0) [0|6000] "mV" Vector__XXX
 SG_ CSC02_Voltage_U40 m13 : 47|16@0+ (1,0) [0|6000] "mV" Vector__XXX
 SG_ CSC02_Voltage_U39 m13 : 31|16@0+ (1,0) [0|6000] "mV" Vector__XXX
 SG_ CSC02_Voltage_U38 m13 : 15|16@0+ (1,0) [0|6000] "mV" Vector__XXX
 SG_ CSC02_Voltage_U37 m12 : 47|16@0+ (1,0) [0|6000] "mV" Vector__XXX
 SG_ CSC02_Voltage_U36 m12 : 31|16@0+ (1,0) [0|6000] "mV" Vector__XXX
 SG_ CSC02_Voltage_U35 m12 : 15|16@0+ (1,0) [0|6000] "mV" Vector__XXX
 SG_ CSC02_Voltage_U34 m11 : 47|16@0+ (1,0) [0|6000] "mV" Vector__XXX
 SG_ CSC02_Voltage_U33 m11 : 31|16@0+ (1,0) [0|6000] "mV" Vector__XXX
 SG_ CSC02_Voltage_U32 m11 : 15|16@0+ (1,0) [0|6000] "mV" Vector__XXX
 SG_ CSC02_Voltage_U31 m10 : 47|16@0+ (1,0) [0|6000] "mV" Vector__XXX
 SG_ CSC02_Voltage_U30 m10 : 31|16@0+ (1,0) [0|6000] "mV" Vector__XXX
 SG_ CSC02_Voltage_U29 m10 : 15|16@0+ (1,0) [0|6000] "mV" Vector__XXX
 SG_ CSC02_Voltage_U28 m9 : 31|16@0+ (1,0) [0|6000] "mV" Vector__XXX
 SG_ CSC02_Voltage_U27 m9 : 15|16@0+ (1,0) [0|6000] "mV" Vector__XXX
 SG_ CSC02_Voltage_U26 m8 : 47|16@0+ (1,0) [0|6000] "mV" Vector__XXX
 SG_ CSC02_Voltage_U25 m8 : 31|16@0+ (1,0) [0|6000] "mV" Vector__XXX
 SG_ CSC02_Voltage_U24 m8 : 15|16@0+ (1,0) [0|6000] "mV" Vector__XXX
 SG_ CSC02_Voltage_U23 m7 : 47|16@0+ (1,0) [0|6000] "mV" Vector__XXX
 SG_ CSC02_Voltage_U22 m7 : 31|16@0+ (1,0) [0|6000] "mV" Vector__XXX
 SG_ CSC02_Voltage_U21 m7 : 15|16@0+ (1,0) [0|6000] "mV" Vector__XXX
 SG_ CSC02_Voltage_U20 m6 : 47|16@0+ (1,0) [0|6000] "mV" Vector__XXX
 SG_ CSC02_Voltage_U19 m6 : 31|16@0+ (1,0) [0|6000] "mV" Vector__XXX
 SG_ CSC02_Voltage_U18 m6 : 15|16@0+ (1,0) [0|6000] "mV" Vector__XXX
 SG_ CSC02_Voltage_U17 m5 : 47|16@0+ (1,0) [0|6000] "mV" Vector__XXX
 SG_ CSC02_Voltage_U16 m5 : 31|16@0+ (1,0) [0|6000] "mV" Vector__XXX
 SG_ CSC02_Voltage_U15 m5 : 15|16@0+ (1,0) [0|6000] "mV" Vector__XXX
 SG_ CSC02_Voltage_U14 m4 : 31|16@0+ (1,0) [0|6000] "mV" Vector__XXX
 SG_ CSC02_Voltage_U13 m4 : 15|16@0+ (1,0) [0|6000] "mV" Vector__XXX
 SG_ CSC02_Voltage_U12 m3 : 47|16@0+ (1,0) [0|6000] "mV" Vector__XXX
 SG_ CSC02_Voltage_U11 m3 : 31|16@0+ (1,0) [0|6000] "mV" Vector__XXX
 SG_ CSC02_Voltage_U10 m3 : 15|16@0+ (1,0) [0|6000] "mV" Vector__XXX
 SG_ CSC02_Voltage_U9 m2 : 47|16@0+ (1,0) [0|6000] "mV" Vector__XXX
 SG_ CSC02_Voltage_U8 m2 : 31|16@0+ (1,0) [0|6000] "mV" Vector__XXX
 SG_ CSC02_Voltage_U7 m2 : 15|16@0+ (1,0) [0|6000] "mV" Vector__XXX
 SG_ CSC02_Voltage_U6 m1 : 47|16@0+ (1,0) [0|6000] "mV" Vector__XXX
 SG_ CSC02_Voltage_U5 m1 : 31|16@0+ (1,0) [0|6000] "mV" Vector__XXX
 SG_ CSC02_Voltage_U4 m1 : 15|16@0+ (1,0) [0|6000] "mV" Vector__XXX
 SG_ CSC02_Voltage_U3 m0 : 47|16@0+ (1,0) [0|6000] "mV" Vector__XXX
 SG_ CSC02_Voltage_U2 m0 : 31|16@0+ (1,0) [0|6000] "mV" Vector__XXX
 SG_ CSC02_Voltage_U1 m0 : 15|16@0+ (1,0) [0|6000] "mV" Vector__XXX
 SG_ CSC02_IndexCell M : 7|8@0+ (1,0) [0|255] "" Vector__XXX

BO_ 2550333440 CSC03_CELL_VOLTS: 8 CSC03
 SG_ CSC03_Voltage_U56 m19 : 31|16@0+ (1,0) [0|6000] "mV" Vector__XXX
 SG_ CSC03_Voltage_U55 m19 : 15|16@0+ (1,0) [0|6000] "mV" Vector__XXX
 SG_ CSC03_Voltage_U54 m18 : 47|16@0+ (1,0) [0|6000] "mV" Vector__XXX
 SG_ CSC03_Voltage_U53 m18 : 31|16@0+ (1,0) [0|6000] "mV" Vector__XXX
 SG_ CSC03_Voltage_U52 m18 : 15|16@0+ (1,0) [0|6000] "mV" Vector__XXX
 SG_ CSC03_Voltage_U51 m17 : 47|16@0+ (1,0) [0|6000] "mV" Vector__XXX
 SG_ CSC03_Voltage_U50 m17 : 31|16@0+ (1,0) [0|6000] "mV" Vector__XXX
 SG_ CSC03_Voltage_U49 m17 : 15|16@0+ (1,0) [0|6000] "mV" Vector__XXX
 SG_ CSC03_Voltage_U48 m16 : 47|16@0+ (1,0) [0|6000] "mV" Vector__XXX
 SG_ CSC03_Voltage_U47 m16 : 31|16@0+ (1,0) [0|6000] "mV" Vector__XXX
 SG_ CSC03_Voltage_U46 m16 : 15|16@0+ (1,0) [0|6000] "mV" Vector__XXX
 SG_ CSC03_Voltage_U45 m15 : 47|16@0+ (1,0) [0|6000] "mV" Vector__XXX
 SG_ CSC03_Voltage_U44 m15 : 31|16@0+ (1,0) [0|6000] "mV" Vector__XXX
 SG_ CSC03_Voltage_U43 m15 : 15|16@0+ (1,0) [0|6000] "mV" Vector__XXX
 SG_ CSC03_Voltage_U42 m14 : 31|16@0+ (1,0) [0|6000] "mV" Vector__XXX
 SG_ CSC03_Voltage_U41 m14 : 15|16@0+ (1,0) [0|6000] "mV" Vector__XXX
 SG_ CSC03_Voltage_U40 m13 : 47|16@0+ (1,0) [0|6000] "mV" Vector__XXX
 SG_ CSC03_Voltage_U39 m13 : 31|16@0+ (1,0) [0|6000] "mV" Vector__XXX
 SG_ CSC03_Voltage_U38 m13 : 15|16@0+ (1,0) [0|6000] "mV" Vector__XXX
 SG_ CSC03_Voltage_U37 m12 : 47|16@0+ (1,0) [0|6000] "mV" Vector__XXX
 SG_ CSC03_Voltage_U36 m12 : 31|16@0+ (1,0) [0|6000] "mV" Vector__XXX
 SG_ CSC03_Voltage_U35 m12 : 15|16@0+ (1,0) [0|6000] "mV" Vector__XXX
 SG_ CSC03_Voltage_U34 m11 : 47|16@0+ (1,0) [0|6000] "mV" Vector__XXX
 SG_ CSC03_Voltage_U33 m11 : 31|16@0+ (1,0) [0|6000] "mV" Vector__XXX
 SG_ CSC03_Voltage_U32 m11 : 15|16@0+ (1,0) [0|6000] "mV" Vector__XXX
 SG_ CSC03_Voltage_U31 m10 : 47|16@0+ (1,0) [0|6000] "mV" Vector__XXX
 SG_ CSC03_Voltage_U30 m10 : 31|16@0+ (1,0) [0|6000] "mV" Vector__XXX
 SG_ CSC03_Voltage_U29 m10 : 15|16@0+ (1,0) [0|6000] "mV" Vector__XXX
 SG_ CSC03_Voltage_U28 m9 : 31|16@0+ (1,0) [0|6000] "mV" Vector__XXX
 SG_ CSC03_Voltage_U27 m9 : 15|16@0+ (1,0) [0|6000] "mV" Vector__XXX
 SG_ CSC03_Voltage_U26 m8 : 47|16@0+ (1,0) [0|6000] "mV" Vector__XXX
 SG_ CSC03_Voltage_U25 m8 : 31|16@0+ (1,0) [0|6000] "mV" Vector__XXX
 SG_ CSC03_Voltage_U24 m8 : 15|16@0+ (1,0) [0|6000] "mV" Vector__XXX
 SG_ CSC03_Voltage_U23 m7 : 47|16@0+ (1,0) [0|6000] "mV" Vector__XXX
 SG_ CSC03_Voltage_U22 m7 : 31|16@0+ (1,0) [0|6000] "mV" Vector__XXX
 SG_ CSC03_Voltage_U21 m7 : 15|16@0+ (1,0) [0|6000] "mV" Vector__XXX
 SG_ CSC03_Voltage_U20 m6 : 47|16@0+ (1,0) [0|6000] "mV" Vector__XXX
 SG_ CSC03_Voltage_U19 m6 : 31|16@0+ (1,0) [0|6000] "mV" Vector__XXX
 SG_ CSC03_Voltage_U18 m6 : 15|16@0+ (1,0) [0|6000] "mV" Vector__XXX
 SG_ CSC03_Voltage_U17 m5 : 47|16@0+ (1,0) [0|6000] "mV" Vector__XXX
 SG_ CSC03_Voltage_U16 m5 : 31|16@0+ (1,0) [0|6000] "mV" Vector__XXX
 SG_ CSC03_Voltage_U15 m5 : 15|16@0+ (1,0) [0|6000] "mV" Vector__XXX
 SG_ CSC03_Voltage_U14 m4 : 31|16@0+ (1,0) [0|6000] "mV" Vector__XXX
 SG_ CSC03_Voltage_U13 m4 : 15|16@0+ (1,0) [0|6000] "mV" Vector__XXX
 SG_ CSC03_Voltage_U12 m3 : 47|16@0+ (1,0) [0|6000] "mV" Vector__XXX
 SG_ CSC03_Voltage_U11 m3 : 31|16@0+ (1,0) [0|6000] "mV" Vector__XXX
 SG_ CSC03_Voltage_U10 m3 : 15|16@0+ (1,0) [0|6000] "mV" Vector__XXX
 SG_ CSC03_Voltage_U9 m2 : 47|16@0+ (1,0) [0|6000] "mV" Vector__XXX
 SG_ CSC03_Voltage_U8 m2 : 31|16@0+ (1,0) [0|6000] "mV" Vector__XXX
 SG_ CSC03_Voltage_U7 m2 : 15|16@0+ (1,0) [0|6000] "mV" Vector__XXX
 SG_ CSC03_Voltage_U6 m1 : 47|16@0+ (1,0) [0|6000] "mV" Vector__XXX
 SG_ CSC03_Voltage_U5 m1 : 31|16@0+ (1,0) [0|6000] "mV" Vector__XXX
 SG_ CSC03_Voltage_U4 m1 : 15|16@0+ (1,0) [0|6000] "mV" Vector__XXX
 SG_ CSC03_Voltage_U3 m0 : 47|16@0+ (1,0) [0|6000] "mV" Vector__XXX
 SG_ CSC03_Voltage_U2 m0 : 31|16@0+ (1,0) [0|6000] "mV" Vector__XXX
 SG_ CSC03_Voltage_U1 m0 : 15|16@0+ (1,0) [0|6000] "mV" Vector__XXX
 SG_ CSC03_IndexCell M : 7|8@0+ (1,0) [0|255] "" Vector__XXX

BO_ 2550398976 CSC04_CELL_VOLTS: 8 CSC04
 SG_ CSC04_Voltage_U56 m19 : 31|16@0+ (1,0) [0|6000] "mV" Vector__XXX
 SG_ CSC04_Voltage_U55 m19 : 15|16@0+ (1,0) [0|6000] "mV" Vector__XXX
 SG_ CSC04_Voltage_U54 m18 : 47|16@0+ (1,0) [0|6000] "mV" Vector__XXX
 SG_ CSC04_Voltage_U53 m18 : 31|16@0+ (1,0) [0|6000] "mV" Vector__XXX
 SG_ CSC04_Voltage_U52 m18 : 15|16@0+ (1,0) [0|6000] "mV" Vector__XXX
 SG_ CSC04_Voltage_U51 m17 : 47|16@0+ (1,0) [0|6000] "mV" Vector__XXX
 SG_ CSC04_Voltage_U50 m17 : 31|16@0+ (1,0) [0|6000] "mV" Vector__XXX
 SG_ CSC04_Voltage_U49 m17 : 15|16@0+ (1,0) [0|6000] "mV" Vector__XXX
 SG_ CSC04_Voltage_U48 m16 : 47|16@0+ (1,0) [0|6000] "mV" Vector__XXX
 SG_ CSC04_Voltage_U47 m16 : 31|16@0+ (1,0) [0|6000] "mV" Vector__XXX
 SG_ CSC04_Voltage_U46 m16 : 15|16@0+ (1,0) [0|6000] "mV" Vector__XXX
 SG_ CSC04_Voltage_U45 m15 : 47|16@0+ (1,0) [0|6000] "mV" Vector__XXX
 SG_ CSC04_Voltage_U44 m15 : 31|16@0+ (1,0) [0|6000] "mV" Vector__XXX
 SG_ CSC04_Voltage_U43 m15 : 15|16@0+ (1,0) [0|6000] "mV" Vector__XXX
 SG_ CSC04_Voltage_U42 m14 : 31|16@0+ (1,0) [0|6000] "mV" Vector__XXX
 SG_ CSC04_Voltage_U41 m14 : 15|16@0+ (1,0) [0|6000] "mV" Vector__XXX
 SG_ CSC04_Voltage_U40 m13 : 47|16@0+ (1,0) [0|6000] "mV" Vector__XXX
 SG_ CSC04_Voltage_U39 m13 : 31|16@0+ (1,0) [0|6000] "mV" Vector__XXX
 SG_ CSC04_Voltage_U38 m13 : 15|16@0+ (1,0) [0|6000] "mV" Vector__XXX
 SG_ CSC04_Voltage_U37 m12 : 47|16@0+ (1,0) [0|6000] "mV" Vector__XXX
 SG_ CSC04_Voltage_U36 m12 : 31|16@0+ (1,0) [0|6000] "mV" Vector__XXX
 SG_ CSC04_Voltage_U35 m12 : 15|16@0+ (1,0) [0|6000] "mV" Vector__XXX
 SG_ CSC04_Voltage_U34 m11 : 47|16@0+ (1,0) [0|6000] "mV" Vector__XXX
 SG_ CSC04_Voltage_U33 m11 : 31|16@0+ (1,0) [0|6000] "mV" Vector__XXX
 SG_ CSC04_Voltage_U32 m11 : 15|16@0+ (1,0) [0|6000] "mV" Vector__XXX
 SG_ CSC04_Voltage_U31 m10 : 47|16@0+ (1,0) [0|6000] "mV" Vector__XXX
 SG_ CSC04_Voltage_U30 m10 : 31|16@0+ (1,0) [0|6000] "mV" Vector__XXX
 SG_ CSC04_Voltage_U29 m10 : 15|16@0+ (1,0) [0|6000] "mV" Vector__XXX
 SG_ CSC04_Voltage_U28 m9 : 31|16@0+ (1,0) [0|6000] "mV" Vector__XXX
 SG_ CSC04_Voltage_U27 m9 : 15|16@0+ (1,0) [0|6000] "mV" Vector__XXX
 SG_ CSC04_Voltage_U26 m8 : 47|16@0+ (1,0) [0|6000] "mV" Vector__XXX
 SG_ CSC04_Voltage_U25 m8 : 31|16@0+ (1,0) [0|6000] "mV" Vector__XXX
 SG_ CSC04_Voltage_U24 m8 : 15|16@0+ (1,0) [0|6000] "mV" Vector__XXX
 SG_ CSC04_Voltage_U23 m7 : 47|16@0+ (1,0) [0|6000] "mV" Vector__XXX
 SG_ CSC04_Voltage_U22 m7 : 31|16@0+ (1,0) [0|6000] "mV" Vector__XXX
 SG_ CSC04_Voltage_U21 m7 : 15|16@0+ (1,0) [0|6000] "mV" Vector__XXX
 SG_ CSC04_Voltage_U20 m6 : 47|16@0+ (1,0) [0|6000] "mV" Vector__XXX
 SG_ CSC04_Voltage_U19 m6 : 31|16@0+ (1,0) [0|6000] "mV" Vector__XXX
 SG_ CSC04_Voltage_U18 m6 : 15|16@0+ (1,0) [0|6000] "mV" Vector__XXX
 SG_ CSC04_Voltage_U17 m5 : 47|16@0+ (1,0) [0|6000] "mV" Vector__XXX
 SG_ CSC04_Voltage_U16 m5 : 31|16@0+ (1,0) [0|6000] "mV" Vector__XXX
 SG_ CSC04_Voltage_U15 m5 : 15|16@0+ (1,0) [0|6000] "mV" Vector__XXX
 SG_ CSC04_Voltage_U14 m4 : 31|16@0+ (1,0) [0|6000] "mV" Vector__XXX
 SG_ CSC04_Voltage_U13 m4 : 15|16@0+ (1,0) [0|6000] "mV" Vector__XXX
 SG_ CSC04_Voltage_U12 m3 : 47|16@0+ (1,0) [0|6000] "mV" Vector__XXX
 SG_ CSC04_Voltage_U11 m3 : 31|16@0+ (1,0) [0|6000] "mV" Vector__XXX
 SG_ CSC04_Voltage_U10 m3 : 15|16@0+ (1,0) [0|6000] "mV" Vector__XXX
 SG_ CSC04_Voltage_U9 m2 : 47|16@0+ (1,0) [0|6000] "mV" Vector__XXX
 SG_ CSC04_Voltage_U8 m2 : 31|16@0+ (1,0) [0|6000] "mV" Vector__XXX
 SG_ CSC04_Voltage_U7 m2 : 15|16@0+ (1,0) [0|6000] "mV" Vector__XXX
 SG_ CSC04_Voltage_U6 m1 : 47|16@0+ (1,0) [0|6000] "mV" Vector__XXX
 SG_ CSC04_Voltage_U5 m1 : 31|16@0+ (1,0) [0|6000] "mV" Vector__XXX
 SG_ CSC04_Voltage_U4 m1 : 15|16@0+ (1,0) [0|6000] "mV" Vector__XXX
 SG_ CSC04_Voltage_U3 m0 : 47|16@0+ (1,0) [0|6000] "mV" Vector__XXX
 SG_ CSC04_Voltage_U2 m0 : 31|16@0+ (1,0) [0|6000] "mV" Vector__XXX
 SG_ CSC04_Voltage_U1 m0 : 15|16@0+ (1,0) [0|6000] "mV" Vector__XXX
 SG_ CSC04_IndexCell M : 7|8@0+ (1,0) [0|255] "" Vector__XXX

BO_ 2550464512 CSC05_CELL_VOLTS: 8 CSC05
 SG_ CSC05_Voltage_U56 m19 : 31|16@0+ (1,0) [0|6000] "mV" Vector__XXX
 SG_ CSC05_Voltage_U55 m19 : 15|16@0+ (1,0) [0|6000] "mV" Vector__XXX
 SG_ CSC05_Voltage_U54 m18 : 47|16@0+ (1,0) [0|6000] "mV" Vector__XXX
 SG_ CSC05_Voltage_U53 m18 : 31|16@0+ (1,0) [0|6000] "mV" Vector__XXX
 SG_ CSC05_Voltage_U52 m18 : 15|16@0+ (1,0) [0|6000] "mV" Vector__XXX
 SG_ CSC05_Voltage_U51 m17 : 47|16@0+ (1,0) [0|6000] "mV" Vector__XXX
 SG_ CSC05_Voltage_U50 m17 : 31|16@0+ (1,0) [0|6000] "mV" Vector__XXX
 SG_ CSC05_Voltage_U49 m17 : 15|16@0+ (1,0) [0|6000] "mV" Vector__XXX
 SG_ CSC05_Voltage_U48 m16 : 47|16@0+ (1,0) [0|6000] "mV" Vector__XXX
 SG_ CSC05_Voltage_U47 m16 : 31|16@0+ (1,0) [0|6000] "mV" Vector__XXX
 SG_ CSC05_Voltage_U46 m16 : 15|16@0+ (1,0) [0|6000] "mV" Vector__XXX
 SG_ CSC05_Voltage_U45 m15 : 47|16@0+ (1,0) [0|6000] "mV" Vector__XXX
 SG_ CSC05_Voltage_U44 m15 : 31|16@0+ (1,0) [0|6000] "mV" Vector__XXX
 SG_ CSC05_Voltage_U43 m15 : 15|16@0+ (1,0) [0|6000] "mV" Vector__XXX
 SG_ CSC05_Voltage_U42 m14 : 31|16@0+ (1,0) [0|6000] "mV" Vector__XXX
 SG_ CSC05_Voltage_U41 m14 : 15|16@0+ (1,0) [0|6000] "mV" Vector__XXX
 SG_ CSC05_Voltage_U40 m13 : 47|16@0+ (1,0) [0|6000] "mV" Vector__XXX
 SG_ CSC05_Voltage_U39 m13 : 31|16@0+ (1,0) [0|6000] "mV" Vector__XXX
 SG_ CSC05_Voltage_U38 m13 : 15|16@0+ (1,0) [0|6000] "mV" Vector__XXX
 SG_ CSC05_Voltage_U37 m12 : 47|16@0+ (1,0) [0|6000] "mV" Vector__XXX
 SG_ CSC05_Voltage_U36 m12 : 31|16@0+ (1,0) [0|6000] "mV" Vector__XXX
 SG_ CSC05_Voltage_U35 m12 : 15|16@0+ (1,0) [0|6000] "mV" Vector__XXX
 SG_ CSC05_Voltage_U34 m11 : 47|16@0+ (1,0) [0|6000] "mV" Vector__XXX
 SG_ CSC05_Voltage_U33 m11 : 31|16@0+ (1,0) [0|6000] "mV" Vector__XXX
 SG_ CSC05_Voltage_U32 m11 : 15|16@0+ (1,0) [0|6000] "mV" Vector__XXX
 SG_ CSC05_Voltage_U31 m10 : 47|16@0+ (1,0) [0|6000] "mV" Vector__XXX
 SG_ CSC05_Voltage_U30 m10 : 31|16@0+ (1,0) [0|6000] "mV" Vector__XXX
 SG_ CSC05_Voltage_U29 m10 : 15|16@0+ (1,0) [0|6000] "mV" Vector__XXX
 SG_ CSC05_Voltage_U28 m9 : 31|16@0+ (1,0) [0|6000] "mV" Vector__XXX
 SG_ CSC05_Voltage_U27 m9 : 15|16@0+ (1,0) [0|6000] "mV" Vector__XXX
 SG_ CSC05_Voltage_U26 m8 : 47|16@0+ (1,0) [0|6000] "mV" Vector__XXX
 SG_ CSC05_Voltage_U25 m8 : 31|16@0+ (1,0) [0|6000] "mV" Vector__XXX
 SG_ CSC05_Voltage_U24 m8 : 15|16@0+ (1,0) [0|6000] "mV" Vector__XXX
 SG_ CSC05_Voltage_U23 m7 : 47|16@0+ (1,0) [0|6000] "mV" Vector__XXX
 SG_ CSC05_Voltage_U22 m7 : 31|16@0+ (1,0) [0|6000] "mV" Vector__XXX
 SG_ CSC05_Voltage_U21 m7 : 15|16@0+ (1,0) [0|6000] "mV" Vector__XXX
 SG_ CSC05_Voltage_U20 m6 : 47|16@0+ (1,0) [0|6000] "mV" Vector__XXX
 SG_ CSC05_Voltage_U19 m6 : 31|16@0+ (1,0) [0|6000] "mV" Vector__XXX
 SG_ CSC05_Voltage_U18 m6 : 15|16@0+ (1,0) [0|6000] "mV" Vector__XXX
 SG_ CSC05_Voltage_U17 m5 : 47|16@0+ (1,0) [0|6000] "mV" Vector__XXX
 SG_ CSC05_Voltage_U16 m5 : 31|16@0+ (1,0) [0|6000] "mV" Vector__XXX
 SG_ CSC05_Voltage_U15 m5 : 15|16@0+ (1,0) [0|6000] "mV" Vector__XXX
 SG_ CSC05_Voltage_U14 m4 : 31|16@0+ (1,0) [0|6000] "mV" Vector__XXX
 SG_ CSC05_Voltage_U13 m4 : 15|16@0+ (1,0) [0|6000] "mV" Vector__XXX
 SG_ CSC05_Voltage_U12 m3 : 47|16@0+ (1,0) [0|6000] "mV" Vector__XXX
 SG_ CSC05_Voltage_U11 m3 : 31|16@0+ (1,0) [0|6000] "mV" Vector__XXX
 SG_ CSC05_Voltage_U10 m3 : 15|16@0+ (1,0) [0|6000] "mV" Vector__XXX
 SG_ CSC05_Voltage_U9 m2 : 47|16@0+ (1,0) [0|6000] "mV" Vector__XXX
 SG_ CSC05_Voltage_U8 m2 : 31|16@0+ (1,0) [0|6000] "mV" Vector__XXX
 SG_ CSC05_Voltage_U7 m2 : 15|16@0+ (1,0) [0|6000] "mV" Vector__XXX
 SG_ CSC05_Voltage_U6 m1 : 47|16@0+ (1,0) [0|6000] "mV" Vector__XXX
 SG_ CSC05_Voltage_U5 m1 : 31|16@0+ (1,0) [0|6000] "mV" Vector__XXX
 SG_ CSC05_Voltage_U4 m1 : 15|16@0+ (1,0) [0|6000] "mV" Vector__XXX
 SG_ CSC05_Voltage_U3 m0 : 47|16@0+ (1,0) [0|6000] "mV" Vector__XXX
 SG_ CSC05_Voltage_U2 m0 : 31|16@0+ (1,0) [0|6000] "mV" Vector__XXX
 SG_ CSC05_Voltage_U1 m0 : 15|16@0+ (1,0) [0|6000] "mV" Vector__XXX
 SG_ CSC05_IndexCell M : 7|8@0+ (1,0) [0|255] "" Vector__XXX

BO_ 2550530048 CSC06_CELL_VOLTS: 8 CSC06
 SG_ CSC06_Voltage_U56 m19 : 31|16@0+ (1,0) [0|6000] "mV" Vector__XXX
 SG_ CSC06_Voltage_U55 m19 : 15|16@0+ (1,0) [0|6000] "mV" Vector__XXX
 SG_ CSC06_Voltage_U54 m18 : 47|16@0+ (1,0) [0|6000] "mV" Vector__XXX
 SG_ CSC06_Voltage_U53 m18 : 31|16@0+ (1,0) [0|6000] "mV" Vector__XXX
 SG_ CSC06_Voltage_U52 m18 : 15|16@0+ (1,0) [0|6000] "mV" Vector__XXX
 SG_ CSC06_Voltage_U51 m17 : 47|16@0+ (1,0) [0|6000] "mV" Vector__XXX
 SG_ CSC06_Voltage_U50 m17 : 31|16@0+ (1,0) [0|6000] "mV" Vector__XXX
 SG_ CSC06_Voltage_U49 m17 : 15|16@0+ (1,0) [0|6000] "mV" Vector__XXX
 SG_ CSC06_Voltage_U48 m16 : 47|16@0+ (1,0) [0|6000] "mV" Vector__XXX
 SG_ CSC06_Voltage_U47 m16 : 31|16@0+ (1,0) [0|6000] "mV" Vector__XXX
 SG_ CSC06_Voltage_U46 m16 : 15|16@0+ (1,0) [0|6000] "mV" Vector__XXX
 SG_ CSC06_Voltage_U45 m15 : 47|16@0+ (1,0) [0|6000] "mV" Vector__XXX
 SG_ CSC06_Voltage_U44 m15 : 31|16@0+ (1,0) [0|6000] "mV" Vector__XXX
 SG_ CSC06_Voltage_U43 m15 : 15|16@0+ (1,0) [0|6000] "mV" Vector__XXX
 SG_ CSC06_Voltage_U42 m14 : 31|16@0+ (1,0) [0|6000] "mV" Vector__XXX
 SG_ CSC06_Voltage_U41 m14 : 15|16@0+ (1,0) [0|6000] "mV" Vector__XXX
 SG_ CSC06_Voltage_U40 m13 : 47|16@0+ (1,0) [0|6000] "mV" Vector__XXX
 SG_ CSC06_Voltage_U39 m13 : 31|16@0+ (1,0) [0|6000] "mV" Vector__XXX
 SG_ CSC06_Voltage_U38 m13 : 15|16@0+ (1,0) [0|6000] "mV" Vector__XXX
 SG_ CSC06_Voltage_U37 m12 : 47|16@0+ (1,0) [0|6000] "mV" Vector__XXX
 SG_ CSC06_Voltage_U36 m12 : 31|16@0+ (1,0) [0|6000] "mV" Vector__XXX
 SG_ CSC06_Voltage_U35 m12 : 15|16@0+ (1,0) [0|6000] "mV" Vector__XXX
 SG_ CSC06_Voltage_U34 m11 : 47|16@0+ (1,0) [0|6000] "mV" Vector__XXX
 SG_ CSC06_Voltage_U33 m11 : 31|16@0+ (1,0) [0|6000] "mV" Vector__XXX
 SG_ CSC06_Voltage_U32 m11 : 15|16@0+ (1,0) [0|6000] "mV" Vector__XXX
 SG_ CSC06_Voltage_U31 m10 : 47|16@0+ (1,0) [0|6000] "mV" Vector__XXX
 SG_ CSC06_Voltage_U30 m10 : 31|16@0+ (1,0) [0|6000] "mV" Vector__XXX
 SG_ CSC06_Voltage_U29 m10 : 15|16@0+ (1,0) [0|6000] "mV" Vector__XXX
 SG_ CSC06_Voltage_U28 m9 : 31|16@0+ (1,0) [0|6000] "mV" Vector__XXX
 SG_ CSC06_Voltage_U27 m9 : 15|16@0+ (1,0) [0|6000] "mV" Vector__XXX
 SG_ CSC06_Voltage_U26 m8 : 47|16@0+ (1,0) [0|6000] "mV" Vector__XXX
 SG_ CSC06_Voltage_U25 m8 : 31|16@0+ (1,0) [0|6000] "mV" Vector__XXX
 SG_ CSC06_Voltage_U24 m8 : 15|16@0+ (1,0) [0|6000] "mV" Vector__XXX
 SG_ CSC06_Voltage_U23 m7 : 47|16@0+ (1,0) [0|6000] "mV" Vector__XXX
 SG_ CSC06_Voltage_U22 m7 : 31|16@0+ (1,0) [0|6000] "mV" Vector__XXX
 SG_ CSC06_Voltage_U21 m7 : 15|16@0+ (1,0) [0|6000] "mV" Vector__XXX
 SG_ CSC06_Voltage_U20 m6 : 47|16@0+ (1,0) [0|6000] "mV" Vector__XXX
 SG_ CSC06_Voltage_U19 m6 : 31|16@0+ (1,0) [0|6000] "mV" Vector__XXX
 SG_ CSC06_Voltage_U18 m6 : 15|16@0+ (1,0) [0|6000] "mV" Vector__XXX
 SG_ CSC06_Voltage_U17 m5 : 47|16@0+ (1,0) [0|6000] "mV" Vector__XXX
 SG_ CSC06_Voltage_U16 m5 : 31|16@0+ (1,0) [0|6000] "mV" Vector__XXX
 SG_ CSC06_Voltage_U15 m5 : 15|16@0+ (1,0) [0|6000] "mV" Vector__XXX
 SG_ CSC06_Voltage_U14 m4 : 31|16@0+ (1,0) [0|6000] "mV" Vector__XXX
 SG_ CSC06_Voltage_U13 m4 : 15|16@0+ (1,0) [0|6000] "mV" Vector__XXX
 SG_ CSC06_Voltage_U12 m3 : 47|16@0+ (1,0) [0|6000] "mV" Vector__XXX
 SG_ CSC06_Voltage_U11 m3 : 31|16@0+ (1,0) [0|6000] "mV" Vector__XXX
 SG_ CSC06_Voltage_U10 m3 : 15|16@0+ (1,0) [0|6000] "mV" Vector__XXX
 SG_ CSC06_Voltage_U9 m2 : 47|16@0+ (1,0) [0|6000] "mV" Vector__XXX
 SG_ CSC06_Voltage_U8 m2 : 31|16@0+ (1,0) [0|6000] "mV" Vector__XXX
 SG_ CSC06_Voltage_U7 m2 : 15|16@0+ (1,0) [0|6000] "mV" Vector__XXX
 SG_ CSC06_Voltage_U6 m1 : 47|16@0+ (1,0) [0|6000] "mV" Vector__XXX
 SG_ CSC06_Voltage_U5 m1 : 31|16@0+ (1,0) [0|6000] "mV" Vector__XXX
 SG_ CSC06_Voltage_U4 m1 : 15|16@0+ (1,0) [0|6000] "mV" Vector__XXX
 SG_ CSC06_Voltage_U3 m0 : 47|16@0+ (1,0) [0|6000] "mV" Vector__XXX
 SG_ CSC06_Voltage_U2 m0 : 31|16@0+ (1,0) [0|6000] "mV" Vector__XXX
 SG_ CSC06_Voltage_U1 m0 : 15|16@0+ (1,0) [0|6000] "mV" Vector__XXX
 SG_ CSC06_IndexCell M : 7|8@0+ (1,0) [0|255] "" Vector__XXX

BO_ 2550595584 CSC07_CELL_VOLTS: 8 CSC07
 SG_ CSC07_Voltage_U56 m19 : 31|16@0+ (1,0) [0|6000] "mV" Vector__XXX
 SG_ CSC07_Voltage_U55 m19 : 15|16@0+ (1,0) [0|6000] "mV" Vector__XXX
 SG_ CSC07_Voltage_U54 m18 : 47|16@0+ (1,0) [0|6000] "mV" Vector__XXX
 SG_ CSC07_Voltage_U53 m18 : 31|16@0+ (1,0) [0|6000] "mV" Vector__XXX
 SG_ CSC07_Voltage_U52 m18 : 15|16@0+ (1,0) [0|6000] "mV" Vector__XXX
 SG_ CSC07_Voltage_U51 m17 : 47|16@0+ (1,0) [0|6000] "mV" Vector__XXX
 SG_ CSC07_Voltage_U50 m17 : 31|16@0+ (1,0) [0|6000] "mV" Vector__XXX
 SG_ CSC07_Voltage_U49 m17 : 15|16@0+ (1,0) [0|6000] "mV" Vector__XXX
 SG_ CSC07_Voltage_U48 m16 : 47|16@0+ (1,0) [0|6000] "mV" Vector__XXX
 SG_ CSC07_Voltage_U47 m16 : 31|16@0+ (1,0) [0|6000] "mV" Vector__XXX
 SG_ CSC07_Voltage_U46 m16 : 15|16@0+ (1,0) [0|6000] "mV" Vector__XXX
 SG_ CSC07_Voltage_U45 m15 : 47|16@0+ (1,0) [0|6000] "mV" Vector__XXX
 SG_ CSC07_Voltage_U44 m15 : 31|16@0+ (1,0) [0|6000] "mV" Vector__XXX
 SG_ CSC07_Voltage_U43 m15 : 15|16@0+ (1,0) [0|6000] "mV" Vector__XXX
 SG_ CSC07_Voltage_U42 m14 : 31|16@0+ (1,0) [0|6000] "mV" Vector__XXX
 SG_ CSC07_Voltage_U41 m14 : 15|16@0+ (1,0) [0|6000] "mV" Vector__XXX
 SG_ CSC07_Voltage_U40 m13 : 47|16@0+ (1,0) [0|6000] "mV" Vector__XXX
 SG_ CSC07_Voltage_U39 m13 : 31|16@0+ (1,0) [0|6000] "mV" Vector__XXX
 SG_ CSC07_Voltage_U38 m13 : 15|16@0+ (1,0) [0|6000] "mV" Vector__XXX
 SG_ CSC07_Voltage_U37 m12 : 47|16@0+ (1,0) [0|6000] "mV" Vector__XXX
 SG_ CSC07_Voltage_U36 m12 : 31|16@0+ (1,0) [0|6000] "mV" Vector__XXX
 SG_ CSC07_Voltage_U35 m12 : 15|16@0+ (1,0) [0|6000] "mV" Vector__XXX
 SG_ CSC07_Voltage_U34 m11 : 47|16@0+ (1,0) [0|6000] "mV" Vector__XXX
 SG_ CSC07_Voltage_U33 m11 : 31|16@0+ (1,0) [0|6000] "mV" Vector__XXX
 SG_ CSC07_Voltage_U32 m11 : 15|16@0+ (1,0) [0|6000] "mV" Vector__XXX
 SG_ CSC07_Voltage_U31 m10 : 47|16@0+ (1,0) [0|6000] "mV" Vector__XXX
 SG_ CSC07_Voltage_U30 m10 : 31|16@0+ (1,0) [0|6000] "mV" Vector__XXX
 SG_ CSC07_Voltage_U29 m10 : 15|16@0+ (1,0) [0|6000] "mV" Vector__XXX
 SG_ CSC07_Voltage_U28 m9 : 31|16@0+ (1,0) [0|6000] "mV" Vector__XXX
 SG_ CSC07_Voltage_U27 m9 : 15|16@0+ (1,0) [0|6000] "mV" Vector__XXX
 SG_ CSC07_Voltage_U26 m8 : 47|16@0+ (1,0) [0|6000] "mV" Vector__XXX
 SG_ CSC07_Voltage_U25 m8 : 31|16@0+ (1,0) [0|6000] "mV" Vector__XXX
 SG_ CSC07_Voltage_U24 m8 : 15|16@0+ (1,0) [0|6000] "mV" Vector__XXX
 SG_ CSC07_Voltage_U23 m7 : 47|16@0+ (1,0) [0|6000] "mV" Vector__XXX
 SG_ CSC07_Voltage_U22 m7 : 31|16@0+ (1,0) [0|6000] "mV" Vector__XXX
 SG_ CSC07_Voltage_U21 m7 : 15|16@0+ (1,0) [0|6000] "mV" Vector__XXX
 SG_ CSC07_Voltage_U20 m6 : 47|16@0+ (1,0) [0|6000] "mV" Vector__XXX
 SG_ CSC07_Voltage_U19 m6 : 31|16@0+ (1,0) [0|6000] "mV" Vector__XXX
 SG_ CSC07_Voltage_U18 m6 : 15|16@0+ (1,0) [0|6000] "mV" Vector__XXX
 SG_ CSC07_Voltage_U17 m5 : 47|16@0+ (1,0) [0|6000] "mV" Vector__XXX
 SG_ CSC07_Voltage_U16 m5 : 31|16@0+ (1,0) [0|6000] "mV" Vector__XXX
 SG_ CSC07_Voltage_U15 m5 : 15|16@0+ (1,0) [0|6000] "mV" Vector__XXX
 SG_ CSC07_Voltage_U14 m4 : 31|16@0+ (1,0) [0|6000] "mV" Vector__XXX
 SG_ CSC07_Voltage_U13 m4 : 15|16@0+ (1,0) [0|6000] "mV" Vector__XXX
 SG_ CSC07_Voltage_U12 m3 : 47|16@0+ (1,0) [0|6000] "mV" Vector__XXX
 SG_ CSC07_Voltage_U11 m3 : 31|16@0+ (1,0) [0|6000] "mV" Vector__XXX
 SG_ CSC07_Voltage_U10 m3 : 15|16@0+ (1,0) [0|6000] "mV" Vector__XXX
 SG_ CSC07_Voltage_U9 m2 : 47|16@0+ (1,0) [0|6000] "mV" Vector__XXX
 SG_ CSC07_Voltage_U8 m2 : 31|16@0+ (1,0) [0|6000] "mV" Vector__XXX
 SG_ CSC07_Voltage_U7 m2 : 15|16@0+ (1,0) [0|6000] "mV" Vector__XXX
 SG_ CSC07_Voltage_U6 m1 : 47|16@0+ (1,0) [0|6000] "mV" Vector__XXX
 SG_ CSC07_Voltage_U5 m1 : 31|16@0+ (1,0) [0|6000] "mV" Vector__XXX
 SG_ CSC07_Voltage_U4 m1 : 15|16@0+ (1,0) [0|6000] "mV" Vector__XXX
 SG_ CSC07_Voltage_U3 m0 : 47|16@0+ (1,0) [0|6000] "mV" Vector__XXX
 SG_ CSC07_Voltage_U2 m0 : 31|16@0+ (1,0) [0|6000] "mV" Vector__XXX
 SG_ CSC07_Voltage_U1 m0 : 15|16@0+ (1,0) [0|6000] "mV" Vector__XXX
 SG_ CSC07_IndexCell M : 7|8@0+ (1,0) [0|255] "" Vector__XXX

BO_ 2550661120 CSC08_CELL_VOLTS: 8 CSC08
 SG_ CSC08_Voltage_U56 m19 : 31|16@0+ (1,0) [0|6000] "mV" Vector__XXX
 SG_ CSC08_Voltage_U55 m19 : 15|16@0+ (1,0) [0|6000] "mV" Vector__XXX
 SG_ CSC08_Voltage_U54 m18 : 47|16@0+ (1,0) [0|6000] "mV" Vector__XXX
 SG_ CSC08_Voltage_U53 m18 : 31|16@0+ (1,0) [0|6000] "mV" Vector__XXX
 SG_ CSC08_Voltage_U52 m18 : 15|16@0+ (1,0) [0|6000] "mV" Vector__XXX
 SG_ CSC08_Voltage_U51 m17 : 47|16@0+ (1,0) [0|6000] "mV" Vector__XXX
 SG_ CSC08_Voltage_U50 m17 : 31|16@0+ (1,0) [0|6000] "mV" Vector__XXX
 SG_ CSC08_Voltage_U49 m17 : 15|16@0+ (1,0) [0|6000] "mV" Vector__XXX
 SG_ CSC08_Voltage_U48 m16 : 47|16@0+ (1,0) [0|6000] "mV" Vector__XXX
 SG_ CSC08_Voltage_U47 m16 : 31|16@0+ (1,0) [0|6000] "mV" Vector__XXX
 SG_ CSC08_Voltage_U46 m16 : 15|16@0+ (1,0) [0|6000] "mV" Vector__XXX
 SG_ CSC08_Voltage_U45 m15 : 47|16@0+ (1,0) [0|6000] "mV" Vector__XXX
 SG_ CSC08_Voltage_U44 m15 : 31|16@0+ (1,0) [0|6000] "mV" Vector__XXX
 SG_ CSC08_Voltage_U43 m15 : 15|16@0+ (1,0) [0|6000] "mV" Vector__XXX
 SG_ CSC08_Voltage_U42 m14 : 31|16@0+ (1,0) [0|6000] "mV" Vector__XXX
 SG_ CSC08_Voltage_U41 m14 : 15|16@0+ (1,0) [0|6000] "mV" Vector__XXX
 SG_ CSC08_Voltage_U40 m13 : 47|16@0+ (1,0) [0|6000] "mV" Vector__XXX
 SG_ CSC08_Voltage_U39 m13 : 31|16@0+ (1,0) [0|6000] "mV" Vector__XXX
 SG_ CSC08_Voltage_U38 m13 : 15|16@0+ (1,0) [0|6000] "mV" Vector__XXX
 SG_ CSC08_Voltage_U37 m12 : 47|16@0+ (1,0) [0|6000] "mV" Vector__XXX
 SG_ CSC08_Voltage_U36 m12 : 31|16@0+ (1,0) [0|6000] "mV" Vector__XXX
 SG_ CSC08_Voltage_U35 m12 : 15|16@0+ (1,0) [0|6000] "mV" Vector__XXX
 SG_ CSC08_Voltage_U34 m11 : 47|16@0+ (1,0) [0|6000] "mV" Vector__XXX
 SG_ CSC08_Voltage_U33 m11 : 31|16@0+ (1,0) [0|6000] "mV" Vector__XXX
 SG_ CSC08_Voltage_U32 m11 : 15|16@0+ (1,0) [0|6000] "mV" Vector__XXX
 SG_ CSC08_Voltage_U31 m10 : 47|16@0+ (1,0) [0|6000] "mV" Vector__XXX
 SG_ CSC08_Voltage_U30 m10 : 31|16@0+ (1,0) [0|6000] "mV" Vector__XXX
 SG_ CSC08_Voltage_U29 m10 : 15|16@0+ (1,0) [0|6000] "mV" Vector__XXX
 SG_ CSC08_Voltage_U28 m9 : 31|16@0+ (1,0) [0|6000] "mV" Vector__XXX
 SG_ CSC08_Voltage_U27 m9 : 15|16@0+ (1,0) [0|6000] "mV" Vector__XXX
 SG_ CSC08_Voltage_U26 m8 : 47|16@0+ (1,0) [0|6000] "mV" Vector__XXX
 SG_ CSC08_Voltage_U25 m8 : 31|16@0+ (1,0) [0|6000] "mV" Vector__XXX
 SG_ CSC08_Voltage_U24 m8 : 15|16@0+ (1,0) [0|6000] "mV" Vector__XXX
 SG_ CSC08_Voltage_U23 m7 : 47|16@0+ (1,0) [0|6000] "mV" Vector__XXX
 SG_ CSC08_Voltage_U22 m7 : 31|16@0+ (1,0) [0|6000] "mV" Vector__XXX
 SG_ CSC08_Voltage_U21 m7 : 15|16@0+ (1,0) [0|6000] "mV" Vector__XXX
 SG_ CSC08_Voltage_U20 m6 : 47|16@0+ (1,0) [0|6000] "mV" Vector__XXX
 SG_ CSC08_Voltage_U19 m6 : 31|16@0+ (1,0) [0|6000] "mV" Vector__XXX
 SG_ CSC08_Voltage_U18 m6 : 15|16@0+ (1,0) [0|6000] "mV" Vector__XXX
 SG_ CSC08_Voltage_U17 m5 : 47|16@0+ (1,0) [0|6000] "mV" Vector__XXX
 SG_ CSC08_Voltage_U16 m5 : 31|16@0+ (1,0) [0|6000] "mV" Vector__XXX
 SG_ CSC08_Voltage_U15 m5 : 15|16@0+ (1,0) [0|6000] "mV" Vector__XXX
 SG_ CSC08_Voltage_U14 m4 : 31|16@0+ (1,0) [0|6000] "mV" Vector__XXX
 SG_ CSC08_Voltage_U13 m4 : 15|16@0+ (1,0) [0|6000] "mV" Vector__XXX
 SG_ CSC08_Voltage_U12 m3 : 47|16@0+ (1,0) [0|6000] "mV" Vector__XXX
 SG_ CSC08_Voltage_U11 m3 : 31|16@0+ (1,0) [0|6000] "mV" Vector__XXX
 SG_ CSC08_Voltage_U10 m3 : 15|16@0+ (1,0) [0|6000] "mV" Vector__XXX
 SG_ CSC08_Voltage_U9 m2 : 47|16@0+ (1,0) [0|6000] "mV" Vector__XXX
 SG_ CSC08_Voltage_U8 m2 : 31|16@0+ (1,0) [0|6000] "mV" Vector__XXX
 SG_ CSC08_Voltage_U7 m2 : 15|16@0+ (1,0) [0|6000] "mV" Vector__XXX
 SG_ CSC08_Voltage_U6 m1 : 47|16@0+ (1,0) [0|6000] "mV" Vector__XXX
 SG_ CSC08_Voltage_U5 m1 : 31|16@0+ (1,0) [0|6000] "mV" Vector__XXX
 SG_ CSC08_Voltage_U4 m1 : 15|16@0+ (1,0) [0|6000] "mV" Vector__XXX
 SG_ CSC08_Voltage_U3 m0 : 47|16@0+ (1,0) [0|6000] "mV" Vector__XXX
 SG_ CSC08_Voltage_U2 m0 : 31|16@0+ (1,0) [0|6000] "mV" Vector__XXX
 SG_ CSC08_Voltage_U1 m0 : 15|16@0+ (1,0) [0|6000] "mV" Vector__XXX
 SG_ CSC08_IndexCell M : 7|8@0+ (1,0) [0|255] "" Vector__XXX

BO_ 2550726656 CSC09_CELL_VOLTS: 8 CSC09
 SG_ CSC09_Voltage_U56 m19 : 31|16@0+ (1,0) [0|6000] "mV" Vector__XXX
 SG_ CSC09_Voltage_U55 m19 : 15|16@0+ (1,0) [0|6000] "mV" Vector__XXX
 SG_ CSC09_Voltage_U54 m18 : 47|16@0+ (1,0) [0|6000] "mV" Vector__XXX
 SG_ CSC09_Voltage_U53 m18 : 31|16@0+ (1,0) [0|6000] "mV" Vector__XXX
 SG_ CSC09_Voltage_U52 m18 : 15|16@0+ (1,0) [0|6000] "mV" Vector__XXX
 SG_ CSC09_Voltage_U51 m17 : 47|16@0+ (1,0) [0|6000] "mV" Vector__XXX
 SG_ CSC09_Voltage_U50 m17 : 31|16@0+ (1,0) [0|6000] "mV" Vector__XXX
 SG_ CSC09_Voltage_U49 m17 : 15|16@0+ (1,0) [0|6000] "mV" Vector__XXX
 SG_ CSC09_Voltage_U48 m16 : 47|16@0+ (1,0) [0|6000] "mV" Vector__XXX
 SG_ CSC09_Voltage_U47 m16 : 31|16@0+ (1,0) [0|6000] "mV" Vector__XXX
 SG_ CSC09_Voltage_U46 m16 : 15|16@0+ (1,0) [0|6000] "mV" Vector__XXX
 SG_ CSC09_Voltage_U45 m15 : 47|16@0+ (1,0) [0|6000] "mV" Vector__XXX
 SG_ CSC09_Voltage_U44 m15 : 31|16@0+ (1,0) [0|6000] "mV" Vector__XXX
 SG_ CSC09_Voltage_U43 m15 : 15|16@0+ (1,0) [0|6000] "mV" Vector__XXX
 SG_ CSC09_Voltage_U42 m14 : 31|16@0+ (1,0) [0|6000] "mV" Vector__XXX
 SG_ CSC09_Voltage_U41 m14 : 15|16@0+ (1,0) [0|6000] "mV" Vector__XXX
 SG_ CSC09_Voltage_U40 m13 : 47|16@0+ (1,0) [0|6000] "mV" Vector__XXX
 SG_ CSC09_Voltage_U39 m13 : 31|16@0+ (1,0) [0|6000] "mV" Vector__XXX
 SG_ CSC09_Voltage_U38 m13 : 15|16@0+ (1,0) [0|6000] "mV" Vector__XXX
 SG_ CSC09_Voltage_U37 m12 : 47|16@0+ (1,0) [0|6000] "mV" Vector__XXX
 SG_ CSC09_Voltage_U36 m12 : 31|16@0+ (1,0) [0|6000] "mV" Vector__XXX
 SG_ CSC09_Voltage_U35 m12 : 15|16@0+ (1,0) [0|6000] "mV" Vector__XXX
 SG_ CSC09_Voltage_U34 m11 : 47|16@0+ (1,0) [0|6000] "mV" Vector__XXX
 SG_ CSC09_Voltage_U33 m11 : 31|16@0+ (1,0) [0|6000] "mV" Vector__XXX
 SG_ CSC09_Voltage_U32 m11 : 15|16@0+ (1,0) [0|6000] "mV" Vector__XXX
 SG_ CSC09_Voltage_U31 m10 : 47|16@0+ (1,0) [0|6000] "mV" Vector__XXX
 SG_ CSC09_Voltage_U30 m10 : 31|16@0+ (1,0) [0|6000] "mV" Vector__XXX
 SG_ CSC09_Voltage_U29 m10 : 15|16@0+ (1,0) [0|6000] "mV" Vector__XXX
 SG_ CSC09_Voltage_U28 m9 : 31|16@0+ (1,0) [0|6000] "mV" Vector__XXX
 SG_ CSC09_Voltage_U27 m9 : 15|16@0+ (1,0) [0|6000] "mV" Vector__XXX
 SG_ CSC09_Voltage_U26 m8 : 47|16@0+ (1,0) [0|6000] "mV" Vector__XXX
 SG_ CSC09_Voltage_U25 m8 : 31|16@0+ (1,0) [0|6000] "mV" Vector__XXX
 SG_ CSC09_Voltage_U24 m8 : 15|16@0+ (1,0) [0|6000] "mV" Vector__XXX
 SG_ CSC09_Voltage_U23 m7 : 47|16@0+ (1,0) [0|6000] "mV" Vector__XXX
 SG_ CSC09_Voltage_U22 m7 : 31|16@0+ (1,0) [0|6000] "mV" Vector__XXX
 SG_ CSC09_Voltage_U21 m7 : 15|16@0+ (1,0) [0|6000] "mV" Vector__XXX
 SG_ CSC09_Voltage_U20 m6 : 47|16@0+ (1,0) [0|6000] "mV" Vector__XXX
 SG_ CSC09_Voltage_U19 m6 : 31|16@0+ (1,0) [0|6000] "mV" Vector__XXX
 SG_ CSC09_Voltage_U18 m6 : 15|16@0+ (1,0) [0|6000] "mV" Vector__XXX
 SG_ CSC09_Voltage_U17 m5 : 47|16@0+ (1,0) [0|6000] "mV" Vector__XXX
 SG_ CSC09_Voltage_U16 m5 : 31|16@0+ (1,0) [0|6000] "mV" Vector__XXX
 SG_ CSC09_Voltage_U15 m5 : 15|16@0+ (1,0) [0|6000] "mV" Vector__XXX
 SG_ CSC09_Voltage_U14 m4 : 31|16@0+ (1,0) [0|6000] "mV" Vector__XXX
 SG_ CSC09_Voltage_U13 m4 : 15|16@0+ (1,0) [0|6000] "mV" Vector__XXX
 SG_ CSC09_Voltage_U12 m3 : 47|16@0+ (1,0) [0|6000] "mV" Vector__XXX
 SG_ CSC09_Voltage_U11 m3 : 31|16@0+ (1,0) [0|6000] "mV" Vector__XXX
 SG_ CSC09_Voltage_U10 m3 : 15|16@0+ (1,0) [0|6000] "mV" Vector__XXX
 SG_ CSC09_Voltage_U9 m2 : 47|16@0+ (1,0) [0|6000] "mV" Vector__XXX
 SG_ CSC09_Voltage_U8 m2 : 31|16@0+ (1,0) [0|6000] "mV" Vector__XXX
 SG_ CSC09_Voltage_U7 m2 : 15|16@0+ (1,0) [0|6000] "mV" Vector__XXX
 SG_ CSC09_Voltage_U6 m1 : 47|16@0+ (1,0) [0|6000] "mV" Vector__XXX
 SG_ CSC09_Voltage_U5 m1 : 31|16@0+ (1,0) [0|6000] "mV" Vector__XXX
 SG_ CSC09_Voltage_U4 m1 : 15|16@0+ (1,0) [0|6000] "mV" Vector__XXX
 SG_ CSC09_Voltage_U3 m0 : 47|16@0+ (1,0) [0|6000] "mV" Vector__XXX
 SG_ CSC09_Voltage_U2 m0 : 31|16@0+ (1,0) [0|6000] "mV" Vector__XXX
 SG_ CSC09_Voltage_U1 m0 : 15|16@0+ (1,0) [0|6000] "mV" Vector__XXX
 SG_ CSC09_IndexCell M : 7|8@0+ (1,0) [0|255] "" Vector__XXX

BO_ 2550792192 CSC10_CELL_VOLTS: 8 CSC10
 SG_ CSC10_Voltage_U56 m19 : 31|16@0+ (1,0) [0|6000] "mV" Vector__XXX
 SG_ CSC10_Voltage_U55 m19 : 15|16@0+ (1,0) [0|6000] "mV" Vector__XXX
 SG_ CSC10_Voltage_U54 m18 : 47|16@0+ (1,0) [0|6000] "mV" Vector__XXX
 SG_ CSC10_Voltage_U53 m18 : 31|16@0+ (1,0) [0|6000] "mV" Vector__XXX
 SG_ CSC10_Voltage_U52 m18 : 15|16@0+ (1,0) [0|6000] "mV" Vector__XXX
 SG_ CSC10_Voltage_U51 m17 : 47|16@0+ (1,0) [0|6000] "mV" Vector__XXX
 SG_ CSC10_Voltage_U50 m17 : 31|16@0+ (1,0) [0|6000] "mV" Vector__XXX
 SG_ CSC10_Voltage_U49 m17 : 15|16@0+ (1,0) [0|6000] "mV" Vector__XXX
 SG_ CSC10_Voltage_U48 m16 : 47|16@0+ (1,0) [0|6000] "mV" Vector__XXX
 SG_ CSC10_Voltage_U47 m16 : 31|16@0+ (1,0) [0|6000] "mV" Vector__XXX
 SG_ CSC10_Voltage_U46 m16 : 15|16@0+ (1,0) [0|6000] "mV" Vector__XXX
 SG_ CSC10_Voltage_U45 m15 : 47|16@0+ (1,0) [0|6000] "mV" Vector__XXX
 SG_ CSC10_Voltage_U44 m15 : 31|16@0+ (1,0) [0|6000] "mV" Vector__XXX
 SG_ CSC10_Voltage_U43 m15 : 15|16@0+ (1,0) [0|6000] "mV" Vector__XXX
 SG_ CSC10_Voltage_U42 m14 : 31|16@0+ (1,0) [0|6000] "mV" Vector__XXX
 SG_ CSC10_Voltage_U41 m14 : 15|16@0+ (1,0) [0|6000] "mV" Vector__XXX
 SG_ CSC10_Voltage_U40 m13 : 47|16@0+ (1,0) [0|6000] "mV" Vector__XXX
 SG_ CSC10_Voltage_U39 m13 : 31|16@0+ (1,0) [0|6000] "mV" Vector__XXX
 SG_ CSC10_Voltage_U38 m13 : 15|16@0+ (1,0) [0|6000] "mV" Vector__XXX
 SG_ CSC10_Voltage_U37 m12 : 47|16@0+ (1,0) [0|6000] "mV" Vector__XXX
 SG_ CSC10_Voltage_U36 m12 : 31|16@0+ (1,0) [0|6000] "mV" Vector__XXX
 SG_ CSC10_Voltage_U35 m12 : 15|16@0+ (1,0) [0|6000] "mV" Vector__XXX
 SG_ CSC10_Voltage_U34 m11 : 47|16@0+ (1,0) [0|6000] "mV" Vector__XXX
 SG_ CSC10_Voltage_U33 m11 : 31|16@0+ (1,0) [0|6000] "mV" Vector__XXX
 SG_ CSC10_Voltage_U32 m11 : 15|16@0+ (1,0) [0|6000] "mV" Vector__XXX
 SG_ CSC10_Voltage_U31 m10 : 47|16@0+ (1,0) [0|6000] "mV" Vector__XXX
 SG_ CSC10_Voltage_U30 m10 : 31|16@0+ (1,0) [0|6000] "mV" Vector__XXX
 SG_ CSC10_Voltage_U29 m10 : 15|16@0+ (1,0) [0|6000] "mV" Vector__XXX
 SG_ CSC10_Voltage_U28 m9 : 31|16@0+ (1,0) [0|6000] "mV" Vector__XXX
 SG_ CSC10_Voltage_U27 m9 : 15|16@0+ (1,0) [0|6000] "mV" Vector__XXX
 SG_ CSC10_Voltage_U26 m8 : 47|16@0+ (1,0) [0|6000] "mV" Vector__XXX
 SG_ CSC10_Voltage_U25 m8 : 31|16@0+ (1,0) [0|6000] "mV" Vector__XXX
 SG_ CSC10_Voltage_U24 m8 : 15|16@0+ (1,0) [0|6000] "mV" Vector__XXX
 SG_ CSC10_Voltage_U23 m7 : 47|16@0+ (1,0) [0|6000] "mV" Vector__XXX
 SG_ CSC10_Voltage_U22 m7 : 31|16@0+ (1,0) [0|6000] "mV" Vector__XXX
 SG_ CSC10_Voltage_U21 m7 : 15|16@0+ (1,0) [0|6000] "mV" Vector__XXX
 SG_ CSC10_Voltage_U20 m6 : 47|16@0+ (1,0) [0|6000] "mV" Vector__XXX
 SG_ CSC10_Voltage_U19 m6 : 31|16@0+ (1,0) [0|6000] "mV" Vector__XXX
 SG_ CSC10_Voltage_U18 m6 : 15|16@0+ (1,0) [0|6000] "mV" Vector__XXX
 SG_ CSC10_Voltage_U17 m5 : 47|16@0+ (1,0) [0|6000] "mV" Vector__XXX
 SG_ CSC10_Voltage_U16 m5 : 31|16@0+ (1,0) [0|6000] "mV" Vector__XXX
 SG_ CSC10_Voltage_U15 m5 : 15|16@0+ (1,0) [0|6000] "mV" Vector__XXX
 SG_ CSC10_Voltage_U14 m4 : 31|16@0+ (1,0) [0|6000] "mV" Vector__XXX
 SG_ CSC10_Voltage_U13 m4 : 15|16@0+ (1,0) [0|6000] "mV" Vector__XXX
 SG_ CSC10_Voltage_U12 m3 : 47|16@0+ (1,0) [0|6000] "mV" Vector__XXX
 SG_ CSC10_Voltage_U11 m3 : 31|16@0+ (1,0) [0|6000] "mV" Vector__XXX
 SG_ CSC10_Voltage_U10 m3 : 15|16@0+ (1,0) [0|6000] "mV" Vector__XXX
 SG_ CSC10_Voltage_U9 m2 : 47|16@0+ (1,0) [0|6000] "mV" Vector__XXX
 SG_ CSC10_Voltage_U8 m2 : 31|16@0+ (1,0) [0|6000] "mV" Vector__XXX
 SG_ CSC10_Voltage_U7 m2 : 15|16@0+ (1,0) [0|6000] "mV" Vector__XXX
 SG_ CSC10_Voltage_U6 m1 : 47|16@0+ (1,0) [0|6000] "mV" Vector__XXX
 SG_ CSC10_Voltage_U5 m1 : 31|16@0+ (1,0) [0|6000] "mV" Vector__XXX
 SG_ CSC10_Voltage_U4 m1 : 15|16@0+ (1,0) [0|6000] "mV" Vector__XXX
 SG_ CSC10_Voltage_U3 m0 : 47|16@0+ (1,0) [0|6000] "mV" Vector__XXX
 SG_ CSC10_Voltage_U2 m0 : 31|16@0+ (1,0) [0|6000] "mV" Vector__XXX
 SG_ CSC10_Voltage_U1 m0 : 15|16@0+ (1,0) [0|6000] "mV" Vector__XXX
 SG_ CSC10_IndexCell M : 7|8@0+ (1,0) [0|255] "" Vector__XXX

BO_ 2550857728 CSC11_CELL_VOLTS: 8 CSC11
 SG_ CSC11_Voltage_U56 m19 : 31|16@0+ (1,0) [0|6000] "mV" Vector__XXX
 SG_ CSC11_Voltage_U55 m19 : 15|16@0+ (1,0) [0|6000] "mV" Vector__XXX
 SG_ CSC11_Voltage_U54 m18 : 47|16@0+ (1,0) [0|6000] "mV" Vector__XXX
 SG_ CSC11_Voltage_U53 m18 : 31|16@0+ (1,0) [0|6000] "mV" Vector__XXX
 SG_ CSC11_Voltage_U52 m18 : 15|16@0+ (1,0) [0|6000] "mV" Vector__XXX
 SG_ CSC11_Voltage_U51 m17 : 47|16@0+ (1,0) [0|6000] "mV" Vector__XXX
 SG_ CSC11_Voltage_U50 m17 : 31|16@0+ (1,0) [0|6000] "mV" Vector__XXX
 SG_ CSC11_Voltage_U49 m17 : 15|16@0+ (1,0) [0|6000] "mV" Vector__XXX
 SG_ CSC11_Voltage_U48 m16 : 47|16@0+ (1,0) [0|6000] "mV" Vector__XXX
 SG_ CSC11_Voltage_U47 m16 : 31|16@0+ (1,0) [0|6000] "mV" Vector__XXX
 SG_ CSC11_Voltage_U46 m16 : 15|16@0+ (1,0) [0|6000] "mV" Vector__XXX
 SG_ CSC11_Voltage_U45 m15 : 47|16@0+ (1,0) [0|6000] "mV" Vector__XXX
 SG_ CSC11_Voltage_U44 m15 : 31|16@0+ (1,0) [0|6000] "mV" Vector__XXX
 SG_ CSC11_Voltage_U43 m15 : 15|16@0+ (1,0) [0|6000] "mV" Vector__XXX
 SG_ CSC11_Voltage_U42 m14 : 31|16@0+ (1,0) [0|6000] "mV" Vector__XXX
 SG_ CSC11_Voltage_U41 m14 : 15|16@0+ (1,0) [0|6000] "mV" Vector__XXX
 SG_ CSC11_Voltage_U40 m13 : 47|16@0+ (1,0) [0|6000] "mV" Vector__XXX
 SG_ CSC11_Voltage_U39 m13 : 31|16@0+ (1,0) [0|6000] "mV" Vector__XXX
 SG_ CSC11_Voltage_U38 m13 : 15|16@0+ (1,0) [0|6000] "mV" Vector__XXX
 SG_ CSC11_Voltage_U37 m12 : 47|16@0+ (1,0) [0|6000] "mV" Vector__XXX
 SG_ CSC11_Voltage_U36 m12 : 31|16@0+ (1,0) [0|6000] "mV" Vector__XXX
 SG_ CSC11_Voltage_U35 m12 : 15|16@0+ (1,0) [0|6000] "mV" Vector__XXX
 SG_ CSC11_Voltage_U34 m11 : 47|16@0+ (1,0) [0|6000] "mV" Vector__XXX
 SG_ CSC11_Voltage_U33 m11 : 31|16@0+ (1,0) [0|6000] "mV" Vector__XXX
 SG_ CSC11_Voltage_U32 m11 : 15|16@0+ (1,0) [0|6000] "mV" Vector__XXX
 SG_ CSC11_Voltage_U31 m10 : 47|16@0+ (1,0) [0|6000] "mV" Vector__XXX
 SG_ CSC11_Voltage_U30 m10 : 31|16@0+ (1,0) [0|6000] "mV" Vector__XXX
 SG_ CSC11_Voltage_U29 m10 : 15|16@0+ (1,0) [0|6000] "mV" Vector__XXX
 SG_ CSC11_Voltage_U28 m9 : 31|16@0+ (1,0) [0|6000] "mV" Vector__XXX
 SG_ CSC11_Voltage_U27 m9 : 15|16@0+ (1,0) [0|6000] "mV" Vector__XXX
 SG_ CSC11_Voltage_U26 m8 : 47|16@0+ (1,0) [0|6000] "mV" Vector__XXX
 SG_ CSC11_Voltage_U25 m8 : 31|16@0+ (1,0) [0|6000] "mV" Vector__XXX
 SG_ CSC11_Voltage_U24 m8 : 15|16@0+ (1,0) [0|6000] "mV" Vector__XXX
 SG_ CSC11_Voltage_U23 m7 : 47|16@0+ (1,0) [0|6000] "mV" Vector__XXX
 SG_ CSC11_Voltage_U22 m7 : 31|16@0+ (1,0) [0|6000] "mV" Vector__XXX
 SG_ CSC11_Voltage_U21 m7 : 15|16@0+ (1,0) [0|6000] "mV" Vector__XXX
 SG_ CSC11_Voltage_U20 m6 : 47|16@0+ (1,0) [0|6000] "mV" Vector__XXX
 SG_ CSC11_Voltage_U19 m6 : 31|16@0+ (1,0) [0|6000] "mV" Vector__XXX
 SG_ CSC11_Voltage_U18 m6 : 15|16@0+ (1,0) [0|6000] "mV" Vector__XXX
 SG_ CSC11_Voltage_U17 m5 : 47|16@0+ (1,0) [0|6000] "mV" Vector__XXX
 SG_ CSC11_Voltage_U16 m5 : 31|16@0+ (1,0) [0|6000] "mV" Vector__XXX
 SG_ CSC11_Voltage_U15 m5 : 15|16@0+ (1,0) [0|6000] "mV" Vector__XXX
 SG_ CSC11_Voltage_U14 m4 : 31|16@0+ (1,0) [0|6000] "mV" Vector__XXX
 SG_ CSC11_Voltage_U13 m4 : 15|16@0+ (1,0) [0|6000] "mV" Vector__XXX
 SG_ CSC11_Voltage_U12 m3 : 47|16@0+ (1,0) [0|6000] "mV" Vector__XXX
 SG_ CSC11_Voltage_U11 m3 : 31|16@0+ (1,0) [0|6000] "mV" Vector__XXX
 SG_ CSC11_Voltage_U10 m3 : 15|16@0+ (1,0) [0|6000] "mV" Vector__XXX
 SG_ CSC11_Voltage_U9 m2 : 47|16@0+ (1,0) [0|6000] "mV" Vector__XXX
 SG_ CSC11_Voltage_U8 m2 : 31|16@0+ (1,0) [0|6000] "mV" Vector__XXX
 SG_ CSC11_Voltage_U7 m2 : 15|16@0+ (1,0) [0|6000] "mV" Vector__XXX
 SG_ CSC11_Voltage_U6 m1 : 47|16@0+ (1,0) [0|6000] "mV" Vector__XXX
 SG_ CSC11_Voltage_U5 m1 : 31|16@0+ (1,0) [0|6000] "mV" Vector__XXX
 SG_ CSC11_Voltage_U4 m1 : 15|16@0+ (1,0) [0|6000] "mV" Vector__XXX
 SG_ CSC11_Voltage_U3 m0 : 47|16@0+ (1,0) [0|6000] "mV" Vector__XXX
 SG_ CSC11_Voltage_U2 m0 : 31|16@0+ (1,0) [0|6000] "mV" Vector__XXX
 SG_ CSC11_Voltage_U1 m0 : 15|16@0+ (1,0) [0|6000] "mV" Vector__XXX
 SG_ CSC11_IndexCell M : 7|8@0+ (1,0) [0|255] "" Vector__XXX

BO_ 2550923264 CSC12_CELL_VOLTS: 8 CSC12
 SG_ CSC12_Voltage_U56 m19 : 31|16@0+ (1,0) [0|6000] "mV" Vector__XXX
 SG_ CSC12_Voltage_U55 m19 : 15|16@0+ (1,0) [0|6000] "mV" Vector__XXX
 SG_ CSC12_Voltage_U54 m18 : 47|16@0+ (1,0) [0|6000] "mV" Vector__XXX
 SG_ CSC12_Voltage_U53 m18 : 31|16@0+ (1,0) [0|6000] "mV" Vector__XXX
 SG_ CSC12_Voltage_U52 m18 : 15|16@0+ (1,0) [0|6000] "mV" Vector__XXX
 SG_ CSC12_Voltage_U51 m17 : 47|16@0+ (1,0) [0|6000] "mV" Vector__XXX
 SG_ CSC12_Voltage_U50 m17 : 31|16@0+ (1,0) [0|6000] "mV" Vector__XXX
 SG_ CSC12_Voltage_U49 m17 : 15|16@0+ (1,0) [0|6000] "mV" Vector__XXX
 SG_ CSC12_Voltage_U48 m16 : 47|16@0+ (1,0) [0|6000] "mV" Vector__XXX
 SG_ CSC12_Voltage_U47 m16 : 31|16@0+ (1,0) [0|6000] "mV" Vector__XXX
 SG_ CSC12_Voltage_U46 m16 : 15|16@0+ (1,0) [0|6000] "mV" Vector__XXX
 SG_ CSC12_Voltage_U45 m15 : 47|16@0+ (1,0) [0|6000] "mV" Vector__XXX
 SG_ CSC12_Voltage_U44 m15 : 31|16@0+ (1,0) [0|6000] "mV" Vector__XXX
 SG_ CSC12_Voltage_U43 m15 : 15|16@0+ (1,0) [0|6000] "mV" Vector__XXX
 SG_ CSC12_Voltage_U42 m14 : 31|16@0+ (1,0) [0|6000] "mV" Vector__XXX
 SG_ CSC12_Voltage_U41 m14 : 15|16@0+ (1,0) [0|6000] "mV" Vector__XXX
 SG_ CSC12_Voltage_U40 m13 : 47|16@0+ (1,0) [0|6000] "mV" Vector__XXX
 SG_ CSC12_Voltage_U39 m13 : 31|16@0+ (1,0) [0|6000] "mV" Vector__XXX
 SG_ CSC12_Voltage_U38 m13 : 15|16@0+ (1,0) [0|6000] "mV" Vector__XXX
 SG_ CSC12_Voltage_U37 m12 : 47|16@0+ (1,0) [0|6000] "mV" Vector__XXX
 SG_ CSC12_Voltage_U36 m12 : 31|16@0+ (1,0) [0|6000] "mV" Vector__XXX
 SG_ CSC12_Voltage_U35 m12 : 15|16@0+ (1,0) [0|6000] "mV" Vector__XXX
 SG_ CSC12_Voltage_U34 m11 : 47|16@0+ (1,0) [0|6000] "mV" Vector__XXX
 SG_ CSC12_Voltage_U33 m11 : 31|16@0+ (1,0) [0|6000] "mV" Vector__XXX
 SG_ CSC12_Voltage_U32 m11 : 15|16@0+ (1,0) [0|6000] "mV" Vector__XXX
 SG_ CSC12_Voltage_U31 m10 : 47|16@0+ (1,0) [0|6000] "mV" Vector__XXX
 SG_ CSC12_Voltage_U30 m10 : 31|16@0+ (1,0) [0|6000] "mV" Vector__XXX
 SG_ CSC12_Voltage_U29 m10 : 15|16@0+ (1,0) [0|6000] "mV" Vector__XXX
 SG_ CSC12_Voltage_U28 m9 : 31|16@0+ (1,0) [0|6000] "mV" Vector__XXX
 SG_ CSC12_Voltage_U27 m9 : 15|16@0+ (1,0) [0|6000] "mV" Vector__XXX
 SG_ CSC12_Voltage_U26 m8 : 47|16@0+ (1,0) [0|6000] "mV" Vector__XXX
 SG_ CSC12_Voltage_U25 m8 : 31|16@0+ (1,0) [0|6000] "mV" Vector__XXX
 SG_ CSC12_Voltage_U24 m8 : 15|16@0+ (1,0) [0|6000] "mV" Vector__XXX
 SG_ CSC12_Voltage_U23 m7 : 47|16@0+ (1,0) [0|6000] "mV" Vector__XXX
 SG_ CSC12_Voltage_U22 m7 : 31|16@0+ (1,0) [0|6000] "mV" Vector__XXX
 SG_ CSC12_Voltage_U21 m7 : 15|16@0+ (1,0) [0|6000] "mV" Vector__XXX
 SG_ CSC12_Voltage_U20 m6 : 47|16@0+ (1,0) [0|6000] "mV" Vector__XXX
 SG_ CSC12_Voltage_U19 m6 : 31|16@0+ (1,0) [0|6000] "mV" Vector__XXX
 SG_ CSC12_Voltage_U18 m6 : 15|16@0+ (1,0) [0|6000] "mV" Vector__XXX
 SG_ CSC12_Voltage_U17 m5 : 47|16@0+ (1,0) [0|6000] "mV" Vector__XXX
 SG_ CSC12_Voltage_U16 m5 : 31|16@0+ (1,0) [0|6000] "mV" Vector__XXX
 SG_ CSC12_Voltage_U15 m5 : 15|16@0+ (1,0) [0|6000] "mV" Vector__XXX
 SG_ CSC12_Voltage_U14 m4 : 31|16@0+ (1,0) [0|6000] "mV" Vector__XXX
 SG_ CSC12_Voltage_U13 m4 : 15|16@0+ (1,0) [0|6000] "mV" Vector__XXX
 SG_ CSC12_Voltage_U12 m3 : 47|16@0+ (1,0) [0|6000] "mV" Vector__XXX
 SG_ CSC12_Voltage_U11 m3 : 31|16@0+ (1,0) [0|6000] "mV" Vector__XXX
 SG_ CSC12_Voltage_U10 m3 : 15|16@0+ (1,0) [0|6000] "mV" Vector__XXX
 SG_ CSC12_Voltage_U9 m2 : 47|16@0+ (1,0) [0|6000] "mV" Vector__XXX
 SG_ CSC12_Voltage_U8 m2 : 31|16@0+ (1,0) [0|6000] "mV" Vector__XXX
 SG_ CSC12_Voltage_U7 m2 : 15|16@0+ (1,0) [0|6000] "mV" Vector__XXX
 SG_ CSC12_Voltage_U6 m1 : 47|16@0+ (1,0) [0|6000] "mV" Vector__XXX
 SG_ CSC12_Voltage_U5 m1 : 31|16@0+ (1,0) [0|6000] "mV" Vector__XXX
 SG_ CSC12_Voltage_U4 m1 : 15|16@0+ (1,0) [0|6000] "mV" Vector__XXX
 SG_ CSC12_Voltage_U3 m0 : 47|16@0+ (1,0) [0|6000] "mV" Vector__XXX
 SG_ CSC12_Voltage_U2 m0 : 31|16@0+ (1,0) [0|6000] "mV" Vector__XXX
 SG_ CSC12_Voltage_U1 m0 : 15|16@0+ (1,0) [0|6000] "mV" Vector__XXX
 SG_ CSC12_IndexCell M : 7|8@0+ (1,0) [0|255] "" Vector__XXX

BO_ 2550988800 CSC13_CELL_VOLTS: 8 CSC13
 SG_ CSC13_Voltage_U56 m19 : 31|16@0+ (1,0) [0|6000] "mV" Vector__XXX
 SG_ CSC13_Voltage_U55 m19 : 15|16@0+ (1,0) [0|6000] "mV" Vector__XXX
 SG_ CSC13_Voltage_U54 m18 : 47|16@0+ (1,0) [0|6000] "mV" Vector__XXX
 SG_ CSC13_Voltage_U53 m18 : 31|16@0+ (1,0) [0|6000] "mV" Vector__XXX
 SG_ CSC13_Voltage_U52 m18 : 15|16@0+ (1,0) [0|6000] "mV" Vector__XXX
 SG_ CSC13_Voltage_U51 m17 : 47|16@0+ (1,0) [0|6000] "mV" Vector__XXX
 SG_ CSC13_Voltage_U50 m17 : 31|16@0+ (1,0) [0|6000] "mV" Vector__XXX
 SG_ CSC13_Voltage_U49 m17 : 15|16@0+ (1,0) [0|6000] "mV" Vector__XXX
 SG_ CSC13_Voltage_U48 m16 : 47|16@0+ (1,0) [0|6000] "mV" Vector__XXX
 SG_ CSC13_Voltage_U47 m16 : 31|16@0+ (1,0) [0|6000] "mV" Vector__XXX
 SG_ CSC13_Voltage_U46 m16 : 15|16@0+ (1,0) [0|6000] "mV" Vector__XXX
 SG_ CSC13_Voltage_U45 m15 : 47|16@0+ (1,0) [0|6000] "mV" Vector__XXX
 SG_ CSC13_Voltage_U44 m15 : 31|16@0+ (1,0) [0|6000] "mV" Vector__XXX
 SG_ CSC13_Voltage_U43 m15 : 15|16@0+ (1,0) [0|6000] "mV" Vector__XXX
 SG_ CSC13_Voltage_U42 m14 : 31|16@0+ (1,0) [0|6000] "mV" Vector__XXX
 SG_ CSC13_Voltage_U41 m14 : 15|16@0+ (1,0) [0|6000] "mV" Vector__XXX
 SG_ CSC13_Voltage_U40 m13 : 47|16@0+ (1,0) [0|6000] "mV" Vector__XXX
 SG_ CSC13_Voltage_U39 m13 : 31|16@0+ (1,0) [0|6000] "mV" Vector__XXX
 SG_ CSC13_Voltage_U38 m13 : 15|16@0+ (1,0) [0|6000] "mV" Vector__XXX
 SG_ CSC13_Voltage_U37 m12 : 47|16@0+ (1,0) [0|6000] "mV" Vector__XXX
 SG_ CSC13_Voltage_U36 m12 : 31|16@0+ (1,0) [0|6000] "mV" Vector__XXX
 SG_ CSC13_Voltage_U35 m12 : 15|16@0+ (1,0) [0|6000] "mV" Vector__XXX
 SG_ CSC13_Voltage_U34 m11 : 47|16@0+ (1,0) [0|6000] "mV" Vector__XXX
 SG_ CSC13_Voltage_U33 m11 : 31|16@0+ (1,0) [0|6000] "mV" Vector__XXX
 SG_ CSC13_Voltage_U32 m11 : 15|16@0+ (1,0) [0|6000] "mV" Vector__XXX
 SG_ CSC13_Voltage_U31 m10 : 47|16@0+ (1,0) [0|6000] "mV" Vector__XXX
 SG_ CSC13_Voltage_U30 m10 : 31|16@0+ (1,0) [0|6000] "mV" Vector__XXX
 SG_ CSC13_Voltage_U29 m10 : 15|16@0+ (1,0) [0|6000] "mV" Vector__XXX
 SG_ CSC13_Voltage_U28 m9 : 31|16@0+ (1,0) [0|6000] "mV" Vector__XXX
 SG_ CSC13_Voltage_U27 m9 : 15|16@0+ (1,0) [0|6000] "mV" Vector__XXX
 SG_ CSC13_Voltage_U26 m8 : 47|16@0+ (1,0) [0|6000] "mV" Vector__XXX
 SG_ CSC13_Voltage_U25 m8 : 31|16@0+ (1,0) [0|6000] "mV" Vector__XXX
 SG_ CSC13_Voltage_U24 m8 : 15|16@0+ (1,0) [0|6000] "mV" Vector__XXX
 SG_ CSC13_Voltage_U23 m7 : 47|16@0+ (1,0) [0|6000] "mV" Vector__XXX
 SG_ CSC13_Voltage_U22 m7 : 31|16@0+ (1,0) [0|6000] "mV" Vector__XXX
 SG_ CSC13_Voltage_U21 m7 : 15|16@0+ (1,0) [0|6000] "mV" Vector__XXX
 SG_ CSC13_Voltage_U20 m6 : 47|16@0+ (1,0) [0|6000] "mV" Vector__XXX
 SG_ CSC13_Voltage_U19 m6 : 31|16@0+ (1,0) [0|6000] "mV" Vector__XXX
 SG_ CSC13_Voltage_U18 m6 : 15|16@0+ (1,0) [0|6000] "mV" Vector__XXX
 SG_ CSC13_Voltage_U17 m5 : 47|16@0+ (1,0) [0|6000] "mV" Vector__XXX
 SG_ CSC13_Voltage_U16 m5 : 31|16@0+ (1,0) [0|6000] "mV" Vector__XXX
 SG_ CSC13_Voltage_U15 m5 : 15|16@0+ (1,0) [0|6000] "mV" Vector__XXX
 SG_ CSC13_Voltage_U14 m4 : 31|16@0+ (1,0) [0|6000] "mV" Vector__XXX
 SG_ CSC13_Voltage_U13 m4 : 15|16@0+ (1,0) [0|6000] "mV" Vector__XXX
 SG_ CSC13_Voltage_U12 m3 : 47|16@0+ (1,0) [0|6000] "mV" Vector__XXX
 SG_ CSC13_Voltage_U11 m3 : 31|16@0+ (1,0) [0|6000] "mV" Vector__XXX
 SG_ CSC13_Voltage_U10 m3 : 15|16@0+ (1,0) [0|6000] "mV" Vector__XXX
 SG_ CSC13_Voltage_U9 m2 : 47|16@0+ (1,0) [0|6000] "mV" Vector__XXX
 SG_ CSC13_Voltage_U8 m2 : 31|16@0+ (1,0) [0|6000] "mV" Vector__XXX
 SG_ CSC13_Voltage_U7 m2 : 15|16@0+ (1,0) [0|6000] "mV" Vector__XXX
 SG_ CSC13_Voltage_U6 m1 : 47|16@0+ (1,0) [0|6000] "mV" Vector__XXX
 SG_ CSC13_Voltage_U5 m1 : 31|16@0+ (1,0) [0|6000] "mV" Vector__XXX
 SG_ CSC13_Voltage_U4 m1 : 15|16@0+ (1,0) [0|6000] "mV" Vector__XXX
 SG_ CSC13_Voltage_U3 m0 : 47|16@0+ (1,0) [0|6000] "mV" Vector__XXX
 SG_ CSC13_Voltage_U2 m0 : 31|16@0+ (1,0) [0|6000] "mV" Vector__XXX
 SG_ CSC13_Voltage_U1 m0 : 15|16@0+ (1,0) [0|6000] "mV" Vector__XXX
 SG_ CSC13_IndexCell M : 7|8@0+ (1,0) [0|255] "" Vector__XXX

BO_ 2551054336 CSC14_CELL_VOLTS: 8 CSC14
 SG_ CSC14_Voltage_U56 m19 : 31|16@0+ (1,0) [0|6000] "mV" Vector__XXX
 SG_ CSC14_Voltage_U55 m19 : 15|16@0+ (1,0) [0|6000] "mV" Vector__XXX
 SG_ CSC14_Voltage_U54 m18 : 47|16@0+ (1,0) [0|6000] "mV" Vector__XXX
 SG_ CSC14_Voltage_U53 m18 : 31|16@0+ (1,0) [0|6000] "mV" Vector__XXX
 SG_ CSC14_Voltage_U52 m18 : 15|16@0+ (1,0) [0|6000] "mV" Vector__XXX
 SG_ CSC14_Voltage_U51 m17 : 47|16@0+ (1,0) [0|6000] "mV" Vector__XXX
 SG_ CSC14_Voltage_U50 m17 : 31|16@0+ (1,0) [0|6000] "mV" Vector__XXX
 SG_ CSC14_Voltage_U49 m17 : 15|16@0+ (1,0) [0|6000] "mV" Vector__XXX
 SG_ CSC14_Voltage_U48 m16 : 47|16@0+ (1,0) [0|6000] "mV" Vector__XXX
 SG_ CSC14_Voltage_U47 m16 : 31|16@0+ (1,0) [0|6000] "mV" Vector__XXX
 SG_ CSC14_Voltage_U46 m16 : 15|16@0+ (1,0) [0|6000] "mV" Vector__XXX
 SG_ CSC14_Voltage_U45 m15 : 47|16@0+ (1,0) [0|6000] "mV" Vector__XXX
 SG_ CSC14_Voltage_U44 m15 : 31|16@0+ (1,0) [0|6000] "mV" Vector__XXX
 SG_ CSC14_Voltage_U43 m15 : 15|16@0+ (1,0) [0|6000] "mV" Vector__XXX
 SG_ CSC14_Voltage_U42 m14 : 31|16@0+ (1,0) [0|6000] "mV" Vector__XXX
 SG_ CSC14_Voltage_U41 m14 : 15|16@0+ (1,0) [0|6000] "mV" Vector__XXX
 SG_ CSC14_Voltage_U40 m13 : 47|16@0+ (1,0) [0|6000] "mV" Vector__XXX
 SG_ CSC14_Voltage_U39 m13 : 31|16@0+ (1,0) [0|6000] "mV" Vector__XXX
 SG_ CSC14_Voltage_U38 m13 : 15|16@0+ (1,0) [0|6000] "mV" Vector__XXX
 SG_ CSC14_Voltage_U37 m12 : 47|16@0+ (1,0) [0|6000] "mV" Vector__XXX
 SG_ CSC14_Voltage_U36 m12 : 31|16@0+ (1,0) [0|6000] "mV" Vector__XXX
 SG_ CSC14_Voltage_U35 m12 : 15|16@0+ (1,0) [0|6000] "mV" Vector__XXX
 SG_ CSC14_Voltage_U34 m11 : 47|16@0+ (1,0) [0|6000] "mV" Vector__XXX
 SG_ CSC14_Voltage_U33 m11 : 31|16@0+ (1,0) [0|6000] "mV" Vector__XXX
 SG_ CSC14_Voltage_U32 m11 : 15|16@0+ (1,0) [0|6000] "mV" Vector__XXX
 SG_ CSC14_Voltage_U31 m10 : 47|16@0+ (1,0) [0|6000] "mV" Vector__XXX
 SG_ CSC14_Voltage_U30 m10 : 31|16@0+ (1,0) [0|6000] "mV" Vector__XXX
 SG_ CSC14_Voltage_U29 m10 : 15|16@0+ (1,0) [0|6000] "mV" Vector__XXX
 SG_ CSC14_Voltage_U28 m9 : 31|16@0+ (1,0) [0|6000] "mV" Vector__XXX
 SG_ CSC14_Voltage_U27 m9 : 15|16@0+ (1,0) [0|6000] "mV" Vector__XXX
 SG_ CSC14_Voltage_U26 m8 : 47|16@0+ (1,0) [0|6000] "mV" Vector__XXX
 SG_ CSC14_Voltage_U25 m8 : 31|16@0+ (1,0) [0|6000] "mV" Vector__XXX
 SG_ CSC14_Voltage_U24 m8 : 15|16@0+ (1,0) [0|6000] "mV" Vector__XXX
 SG_ CSC14_Voltage_U23 m7 : 47|16@0+ (1,0) [0|6000] "mV" Vector__XXX
 SG_ CSC14_Voltage_U22 m7 : 31|16@0+ (1,0) [0|6000] "mV" Vector__XXX
 SG_ CSC14_Voltage_U21 m7 : 15|16@0+ (1,0) [0|6000] "mV" Vector__XXX
 SG_ CSC14_Voltage_U20 m6 : 47|16@0+ (1,0) [0|6000] "mV" Vector__XXX
 SG_ CSC14_Voltage_U19 m6 : 31|16@0+ (1,0) [0|6000] "mV" Vector__XXX
 SG_ CSC14_Voltage_U18 m6 : 15|16@0+ (1,0) [0|6000] "mV" Vector__XXX
 SG_ CSC14_Voltage_U17 m5 : 47|16@0+ (1,0) [0|6000] "mV" Vector__XXX
 SG_ CSC14_Voltage_U16 m5 : 31|16@0+ (1,0) [0|6000] "mV" Vector__XXX
 SG_ CSC14_Voltage_U15 m5 : 15|16@0+ (1,0) [0|6000] "mV" Vector__XXX
 SG_ CSC14_Voltage_U14 m4 : 31|16@0+ (1,0) [0|6000] "mV" Vector__XXX
 SG_ CSC14_Voltage_U13 m4 : 15|16@0+ (1,0) [0|6000] "mV" Vector__XXX
 SG_ CSC14_Voltage_U12 m3 : 47|16@0+ (1,0) [0|6000] "mV" Vector__XXX
 SG_ CSC14_Voltage_U11 m3 : 31|16@0+ (1,0) [0|6000] "mV" Vector__XXX
 SG_ CSC14_Voltage_U10 m3 : 15|16@0+ (1,0) [0|6000] "mV" Vector__XXX
 SG_ CSC14_Voltage_U9 m2 : 47|16@0+ (1,0) [0|6000] "mV" Vector__XXX
 SG_ CSC14_Voltage_U8 m2 : 31|16@0+ (1,0) [0|6000] "mV" Vector__XXX
 SG_ CSC14_Voltage_U7 m2 : 15|16@0+ (1,0) [0|6000] "mV" Vector__XXX
 SG_ CSC14_Voltage_U6 m1 : 47|16@0+ (1,0) [0|6000] "mV" Vector__XXX
 SG_ CSC14_Voltage_U5 m1 : 31|16@0+ (1,0) [0|6000] "mV" Vector__XXX
 SG_ CSC14_Voltage_U4 m1 : 15|16@0+ (1,0) [0|6000] "mV" Vector__XXX
 SG_ CSC14_Voltage_U3 m0 : 47|16@0+ (1,0) [0|6000] "mV" Vector__XXX
 SG_ CSC14_Voltage_U2 m0 : 31|16@0+ (1,0) [0|6000] "mV" Vector__XXX
 SG_ CSC14_Voltage_U1 m0 : 15|16@0+ (1,0) [0|6000] "mV" Vector__XXX
 SG_ CSC14_IndexCell M : 7|8@0+ (1,0) [0|255] "" Vector__XXX

BO_ 2551119872 CSC15_CELL_VOLTS: 8 CSC15
 SG_ CSC15_Voltage_U56 m19 : 31|16@0+ (1,0) [0|6000] "mV" Vector__XXX
 SG_ CSC15_Voltage_U55 m19 : 15|16@0+ (1,0) [0|6000] "mV" Vector__XXX
 SG_ CSC15_Voltage_U54 m18 : 47|16@0+ (1,0) [0|6000] "mV" Vector__XXX
 SG_ CSC15_Voltage_U53 m18 : 31|16@0+ (1,0) [0|6000] "mV" Vector__XXX
 SG_ CSC15_Voltage_U52 m18 : 15|16@0+ (1,0) [0|6000] "mV" Vector__XXX
 SG_ CSC15_Voltage_U51 m17 : 47|16@0+ (1,0) [0|6000] "mV" Vector__XXX
 SG_ CSC15_Voltage_U50 m17 : 31|16@0+ (1,0) [0|6000] "mV" Vector__XXX
 SG_ CSC15_Voltage_U49 m17 : 15|16@0+ (1,0) [0|6000] "mV" Vector__XXX
 SG_ CSC15_Voltage_U48 m16 : 47|16@0+ (1,0) [0|6000] "mV" Vector__XXX
 SG_ CSC15_Voltage_U47 m16 : 31|16@0+ (1,0) [0|6000] "mV" Vector__XXX
 SG_ CSC15_Voltage_U46 m16 : 15|16@0+ (1,0) [0|6000] "mV" Vector__XXX
 SG_ CSC15_Voltage_U45 m15 : 47|16@0+ (1,0) [0|6000] "mV" Vector__XXX
 SG_ CSC15_Voltage_U44 m15 : 31|16@0+ (1,0) [0|6000] "mV" Vector__XXX
 SG_ CSC15_Voltage_U43 m15 : 15|16@0+ (1,0) [0|6000] "mV" Vector__XXX
 SG_ CSC15_Voltage_U42 m14 : 31|16@0+ (1,0) [0|6000] "mV" Vector__XXX
 SG_ CSC15_Voltage_U41 m14 : 15|16@0+ (1,0) [0|6000] "mV" Vector__XXX
 SG_ CSC15_Voltage_U40 m13 : 47|16@0+ (1,0) [0|6000] "mV" Vector__XXX
 SG_ CSC15_Voltage_U39 m13 : 31|16@0+ (1,0) [0|6000] "mV" Vector__XXX
 SG_ CSC15_Voltage_U38 m13 : 15|16@0+ (1,0) [0|6000] "mV" Vector__XXX
 SG_ CSC15_Voltage_U37 m12 : 47|16@0+ (1,0) [0|6000] "mV" Vector__XXX
 SG_ CSC15_Voltage_U36 m12 : 31|16@0+ (1,0) [0|6000] "mV" Vector__XXX
 SG_ CSC15_Voltage_U35 m12 : 15|16@0+ (1,0) [0|6000] "mV" Vector__XXX
 SG_ CSC15_Voltage_U34 m11 : 47|16@0+ (1,0) [0|6000] "mV" Vector__XXX
 SG_ CSC15_Voltage_U33 m11 : 31|16@0+ (1,0) [0|6000] "mV" Vector__XXX
 SG_ CSC15_Voltage_U32 m11 : 15|16@0+ (1,0) [0|6000] "mV" Vector__XXX
 SG_ CSC15_Voltage_U31 m10 : 47|16@0+ (1,0) [0|6000] "mV" Vector__XXX
 SG_ CSC15_Voltage_U30 m10 : 31|16@0+ (1,0) [0|6000] "mV" Vector__XXX
 SG_ CSC15_Voltage_U29 m10 : 15|16@0+ (1,0) [0|6000] "mV" Vector__XXX
 SG_ CSC15_Voltage_U28 m9 : 31|16@0+ (1,0) [0|6000] "mV" Vector__XXX
 SG_ CSC15_Voltage_U27 m9 : 15|16@0+ (1,0) [0|6000] "mV" Vector__XXX
 SG_ CSC15_Voltage_U26 m8 : 47|16@0+ (1,0) [0|6000] "mV" Vector__XXX
 SG_ CSC15_Voltage_U25 m8 : 31|16@0+ (1,0) [0|6000] "mV" Vector__XXX
 SG_ CSC15_Voltage_U24 m8 : 15|16@0+ (1,0) [0|6000] "mV" Vector__XXX
 SG_ CSC15_Voltage_U23 m7 : 47|16@0+ (1,0) [0|6000] "mV" Vector__XXX
 SG_ CSC15_Voltage_U22 m7 : 31|16@0+ (1,0) [0|6000] "mV" Vector__XXX
 SG_ CSC15_Voltage_U21 m7 : 15|16@0+ (1,0) [0|6000] "mV" Vector__XXX
 SG_ CSC15_Voltage_U20 m6 : 47|16@0+ (1,0) [0|6000] "mV" Vector__XXX
 SG_ CSC15_Voltage_U19 m6 : 31|16@0+ (1,0) [0|6000] "mV" Vector__XXX
 SG_ CSC15_Voltage_U18 m6 : 15|16@0+ (1,0) [0|6000] "mV" Vector__XXX
 SG_ CSC15_Voltage_U17 m5 : 47|16@0+ (1,0) [0|6000] "mV" Vector__XXX
 SG_ CSC15_Voltage_U16 m5 : 31|16@0+ (1,0) [0|6000] "mV" Vector__XXX
 SG_ CSC15_Voltage_U15 m5 : 15|16@0+ (1,0) [0|6000] "mV" Vector__XXX
 SG_ CSC15_Voltage_U14 m4 : 31|16@0+ (1,0) [0|6000] "mV" Vector__XXX
 SG_ CSC15_Voltage_U13 m4 : 15|16@0+ (1,0) [0|6000] "mV" Vector__XXX
 SG_ CSC15_Voltage_U12 m3 : 47|16@0+ (1,0) [0|6000] "mV" Vector__XXX
 SG_ CSC15_Voltage_U11 m3 : 31|16@0+ (1,0) [0|6000] "mV" Vector__XXX
 SG_ CSC15_Voltage_U10 m3 : 15|16@0+ (1,0) [0|6000] "mV" Vector__XXX
 SG_ CSC15_Voltage_U9 m2 : 47|16@0+ (1,0) [0|6000] "mV" Vector__XXX
 SG_ CSC15_Voltage_U8 m2 : 31|16@0+ (1,0) [0|6000] "mV" Vector__XXX
 SG_ CSC15_Voltage_U7 m2 : 15|16@0+ (1,0) [0|6000] "mV" Vector__XXX
 SG_ CSC15_Voltage_U6 m1 : 47|16@0+ (1,0) [0|6000] "mV" Vector__XXX
 SG_ CSC15_Voltage_U5 m1 : 31|16@0+ (1,0) [0|6000] "mV" Vector__XXX
 SG_ CSC15_Voltage_U4 m1 : 15|16@0+ (1,0) [0|6000] "mV" Vector__XXX
 SG_ CSC15_Voltage_U3 m0 : 47|16@0+ (1,0) [0|6000] "mV" Vector__XXX
 SG_ CSC15_Voltage_U2 m0 : 31|16@0+ (1,0) [0|6000] "mV" Vector__XXX
 SG_ CSC15_Voltage_U1 m0 : 15|16@0+ (1,0) [0|6000] "mV" Vector__XXX
 SG_ CSC15_IndexCell M : 7|8@0+ (1,0) [0|255] "" Vector__XXX

BO_ 2550202369 CSC01_CELL_TEMPS: 8 CSC01
 SG_ IC4_PCB_Temperatures m7 : 15|8@0+ (1,-40) [-40|215] "degC" Vector__XXX
 SG_ IC4_InternalTemperature m7 : 23|8@0+ (1,-40) [-40|215] "degC" Vector__XXX
 SG_ IC4_PackTemperatures_1 m6 : 15|8@0+ (1,-40) [-40|215] "degC" Vector__XXX
 SG_ IC4_PackTemperatures_2 m6 : 23|8@0+ (1,-40) [-40|215] "degC" Vector__XXX
 SG_ IC4_PackTemperatures_3 m6 : 31|8@0+ (1,-40) [-40|215] "degC" Vector__XXX
 SG_ IC4_PackTemperatures_4 m6 : 39|8@0+ (1,-40) [-40|215] "degC" Vector__XXX
 SG_ IC4_PackTemperatures_5 m6 : 47|8@0+ (1,-40) [-40|215] "degC" Vector__XXX
 SG_ IC4_PackTemperatures_6 m6 : 55|8@0+ (1,-40) [-40|215] "degC" Vector__XXX
 SG_ IC3_PCB_Temperatures m5 : 15|8@0+ (1,-40) [-40|215] "degC" Vector__XXX
 SG_ IC3_InternalTemperature m5 : 23|8@0+ (1,-40) [-40|215] "degC" Vector__XXX
 SG_ IC3_PackTemperatures_1 m4 : 15|8@0+ (1,-40) [-40|215] "degC" Vector__XXX
 SG_ IC3_PackTemperatures_2 m4 : 23|8@0+ (1,-40) [-40|215] "degC" Vector__XXX
 SG_ IC3_PackTemperatures_3 m4 : 31|8@0+ (1,-40) [-40|215] "degC" Vector__XXX
 SG_ IC3_PackTemperatures_4 m4 : 39|8@0+ (1,-40) [-40|215] "degC" Vector__XXX
 SG_ IC3_PackTemperatures_5 m4 : 47|8@0+ (1,-40) [-40|215] "degC" Vector__XXX
 SG_ IC3_PackTemperatures_6 m4 : 55|8@0+ (1,-40) [-40|215] "degC" Vector__XXX
 SG_ IC2_PCB_Temperatures m3 : 15|8@0+ (1,-40) [-40|215] "degC" Vector__XXX
 SG_ IC2_InternalTemperature m3 : 23|8@0+ (1,-40) [-40|215] "degC" Vector__XXX
 SG_ IC2_PackTemperatures_1 m2 : 15|8@0+ (1,-40) [-40|215] "degC" Vector__XXX
 SG_ IC2_PackTemperatures_2 m2 : 23|8@0+ (1,-40) [-40|215] "degC" Vector__XXX
 SG_ IC2_PackTemperatures_3 m2 : 31|8@0+ (1,-40) [-40|215] "degC" Vector__XXX
 SG_ IC2_PackTemperatures_4 m2 : 39|8@0+ (1,-40) [-40|215] "degC" Vector__XXX
 SG_ IC2_PackTemperatures_5 m2 : 47|8@0+ (1,-40) [-40|215] "degC" Vector__XXX
 SG_ IC2_PackTemperatures_6 m2 : 55|8@0+ (1,-40) [-40|215] "degC" Vector__XXX
 SG_ IC1_PCB_Temperatures m1 : 15|8@0+ (1,-40) [-40|215] "degC" Vector__XXX
 SG_ IC1_InternalTemperature m1 : 23|8@0+ (1,-40) [-40|215] "degC" Vector__XXX
 SG_ IC1_PackTemperatures_1 m0 : 15|8@0+ (1,-40) [-40|215] "degC" Vector__XXX
 SG_ IC1_PackTemperatures_2 m0 : 23|8@0+ (1,-40) [-40|215] "degC" Vector__XXX
 SG_ IC1_PackTemperatures_3 m0 : 31|8@0+ (1,-40) [-40|215] "degC" Vector__XXX
 SG_ IC1_PackTemperatures_4 m0 : 39|8@0+ (1,-40) [-40|215] "degC" Vector__XXX
 SG_ IC1_PackTemperatures_5 m0 : 47|8@0+ (1,-40) [-40|215] "degC" Vector__XXX
 SG_ IC1_PackTemperatures_6 m0 : 55|8@0+ (1,-40) [-40|215] "degC" Vector__XXX
 SG_ CSC01_IndexTemps M : 7|8@0+ (1,0) [0|255] "" Vector__XXX

BO_ 2550267905 CSC02_CELL_TEMPS: 8 CSC02
 SG_ IC4_PCB_Temperatures m7 : 15|8@0+ (1,-40) [-40|215] "degC" Vector__XXX
 SG_ IC4_InternalTemperature m7 : 23|8@0+ (1,-40) [-40|215] "degC" Vector__XXX
 SG_ IC4_PackTemperatures_1 m6 : 15|8@0+ (1,-40) [-40|215] "degC" Vector__XXX
 SG_ IC4_PackTemperatures_2 m6 : 23|8@0+ (1,-40) [-40|215] "degC" Vector__XXX
 SG_ IC4_PackTemperatures_3 m6 : 31|8@0+ (1,-40) [-40|215] "degC" Vector__XXX
 SG_ IC4_PackTemperatures_4 m6 : 39|8@0+ (1,-40) [-40|215] "degC" Vector__XXX
 SG_ IC4_PackTemperatures_5 m6 : 47|8@0+ (1,-40) [-40|215] "degC" Vector__XXX
 SG_ IC4_PackTemperatures_6 m6 : 55|8@0+ (1,-40) [-40|215] "degC" Vector__XXX
 SG_ IC3_PCB_Temperatures m5 : 15|8@0+ (1,-40) [-40|215] "degC" Vector__XXX
 SG_ IC3_InternalTemperature m5 : 23|8@0+ (1,-40) [-40|215] "degC" Vector__XXX
 SG_ IC3_PackTemperatures_1 m4 : 15|8@0+ (1,-40) [-40|215] "degC" Vector__XXX
 SG_ IC3_PackTemperatures_2 m4 : 23|8@0+ (1,-40) [-40|215] "degC" Vector__XXX
 SG_ IC3_PackTemperatures_3 m4 : 31|8@0+ (1,-40) [-40|215] "degC" Vector__XXX
 SG_ IC3_PackTemperatures_4 m4 : 39|8@0+ (1,-40) [-40|215] "degC" Vector__XXX
 SG_ IC3_PackTemperatures_5 m4 : 47|8@0+ (1,-40) [-40|215] "degC" Vector__XXX
 SG_ IC3_PackTemperatures_6 m4 : 55|8@0+ (1,-40) [-40|215] "degC" Vector__XXX
 SG_ IC2_PCB_Temperatures m3 : 15|8@0+ (1,-40) [-40|215] "degC" Vector__XXX
 SG_ IC2_InternalTemperature m3 : 23|8@0+ (1,-40) [-40|215] "degC" Vector__XXX
 SG_ IC2_PackTemperatures_1 m2 : 15|8@0+ (1,-40) [-40|215] "degC" Vector__XXX
 SG_ IC2_PackTemperatures_2 m2 : 23|8@0+ (1,-40) [-40|215] "degC" Vector__XXX
 SG_ IC2_PackTemperatures_3 m2 : 31|8@0+ (1,-40) [-40|215] "degC" Vector__XXX
 SG_ IC2_PackTemperatures_4 m2 : 39|8@0+ (1,-40) [-40|215] "degC" Vector__XXX
 SG_ IC2_PackTemperatures_5 m2 : 47|8@0+ (1,-40) [-40|215] "degC" Vector__XXX
 SG_ IC2_PackTemperatures_6 m2 : 55|8@0+ (1,-40) [-40|215] "degC" Vector__XXX
 SG_ IC1_PCB_Temperatures m1 : 15|8@0+ (1,-40) [-40|215] "degC" Vector__XXX
 SG_ IC1_InternalTemperature m1 : 23|8@0+ (1,-40) [-40|215] "degC" Vector__XXX
 SG_ IC1_PackTemperatures_1 m0 : 15|8@0+ (1,-40) [-40|215] "degC" Vector__XXX
 SG_ IC1_PackTemperatures_2 m0 : 23|8@0+ (1,-40) [-40|215] "degC" Vector__XXX
 SG_ IC1_PackTemperatures_3 m0 : 31|8@0+ (1,-40) [-40|215] "degC" Vector__XXX
 SG_ IC1_PackTemperatures_4 m0 : 39|8@0+ (1,-40) [-40|215] "degC" Vector__XXX
 SG_ IC1_PackTemperatures_5 m0 : 47|8@0+ (1,-40) [-40|215] "degC" Vector__XXX
 SG_ IC1_PackTemperatures_6 m0 : 55|8@0+ (1,-40) [-40|215] "degC" Vector__XXX
 SG_ CSC02_IndexTemps M : 7|8@0+ (1,0) [0|255] "" Vector__XXX

BO_ 2550333441 CSC03_CELL_TEMPS: 8 CSC03
 SG_ IC4_PCB_Temperatures m7 : 15|8@0+ (1,-40) [-40|215] "degC" Vector__XXX
 SG_ IC4_InternalTemperature m7 : 23|8@0+ (1,-40) [-40|215] "degC" Vector__XXX
 SG_ IC4_PackTemperatures_1 m6 : 15|8@0+ (1,-40) [-40|215] "degC" Vector__XXX
 SG_ IC4_PackTemperatures_2 m6 : 23|8@0+ (1,-40) [-40|215] "degC" Vector__XXX
 SG_ IC4_PackTemperatures_3 m6 : 31|8@0+ (1,-40) [-40|215] "degC" Vector__XXX
 SG_ IC4_PackTemperatures_4 m6 : 39|8@0+ (1,-40) [-40|215] "degC" Vector__XXX
 SG_ IC4_PackTemperatures_5 m6 : 47|8@0+ (1,-40) [-40|215] "degC" Vector__XXX
 SG_ IC4_PackTemperatures_6 m6 : 55|8@0+ (1,-40) [-40|215] "degC" Vector__XXX
 SG_ IC3_PCB_Temperatures m5 : 15|8@0+ (1,-40) [-40|215] "degC" Vector__XXX
 SG_ IC3_InternalTemperature m5 : 23|8@0+ (1,-40) [-40|215] "degC" Vector__XXX
 SG_ IC3_PackTemperatures_1 m4 : 15|8@0+ (1,-40) [-40|215] "degC" Vector__XXX
 SG_ IC3_PackTemperatures_2 m4 : 23|8@0+ (1,-40) [-40|215] "degC" Vector__XXX
 SG_ IC3_PackTemperatures_3 m4 : 31|8@0+ (1,-40) [-40|215] "degC" Vector__XXX
 SG_ IC3_PackTemperatures_4 m4 : 39|8@0+ (1,-40) [-40|215] "degC" Vector__XXX
 SG_ IC3_PackTemperatures_5 m4 : 47|8@0+ (1,-40) [-40|215] "degC" Vector__XXX
 SG_ IC3_PackTemperatures_6 m4 : 55|8@0+ (1,-40) [-40|215] "degC" Vector__XXX
 SG_ IC2_PCB_Temperatures m3 : 15|8@0+ (1,-40) [-40|215] "degC" Vector__XXX
 SG_ IC2_InternalTemperature m3 : 23|8@0+ (1,-40) [-40|215] "degC" Vector__XXX
 SG_ IC2_PackTemperatures_1 m2 : 15|8@0+ (1,-40) [-40|215] "degC" Vector__XXX
 SG_ IC2_PackTemperatures_2 m2 : 23|8@0+ (1,-40) [-40|215] "degC" Vector__XXX
 SG_ IC2_PackTemperatures_3 m2 : 31|8@0+ (1,-40) [-40|215] "degC" Vector__XXX
 SG_ IC2_PackTemperatures_4 m2 : 39|8@0+ (1,-40) [-40|215] "degC" Vector__XXX
 SG_ IC2_PackTemperatures_5 m2 : 47|8@0+ (1,-40) [-40|215] "degC" Vector__XXX
 SG_ IC2_PackTemperatures_6 m2 : 55|8@0+ (1,-40) [-40|215] "degC" Vector__XXX
 SG_ IC1_PCB_Temperatures m1 : 15|8@0+ (1,-40) [-40|215] "degC" Vector__XXX
 SG_ IC1_InternalTemperature m1 : 23|8@0+ (1,-40) [-40|215] "degC" Vector__XXX
 SG_ IC1_PackTemperatures_1 m0 : 15|8@0+ (1,-40) [-40|215] "degC" Vector__XXX
 SG_ IC1_PackTemperatures_2 m0 : 23|8@0+ (1,-40) [-40|215] "degC" Vector__XXX
 SG_ IC1_PackTemperatures_3 m0 : 31|8@0+ (1,-40) [-40|215] "degC" Vector__XXX
 SG_ IC1_PackTemperatures_4 m0 : 39|8@0+ (1,-40) [-40|215] "degC" Vector__XXX
 SG_ IC1_PackTemperatures_5 m0 : 47|8@0+ (1,-40) [-40|215] "degC" Vector__XXX
 SG_ IC1_PackTemperatures_6 m0 : 55|8@0+ (1,-40) [-40|215] "degC" Vector__XXX
 SG_ CSC03_IndexTemps M : 7|8@0+ (1,0) [0|255] "" Vector__XXX

BO_ 2550398977 CSC04_CELL_TEMPS: 8 CSC04
 SG_ IC4_PCB_Temperatures m7 : 15|8@0+ (1,-40) [-40|215] "degC" Vector__XXX
 SG_ IC4_InternalTemperature m7 : 23|8@0+ (1,-40) [-40|215] "degC" Vector__XXX
 SG_ IC4_PackTemperatures_1 m6 : 15|8@0+ (1,-40) [-40|215] "degC" Vector__XXX
 SG_ IC4_PackTemperatures_2 m6 : 23|8@0+ (1,-40) [-40|215] "degC" Vector__XXX
 SG_ IC4_PackTemperatures_3 m6 : 31|8@0+ (1,-40) [-40|215] "degC" Vector__XXX
 SG_ IC4_PackTemperatures_4 m6 : 39|8@0+ (1,-40) [-40|215] "degC" Vector__XXX
 SG_ IC4_PackTemperatures_5 m6 : 47|8@0+ (1,-40) [-40|215] "degC" Vector__XXX
 SG_ IC4_PackTemperatures_6 m6 : 55|8@0+ (1,-40) [-40|215] "degC" Vector__XXX
 SG_ IC3_PCB_Temperatures m5 : 15|8@0+ (1,-40) [-40|215] "degC" Vector__XXX
 SG_ IC3_InternalTemperature m5 : 23|8@0+ (1,-40) [-40|215] "degC" Vector__XXX
 SG_ IC3_PackTemperatures_1 m4 : 15|8@0+ (1,-40) [-40|215] "degC" Vector__XXX
 SG_ IC3_PackTemperatures_2 m4 : 23|8@0+ (1,-40) [-40|215] "degC" Vector__XXX
 SG_ IC3_PackTemperatures_3 m4 : 31|8@0+ (1,-40) [-40|215] "degC" Vector__XXX
 SG_ IC3_PackTemperatures_4 m4 : 39|8@0+ (1,-40) [-40|215] "degC" Vector__XXX
 SG_ IC3_PackTemperatures_5 m4 : 47|8@0+ (1,-40) [-40|215] "degC" Vector__XXX
 SG_ IC3_PackTemperatures_6 m4 : 55|8@0+ (1,-40) [-40|215] "degC" Vector__XXX
 SG_ IC2_PCB_Temperatures m3 : 15|8@0+ (1,-40) [-40|215] "degC" Vector__XXX
 SG_ IC2_InternalTemperature m3 : 23|8@0+ (1,-40) [-40|215] "degC" Vector__XXX
 SG_ IC2_PackTemperatures_1 m2 : 15|8@0+ (1,-40) [-40|215] "degC" Vector__XXX
 SG_ IC2_PackTemperatures_2 m2 : 23|8@0+ (1,-40) [-40|215] "degC" Vector__XXX
 SG_ IC2_PackTemperatures_3 m2 : 31|8@0+ (1,-40) [-40|215] "degC" Vector__XXX
 SG_ IC2_PackTemperatures_4 m2 : 39|8@0+ (1,-40) [-40|215] "degC" Vector__XXX
 SG_ IC2_PackTemperatures_5 m2 : 47|8@0+ (1,-40) [-40|215] "degC" Vector__XXX
 SG_ IC2_PackTemperatures_6 m2 : 55|8@0+ (1,-40) [-40|215] "degC" Vector__XXX
 SG_ IC1_PCB_Temperatures m1 : 15|8@0+ (1,-40) [-40|215] "degC" Vector__XXX
 SG_ IC1_InternalTemperature m1 : 23|8@0+ (1,-40) [-40|215] "degC" Vector__XXX
 SG_ IC1_PackTemperatures_1 m0 : 15|8@0+ (1,-40) [-40|215] "degC" Vector__XXX
 SG_ IC1_PackTemperatures_2 m0 : 23|8@0+ (1,-40) [-40|215] "degC" Vector__XXX
 SG_ IC1_PackTemperatures_3 m0 : 31|8@0+ (1,-40) [-40|215] "degC" Vector__XXX
 SG_ IC1_PackTemperatures_4 m0 : 39|8@0+ (1,-40) [-40|215] "degC" Vector__XXX
 SG_ IC1_PackTemperatures_5 m0 : 47|8@0+ (1,-40) [-40|215] "degC" Vector__XXX
 SG_ IC1_PackTemperatures_6 m0 : 55|8@0+ (1,-40) [-40|215] "degC" Vector__XXX
 SG_ CSC04_IndexTemps M : 7|8@0+ (1,0) [0|255] "" Vector__XXX

BO_ 2550464513 CSC05_CELL_TEMPS: 8 CSC05
 SG_ IC4_PCB_Temperatures m7 : 15|8@0+ (1,-40) [-40|215] "degC" Vector__XXX
 SG_ IC4_InternalTemperature m7 : 23|8@0+ (1,-40) [-40|215] "degC" Vector__XXX
 SG_ IC4_PackTemperatures_1 m6 : 15|8@0+ (1,-40) [-40|215] "degC" Vector__XXX
 SG_ IC4_PackTemperatures_2 m6 : 23|8@0+ (1,-40) [-40|215] "degC" Vector__XXX
 SG_ IC4_PackTemperatures_3 m6 : 31|8@0+ (1,-40) [-40|215] "degC" Vector__XXX
 SG_ IC4_PackTemperatures_4 m6 : 39|8@0+ (1,-40) [-40|215] "degC" Vector__XXX
 SG_ IC4_PackTemperatures_5 m6 : 47|8@0+ (1,-40) [-40|215] "degC" Vector__XXX
 SG_ IC4_PackTemperatures_6 m6 : 55|8@0+ (1,-40) [-40|215] "degC" Vector__XXX
 SG_ IC3_PCB_Temperatures m5 : 15|8@0+ (1,-40) [-40|215] "degC" Vector__XXX
 SG_ IC3_InternalTemperature m5 : 23|8@0+ (1,-40) [-40|215] "degC" Vector__XXX
 SG_ IC3_PackTemperatures_1 m4 : 15|8@0+ (1,-40) [-40|215] "degC" Vector__XXX
 SG_ IC3_PackTemperatures_2 m4 : 23|8@0+ (1,-40) [-40|215] "degC" Vector__XXX
 SG_ IC3_PackTemperatures_3 m4 : 31|8@0+ (1,-40) [-40|215] "degC" Vector__XXX
 SG_ IC3_PackTemperatures_4 m4 : 39|8@0+ (1,-40) [-40|215] "degC" Vector__XXX
 SG_ IC3_PackTemperatures_5 m4 : 47|8@0+ (1,-40) [-40|215] "degC" Vector__XXX
 SG_ IC3_PackTemperatures_6 m4 : 55|8@0+ (1,-40) [-40|215] "degC" Vector__XXX
 SG_ IC2_PCB_Temperatures m3 : 15|8@0+ (1,-40) [-40|215] "degC" Vector__XXX
 SG_ IC2_InternalTemperature m3 : 23|8@0+ (1,-40) [-40|215] "degC" Vector__XXX
 SG_ IC2_PackTemperatures_1 m2 : 15|8@0+ (1,-40) [-40|215] "degC" Vector__XXX
 SG_ IC2_PackTemperatures_2 m2 : 23|8@0+ (1,-40) [-40|215] "degC" Vector__XXX
 SG_ IC2_PackTemperatures_3 m2 : 31|8@0+ (1,-40) [-40|215] "degC" Vector__XXX
 SG_ IC2_PackTemperatures_4 m2 : 39|8@0+ (1,-40) [-40|215] "degC" Vector__XXX
 SG_ IC2_PackTemperatures_5 m2 : 47|8@0+ (1,-40) [-40|215] "degC" Vector__XXX
 SG_ IC2_PackTemperatures_6 m2 : 55|8@0+ (1,-40) [-40|215] "degC" Vector__XXX
 SG_ IC1_PCB_Temperatures m1 : 15|8@0+ (1,-40) [-40|215] "degC" Vector__XXX
 SG_ IC1_InternalTemperature m1 : 23|8@0+ (1,-40) [-40|215] "degC" Vector__XXX
 SG_ IC1_PackTemperatures_1 m0 : 15|8@0+ (1,-40) [-40|215] "degC" Vector__XXX
 SG_ IC1_PackTemperatures_2 m0 : 23|8@0+ (1,-40) [-40|215] "degC" Vector__XXX
 SG_ IC1_PackTemperatures_3 m0 : 31|8@0+ (1,-40) [-40|215] "degC" Vector__XXX
 SG_ IC1_PackTemperatures_4 m0 : 39|8@0+ (1,-40) [-40|215] "degC" Vector__XXX
 SG_ IC1_PackTemperatures_5 m0 : 47|8@0+ (1,-40) [-40|215] "degC" Vector__XXX
 SG_ IC1_PackTemperatures_6 m0 : 55|8@0+ (1,-40) [-40|215] "degC" Vector__XXX
 SG_ CSC05_IndexTemps M : 7|8@0+ (1,0) [0|255] "" Vector__XXX

BO_ 2550530049 CSC06_CELL_TEMPS: 8 CSC06
 SG_ IC4_PCB_Temperatures m7 : 15|8@0+ (1,-40) [-40|215] "degC" Vector__XXX
 SG_ IC4_InternalTemperature m7 : 23|8@0+ (1,-40) [-40|215] "degC" Vector__XXX
 SG_ IC4_PackTemperatures_1 m6 : 15|8@0+ (1,-40) [-40|215] "degC" Vector__XXX
 SG_ IC4_PackTemperatures_2 m6 : 23|8@0+ (1,-40) [-40|215] "degC" Vector__XXX
 SG_ IC4_PackTemperatures_3 m6 : 31|8@0+ (1,-40) [-40|215] "degC" Vector__XXX
 SG_ IC4_PackTemperatures_4 m6 : 39|8@0+ (1,-40) [-40|215] "degC" Vector__XXX
 SG_ IC4_PackTemperatures_5 m6 : 47|8@0+ (1,-40) [-40|215] "degC" Vector__XXX
 SG_ IC4_PackTemperatures_6 m6 : 55|8@0+ (1,-40) [-40|215] "degC" Vector__XXX
 SG_ IC3_PCB_Temperatures m5 : 15|8@0+ (1,-40) [-40|215] "degC" Vector__XXX
 SG_ IC3_InternalTemperature m5 : 23|8@0+ (1,-40) [-40|215] "degC" Vector__XXX
 SG_ IC3_PackTemperatures_1 m4 : 15|8@0+ (1,-40) [-40|215] "degC" Vector__XXX
 SG_ IC3_PackTemperatures_2 m4 : 23|8@0+ (1,-40) [-40|215] "degC" Vector__XXX
 SG_ IC3_PackTemperatures_3 m4 : 31|8@0+ (1,-40) [-40|215] "degC" Vector__XXX
 SG_ IC3_PackTemperatures_4 m4 : 39|8@0+ (1,-40) [-40|215] "degC" Vector__XXX
 SG_ IC3_PackTemperatures_5 m4 : 47|8@0+ (1,-40) [-40|215] "degC" Vector__XXX
 SG_ IC3_PackTemperatures_6 m4 : 55|8@0+ (1,-40) [-40|215] "degC" Vector__XXX
 SG_ IC2_PCB_Temperatures m3 : 15|8@0+ (1,-40) [-40|215] "degC" Vector__XXX
 SG_ IC2_InternalTemperature m3 : 23|8@0+ (1,-40) [-40|215] "degC" Vector__XXX
 SG_ IC2_PackTemperatures_1 m2 : 15|8@0+ (1,-40) [-40|215] "degC" Vector__XXX
 SG_ IC2_PackTemperatures_2 m2 : 23|8@0+ (1,-40) [-40|215] "degC" Vector__XXX
 SG_ IC2_PackTemperatures_3 m2 : 31|8@0+ (1,-40) [-40|215] "degC" Vector__XXX
 SG_ IC2_PackTemperatures_4 m2 : 39|8@0+ (1,-40) [-40|215] "degC" Vector__XXX
 SG_ IC2_PackTemperatures_5 m2 : 47|8@0+ (1,-40) [-40|215] "degC" Vector__XXX
 SG_ IC2_PackTemperatures_6 m2 : 55|8@0+ (1,-40) [-40|215] "degC" Vector__XXX
 SG_ IC1_PCB_Temperatures m1 : 15|8@0+ (1,-40) [-40|215] "degC" Vector__XXX
 SG_ IC1_InternalTemperature m1 : 23|8@0+ (1,-40) [-40|215] "degC" Vector__XXX
 SG_ IC1_PackTemperatures_1 m0 : 15|8@0+ (1,-40) [-40|215] "degC" Vector__XXX
 SG_ IC1_PackTemperatures_2 m0 : 23|8@0+ (1,-40) [-40|215] "degC" Vector__XXX
 SG_ IC1_PackTemperatures_3 m0 : 31|8@0+ (1,-40) [-40|215] "degC" Vector__XXX
 SG_ IC1_PackTemperatures_4 m0 : 39|8@0+ (1,-40) [-40|215] "degC" Vector__XXX
 SG_ IC1_PackTemperatures_5 m0 : 47|8@0+ (1,-40) [-40|215] "degC" Vector__XXX
 SG_ IC1_PackTemperatures_6 m0 : 55|8@0+ (1,-40) [-40|215] "degC" Vector__XXX
 SG_ CSC06_IndexTemps M : 7|8@0+ (1,0) [0|255] "" Vector__XXX

BO_ 2550595585 CSC07_CELL_TEMPS: 8 CSC07
 SG_ IC4_PCB_Temperatures m7 : 15|8@0+ (1,-40) [-40|215] "degC" Vector__XXX
 SG_ IC4_InternalTemperature m7 : 23|8@0+ (1,-40) [-40|215] "degC" Vector__XXX
 SG_ IC4_PackTemperatures_1 m6 : 15|8@0+ (1,-40) [-40|215] "degC" Vector__XXX
 SG_ IC4_PackTemperatures_2 m6 : 23|8@0+ (1,-40) [-40|215] "degC" Vector__XXX
 SG_ IC4_PackTemperatures_3 m6 : 31|8@0+ (1,-40) [-40|215] "degC" Vector__XXX
 SG_ IC4_PackTemperatures_4 m6 : 39|8@0+ (1,-40) [-40|215] "degC" Vector__XXX
 SG_ IC4_PackTemperatures_5 m6 : 47|8@0+ (1,-40) [-40|215] "degC" Vector__XXX
 SG_ IC4_PackTemperatures_6 m6 : 55|8@0+ (1,-40) [-40|215] "degC" Vector__XXX
 SG_ IC3_PCB_Temperatures m5 : 15|8@0+ (1,-40) [-40|215] "degC" Vector__XXX
 SG_ IC3_InternalTemperature m5 : 23|8@0+ (1,-40) [-40|215] "degC" Vector__XXX
 SG_ IC3_PackTemperatures_1 m4 : 15|8@0+ (1,-40) [-40|215] "degC" Vector__XXX
 SG_ IC3_PackTemperatures_2 m4 : 23|8@0+ (1,-40) [-40|215] "degC" Vector__XXX
 SG_ IC3_PackTemperatures_3 m4 : 31|8@0+ (1,-40) [-40|215] "degC" Vector__XXX
 SG_ IC3_PackTemperatures_4 m4 : 39|8@0+ (1,-40) [-40|215] "degC" Vector__XXX
 SG_ IC3_PackTemperatures_5 m4 : 47|8@0+ (1,-40) [-40|215] "degC" Vector__XXX
 SG_ IC3_PackTemperatures_6 m4 : 55|8@0+ (1,-40) [-40|215] "degC" Vector__XXX
 SG_ IC2_PCB_Temperatures m3 : 15|8@0+ (1,-40) [-40|215] "degC" Vector__XXX
 SG_ IC2_InternalTemperature m3 : 23|8@0+ (1,-40) [-40|215] "degC" Vector__XXX
 SG_ IC2_PackTemperatures_1 m2 : 15|8@0+ (1,-40) [-40|215] "degC" Vector__XXX
 SG_ IC2_PackTemperatures_2 m2 : 23|8@0+ (1,-40) [-40|215] "degC" Vector__XXX
 SG_ IC2_PackTemperatures_3 m2 : 31|8@0+ (1,-40) [-40|215] "degC" Vector__XXX
 SG_ IC2_PackTemperatures_4 m2 : 39|8@0+ (1,-40) [-40|215] "degC" Vector__XXX
 SG_ IC2_PackTemperatures_5 m2 : 47|8@0+ (1,-40) [-40|215] "degC" Vector__XXX
 SG_ IC2_PackTemperatures_6 m2 : 55|8@0+ (1,-40) [-40|215] "degC" Vector__XXX
 SG_ IC1_PCB_Temperatures m1 : 15|8@0+ (1,-40) [-40|215] "degC" Vector__XXX
 SG_ IC1_InternalTemperature m1 : 23|8@0+ (1,-40) [-40|215] "degC" Vector__XXX
 SG_ IC1_PackTemperatures_1 m0 : 15|8@0+ (1,-40) [-40|215] "degC" Vector__XXX
 SG_ IC1_PackTemperatures_2 m0 : 23|8@0+ (1,-40) [-40|215] "degC" Vector__XXX
 SG_ IC1_PackTemperatures_3 m0 : 31|8@0+ (1,-40) [-40|215] "degC" Vector__XXX
 SG_ IC1_PackTemperatures_4 m0 : 39|8@0+ (1,-40) [-40|215] "degC" Vector__XXX
 SG_ IC1_PackTemperatures_5 m0 : 47|8@0+ (1,-40) [-40|215] "degC" Vector__XXX
 SG_ IC1_PackTemperatures_6 m0 : 55|8@0+ (1,-40) [-40|215] "degC" Vector__XXX
 SG_ CSC07_IndexTemps M : 7|8@0+ (1,0) [0|255] "" Vector__XXX

BO_ 2550661121 CSC08_CELL_TEMPS: 8 CSC08
 SG_ IC4_PCB_Temperatures m7 : 15|8@0+ (1,-40) [-40|215] "degC" Vector__XXX
 SG_ IC4_InternalTemperature m7 : 23|8@0+ (1,-40) [-40|215] "degC" Vector__XXX
 SG_ IC4_PackTemperatures_1 m6 : 15|8@0+ (1,-40) [-40|215] "degC" Vector__XXX
 SG_ IC4_PackTemperatures_2 m6 : 23|8@0+ (1,-40) [-40|215] "degC" Vector__XXX
 SG_ IC4_PackTemperatures_3 m6 : 31|8@0+ (1,-40) [-40|215] "degC" Vector__XXX
 SG_ IC4_PackTemperatures_4 m6 : 39|8@0+ (1,-40) [-40|215] "degC" Vector__XXX
 SG_ IC4_PackTemperatures_5 m6 : 47|8@0+ (1,-40) [-40|215] "degC" Vector__XXX
 SG_ IC4_PackTemperatures_6 m6 : 55|8@0+ (1,-40) [-40|215] "degC" Vector__XXX
 SG_ IC3_PCB_Temperatures m5 : 15|8@0+ (1,-40) [-40|215] "degC" Vector__XXX
 SG_ IC3_InternalTemperature m5 : 23|8@0+ (1,-40) [-40|215] "degC" Vector__XXX
 SG_ IC3_PackTemperatures_1 m4 : 15|8@0+ (1,-40) [-40|215] "degC" Vector__XXX
 SG_ IC3_PackTemperatures_2 m4 : 23|8@0+ (1,-40) [-40|215] "degC" Vector__XXX
 SG_ IC3_PackTemperatures_3 m4 : 31|8@0+ (1,-40) [-40|215] "degC" Vector__XXX
 SG_ IC3_PackTemperatures_4 m4 : 39|8@0+ (1,-40) [-40|215] "degC" Vector__XXX
 SG_ IC3_PackTemperatures_5 m4 : 47|8@0+ (1,-40) [-40|215] "degC" Vector__XXX
 SG_ IC3_PackTemperatures_6 m4 : 55|8@0+ (1,-40) [-40|215] "degC" Vector__XXX
 SG_ IC2_PCB_Temperatures m3 : 15|8@0+ (1,-40) [-40|215] "degC" Vector__XXX
 SG_ IC2_InternalTemperature m3 : 23|8@0+ (1,-40) [-40|215] "degC" Vector__XXX
 SG_ IC2_PackTemperatures_1 m2 : 15|8@0+ (1,-40) [-40|215] "degC" Vector__XXX
 SG_ IC2_PackTemperatures_2 m2 : 23|8@0+ (1,-40) [-40|215] "degC" Vector__XXX
 SG_ IC2_PackTemperatures_3 m2 : 31|8@0+ (1,-40) [-40|215] "degC" Vector__XXX
 SG_ IC2_PackTemperatures_4 m2 : 39|8@0+ (1,-40) [-40|215] "degC" Vector__XXX
 SG_ IC2_PackTemperatures_5 m2 : 47|8@0+ (1,-40) [-40|215] "degC" Vector__XXX
 SG_ IC2_PackTemperatures_6 m2 : 55|8@0+ (1,-40) [-40|215] "degC" Vector__XXX
 SG_ IC1_PCB_Temperatures m1 : 15|8@0+ (1,-40) [-40|215] "degC" Vector__XXX
 SG_ IC1_InternalTemperature m1 : 23|8@0+ (1,-40) [-40|215] "degC" Vector__XXX
 SG_ IC1_PackTemperatures_1 m0 : 15|8@0+ (1,-40) [-40|215] "degC" Vector__XXX
 SG_ IC1_PackTemperatures_2 m0 : 23|8@0+ (1,-40) [-40|215] "degC" Vector__XXX
 SG_ IC1_PackTemperatures_3 m0 : 31|8@0+ (1,-40) [-40|215] "degC" Vector__XXX
 SG_ IC1_PackTemperatures_4 m0 : 39|8@0+ (1,-40) [-40|215] "degC" Vector__XXX
 SG_ IC1_PackTemperatures_5 m0 : 47|8@0+ (1,-40) [-40|215] "degC" Vector__XXX
 SG_ IC1_PackTemperatures_6 m0 : 55|8@0+ (1,-40) [-40|215] "degC" Vector__XXX
 SG_ CSC08_IndexTemps M : 7|8@0+ (1,0) [0|255] "" Vector__XXX

BO_ 2550726657 CSC09_CELL_TEMPS: 8 CSC09
 SG_ IC4_PCB_Temperatures m7 : 15|8@0+ (1,-40) [-40|215] "degC" Vector__XXX
 SG_ IC4_InternalTemperature m7 : 23|8@0+ (1,-40) [-40|215] "degC" Vector__XXX
 SG_ IC4_PackTemperatures_1 m6 : 15|8@0+ (1,-40) [-40|215] "degC" Vector__XXX
 SG_ IC4_PackTemperatures_2 m6 : 23|8@0+ (1,-40) [-40|215] "degC" Vector__XXX
 SG_ IC4_PackTemperatures_3 m6 : 31|8@0+ (1,-40) [-40|215] "degC" Vector__XXX
 SG_ IC4_PackTemperatures_4 m6 : 39|8@0+ (1,-40) [-40|215] "degC" Vector__XXX
 SG_ IC4_PackTemperatures_5 m6 : 47|8@0+ (1,-40) [-40|215] "degC" Vector__XXX
 SG_ IC4_PackTemperatures_6 m6 : 55|8@0+ (1,-40) [-40|215] "degC" Vector__XXX
 SG_ IC3_PCB_Temperatures m5 : 15|8@0+ (1,-40) [-40|215] "degC" Vector__XXX
 SG_ IC3_InternalTemperature m5 : 23|8@0+ (1,-40) [-40|215] "degC" Vector__XXX
 SG_ IC3_PackTemperatures_1 m4 : 15|8@0+ (1,-40) [-40|215] "degC" Vector__XXX
 SG_ IC3_PackTemperatures_2 m4 : 23|8@0+ (1,-40) [-40|215] "degC" Vector__XXX
 SG_ IC3_PackTemperatures_3 m4 : 31|8@0+ (1,-40) [-40|215] "degC" Vector__XXX
 SG_ IC3_PackTemperatures_4 m4 : 39|8@0+ (1,-40) [-40|215] "degC" Vector__XXX
 SG_ IC3_PackTemperatures_5 m4 : 47|8@0+ (1,-40) [-40|215] "degC" Vector__XXX
 SG_ IC3_PackTemperatures_6 m4 : 55|8@0+ (1,-40) [-40|215] "degC" Vector__XXX
 SG_ IC2_PCB_Temperatures m3 : 15|8@0+ (1,-40) [-40|215] "degC" Vector__XXX
 SG_ IC2_InternalTemperature m3 : 23|8@0+ (1,-40) [-40|215] "degC" Vector__XXX
 SG_ IC2_PackTemperatures_1 m2 : 15|8@0+ (1,-40) [-40|215] "degC" Vector__XXX
 SG_ IC2_PackTemperatures_2 m2 : 23|8@0+ (1,-40) [-40|215] "degC" Vector__XXX
 SG_ IC2_PackTemperatures_3 m2 : 31|8@0+ (1,-40) [-40|215] "degC" Vector__XXX
 SG_ IC2_PackTemperatures_4 m2 : 39|8@0+ (1,-40) [-40|215] "degC" Vector__XXX
 SG_ IC2_PackTemperatures_5 m2 : 47|8@0+ (1,-40) [-40|215] "degC" Vector__XXX
 SG_ IC2_PackTemperatures_6 m2 : 55|8@0+ (1,-40) [-40|215] "degC" Vector__XXX
 SG_ IC1_PCB_Temperatures m1 : 15|8@0+ (1,-40) [-40|215] "degC" Vector__XXX
 SG_ IC1_InternalTemperature m1 : 23|8@0+ (1,-40) [-40|215] "degC" Vector__XXX
 SG_ IC1_PackTemperatures_1 m0 : 15|8@0+ (1,-40) [-40|215] "degC" Vector__XXX
 SG_ IC1_PackTemperatures_2 m0 : 23|8@0+ (1,-40) [-40|215] "degC" Vector__XXX
 SG_ IC1_PackTemperatures_3 m0 : 31|8@0+ (1,-40) [-40|215] "degC" Vector__XXX
 SG_ IC1_PackTemperatures_4 m0 : 39|8@0+ (1,-40) [-40|215] "degC" Vector__XXX
 SG_ IC1_PackTemperatures_5 m0 : 47|8@0+ (1,-40) [-40|215] "degC" Vector__XXX
 SG_ IC1_PackTemperatures_6 m0 : 55|8@0+ (1,-40) [-40|215] "degC" Vector__XXX
 SG_ CSC09_IndexTemps M : 7|8@0+ (1,0) [0|255] "" Vector__XXX

BO_ 2550792193 CSC10_CELL_TEMPS: 8 CSC10
 SG_ IC4_PCB_Temperatures m7 : 15|8@0+ (1,-40) [-40|215] "degC" Vector__XXX
 SG_ IC4_InternalTemperature m7 : 23|8@0+ (1,-40) [-40|215] "degC" Vector__XXX
 SG_ IC4_PackTemperatures_1 m6 : 15|8@0+ (1,-40) [-40|215] "degC" Vector__XXX
 SG_ IC4_PackTemperatures_2 m6 : 23|8@0+ (1,-40) [-40|215] "degC" Vector__XXX
 SG_ IC4_PackTemperatures_3 m6 : 31|8@0+ (1,-40) [-40|215] "degC" Vector__XXX
 SG_ IC4_PackTemperatures_4 m6 : 39|8@0+ (1,-40) [-40|215] "degC" Vector__XXX
 SG_ IC4_PackTemperatures_5 m6 : 47|8@0+ (1,-40) [-40|215] "degC" Vector__XXX
 SG_ IC4_PackTemperatures_6 m6 : 55|8@0+ (1,-40) [-40|215] "degC" Vector__XXX
 SG_ IC3_PCB_Temperatures m5 : 15|8@0+ (1,-40) [-40|215] "degC" Vector__XXX
 SG_ IC3_InternalTemperature m5 : 23|8@0+ (1,-40) [-40|215] "degC" Vector__XXX
 SG_ IC3_PackTemperatures_1 m4 : 15|8@0+ (1,-40) [-40|215] "degC" Vector__XXX
 SG_ IC3_PackTemperatures_2 m4 : 23|8@0+ (1,-40) [-40|215] "degC" Vector__XXX
 SG_ IC3_PackTemperatures_3 m4 : 31|8@0+ (1,-40) [-40|215] "degC" Vector__XXX
 SG_ IC3_PackTemperatures_4 m4 : 39|8@0+ (1,-40) [-40|215] "degC" Vector__XXX
 SG_ IC3_PackTemperatures_5 m4 : 47|8@0+ (1,-40) [-40|215] "degC" Vector__XXX
 SG_ IC3_PackTemperatures_6 m4 : 55|8@0+ (1,-40) [-40|215] "degC" Vector__XXX
 SG_ IC2_PCB_Temperatures m3 : 15|8@0+ (1,-40) [-40|215] "degC" Vector__XXX
 SG_ IC2_InternalTemperature m3 : 23|8@0+ (1,-40) [-40|215] "degC" Vector__XXX
 SG_ IC2_PackTemperatures_1 m2 : 15|8@0+ (1,-40) [-40|215] "degC" Vector__XXX
 SG_ IC2_PackTemperatures_2 m2 : 23|8@0+ (1,-40) [-40|215] "degC" Vector__XXX
 SG_ IC2_PackTemperatures_3 m2 : 31|8@0+ (1,-40) [-40|215] "degC" Vector__XXX
 SG_ IC2_PackTemperatures_4 m2 : 39|8@0+ (1,-40) [-40|215] "degC" Vector__XXX
 SG_ IC2_PackTemperatures_5 m2 : 47|8@0+ (1,-40) [-40|215] "degC" Vector__XXX
 SG_ IC2_PackTemperatures_6 m2 : 55|8@0+ (1,-40) [-40|215] "degC" Vector__XXX
 SG_ IC1_PCB_Temperatures m1 : 15|8@0+ (1,-40) [-40|215] "degC" Vector__XXX
 SG_ IC1_InternalTemperature m1 : 23|8@0+ (1,-40) [-40|215] "degC" Vector__XXX
 SG_ IC1_PackTemperatures_1 m0 : 15|8@0+ (1,-40) [-40|215] "degC" Vector__XXX
 SG_ IC1_PackTemperatures_2 m0 : 23|8@0+ (1,-40) [-40|215] "degC" Vector__XXX
 SG_ IC1_PackTemperatures_3 m0 : 31|8@0+ (1,-40) [-40|215] "degC" Vector__XXX
 SG_ IC1_PackTemperatures_4 m0 : 39|8@0+ (1,-40) [-40|215] "degC" Vector__XXX
 SG_ IC1_PackTemperatures_5 m0 : 47|8@0+ (1,-40) [-40|215] "degC" Vector__XXX
 SG_ IC1_PackTemperatures_6 m0 : 55|8@0+ (1,-40) [-40|215] "degC" Vector__XXX
 SG_ CSC10_IndexTemps M : 7|8@0+ (1,0) [0|255] "" Vector__XXX

BO_ 2550857729 CSC11_CELL_TEMPS: 8 CSC11
 SG_ IC4_PCB_Temperatures m7 : 15|8@0+ (1,-40) [-40|215] "degC" Vector__XXX
 SG_ IC4_InternalTemperature m7 : 23|8@0+ (1,-40) [-40|215] "degC" Vector__XXX
 SG_ IC4_PackTemperatures_1 m6 : 15|8@0+ (1,-40) [-40|215] "degC" Vector__XXX
 SG_ IC4_PackTemperatures_2 m6 : 23|8@0+ (1,-40) [-40|215] "degC" Vector__XXX
 SG_ IC4_PackTemperatures_3 m6 : 31|8@0+ (1,-40) [-40|215] "degC" Vector__XXX
 SG_ IC4_PackTemperatures_4 m6 : 39|8@0+ (1,-40) [-40|215] "degC" Vector__XXX
 SG_ IC4_PackTemperatures_5 m6 : 47|8@0+ (1,-40) [-40|215] "degC" Vector__XXX
 SG_ IC4_PackTemperatures_6 m6 : 55|8@0+ (1,-40) [-40|215] "degC" Vector__XXX
 SG_ IC3_PCB_Temperatures m5 : 15|8@0+ (1,-40) [-40|215] "degC" Vector__XXX
 SG_ IC3_InternalTemperature m5 : 23|8@0+ (1,-40) [-40|215] "degC" Vector__XXX
 SG_ IC3_PackTemperatures_1 m4 : 15|8@0+ (1,-40) [-40|215] "degC" Vector__XXX
 SG_ IC3_PackTemperatures_2 m4 : 23|8@0+ (1,-40) [-40|215] "degC" Vector__XXX
 SG_ IC3_PackTemperatures_3 m4 : 31|8@0+ (1,-40) [-40|215] "degC" Vector__XXX
 SG_ IC3_PackTemperatures_4 m4 : 39|8@0+ (1,-40) [-40|215] "degC" Vector__XXX
 SG_ IC3_PackTemperatures_5 m4 : 47|8@0+ (1,-40) [-40|215] "degC" Vector__XXX
 SG_ IC3_PackTemperatures_6 m4 : 55|8@0+ (1,-40) [-40|215] "degC" Vector__XXX
 SG_ IC2_PCB_Temperatures m3 : 15|8@0+ (1,-40) [-40|215] "degC" Vector__XXX
 SG_ IC2_InternalTemperature m3 : 23|8@0+ (1,-40) [-40|215] "degC" Vector__XXX
 SG_ IC2_PackTemperatures_1 m2 : 15|8@0+ (1,-40) [-40|215] "degC" Vector__XXX
 SG_ IC2_PackTemperatures_2 m2 : 23|8@0+ (1,-40) [-40|215] "degC" Vector__XXX
 SG_ IC2_PackTemperatures_3 m2 : 31|8@0+ (1,-40) [-40|215] "degC" Vector__XXX
 SG_ IC2_PackTemperatures_4 m2 : 39|8@0+ (1,-40) [-40|215] "degC" Vector__XXX
 SG_ IC2_PackTemperatures_5 m2 : 47|8@0+ (1,-40) [-40|215] "degC" Vector__XXX
 SG_ IC2_PackTemperatures_6 m2 : 55|8@0+ (1,-40) [-40|215] "degC" Vector__XXX
 SG_ IC1_PCB_Temperatures m1 : 15|8@0+ (1,-40) [-40|215] "degC" Vector__XXX
 SG_ IC1_InternalTemperature m1 : 23|8@0+ (1,-40) [-40|215] "degC" Vector__XXX
 SG_ IC1_PackTemperatures_1 m0 : 15|8@0+ (1,-40) [-40|215] "degC" Vector__XXX
 SG_ IC1_PackTemperatures_2 m0 : 23|8@0+ (1,-40) [-40|215] "degC" Vector__XXX
 SG_ IC1_PackTemperatures_3 m0 : 31|8@0+ (1,-40) [-40|215] "degC" Vector__XXX
 SG_ IC1_PackTemperatures_4 m0 : 39|8@0+ (1,-40) [-40|215] "degC" Vector__XXX
 SG_ IC1_PackTemperatures_5 m0 : 47|8@0+ (1,-40) [-40|215] "degC" Vector__XXX
 SG_ IC1_PackTemperatures_6 m0 : 55|8@0+ (1,-40) [-40|215] "degC" Vector__XXX
 SG_ CSC11_IndexTemps M : 7|8@0+ (1,0) [0|255] "" Vector__XXX

BO_ 2550923265 CSC12_CELL_TEMPS: 8 CSC12
 SG_ IC4_PCB_Temperatures m7 : 15|8@0+ (1,-40) [-40|215] "degC" Vector__XXX
 SG_ IC4_InternalTemperature m7 : 23|8@0+ (1,-40) [-40|215] "degC" Vector__XXX
 SG_ IC4_PackTemperatures_1 m6 : 15|8@0+ (1,-40) [-40|215] "degC" Vector__XXX
 SG_ IC4_PackTemperatures_2 m6 : 23|8@0+ (1,-40) [-40|215] "degC" Vector__XXX
 SG_ IC4_PackTemperatures_3 m6 : 31|8@0+ (1,-40) [-40|215] "degC" Vector__XXX
 SG_ IC4_PackTemperatures_4 m6 : 39|8@0+ (1,-40) [-40|215] "degC" Vector__XXX
 SG_ IC4_PackTemperatures_5 m6 : 47|8@0+ (1,-40) [-40|215] "degC" Vector__XXX
 SG_ IC4_PackTemperatures_6 m6 : 55|8@0+ (1,-40) [-40|215] "degC" Vector__XXX
 SG_ IC3_PCB_Temperatures m5 : 15|8@0+ (1,-40) [-40|215] "degC" Vector__XXX
 SG_ IC3_InternalTemperature m5 : 23|8@0+ (1,-40) [-40|215] "degC" Vector__XXX
 SG_ IC3_PackTemperatures_1 m4 : 15|8@0+ (1,-40) [-40|215] "degC" Vector__XXX
 SG_ IC3_PackTemperatures_2 m4 : 23|8@0+ (1,-40) [-40|215] "degC" Vector__XXX
 SG_ IC3_PackTemperatures_3 m4 : 31|8@0+ (1,-40) [-40|215] "degC" Vector__XXX
 SG_ IC3_PackTemperatures_4 m4 : 39|8@0+ (1,-40) [-40|215] "degC" Vector__XXX
 SG_ IC3_PackTemperatures_5 m4 : 47|8@0+ (1,-40) [-40|215] "degC" Vector__XXX
 SG_ IC3_PackTemperatures_6 m4 : 55|8@0+ (1,-40) [-40|215] "degC" Vector__XXX
 SG_ IC2_PCB_Temperatures m3 : 15|8@0+ (1,-40) [-40|215] "degC" Vector__XXX
 SG_ IC2_InternalTemperature m3 : 23|8@0+ (1,-40) [-40|215] "degC" Vector__XXX
 SG_ IC2_PackTemperatures_1 m2 : 15|8@0+ (1,-40) [-40|215] "degC" Vector__XXX
 SG_ IC2_PackTemperatures_2 m2 : 23|8@0+ (1,-40) [-40|215] "degC" Vector__XXX
 SG_ IC2_PackTemperatures_3 m2 : 31|8@0+ (1,-40) [-40|215] "degC" Vector__XXX
 SG_ IC2_PackTemperatures_4 m2 : 39|8@0+ (1,-40) [-40|215] "degC" Vector__XXX
 SG_ IC2_PackTemperatures_5 m2 : 47|8@0+ (1,-40) [-40|215] "degC" Vector__XXX
 SG_ IC2_PackTemperatures_6 m2 : 55|8@0+ (1,-40) [-40|215] "degC" Vector__XXX
 SG_ IC1_PCB_Temperatures m1 : 15|8@0+ (1,-40) [-40|215] "degC" Vector__XXX
 SG_ IC1_InternalTemperature m1 : 23|8@0+ (1,-40) [-40|215] "degC" Vector__XXX
 SG_ IC1_PackTemperatures_1 m0 : 15|8@0+ (1,-40) [-40|215] "degC" Vector__XXX
 SG_ IC1_PackTemperatures_2 m0 : 23|8@0+ (1,-40) [-40|215] "degC" Vector__XXX
 SG_ IC1_PackTemperatures_3 m0 : 31|8@0+ (1,-40) [-40|215] "degC" Vector__XXX
 SG_ IC1_PackTemperatures_4 m0 : 39|8@0+ (1,-40) [-40|215] "degC" Vector__XXX
 SG_ IC1_PackTemperatures_5 m0 : 47|8@0+ (1,-40) [-40|215] "degC" Vector__XXX
 SG_ IC1_PackTemperatures_6 m0 : 55|8@0+ (1,-40) [-40|215] "degC" Vector__XXX
 SG_ CSC12_IndexTemps M : 7|8@0+ (1,0) [0|255] "" Vector__XXX

BO_ 2550988801 CSC13_CELL_TEMPS: 8 CSC13
 SG_ IC4_PCB_Temperatures m7 : 15|8@0+ (1,-40) [-40|215] "degC" Vector__XXX
 SG_ IC4_InternalTemperature m7 : 23|8@0+ (1,-40) [-40|215] "degC" Vector__XXX
 SG_ IC4_PackTemperatures_1 m6 : 15|8@0+ (1,-40) [-40|215] "degC" Vector__XXX
 SG_ IC4_PackTemperatures_2 m6 : 23|8@0+ (1,-40) [-40|215] "degC" Vector__XXX
 SG_ IC4_PackTemperatures_3 m6 : 31|8@0+ (1,-40) [-40|215] "degC" Vector__XXX
 SG_ IC4_PackTemperatures_4 m6 : 39|8@0+ (1,-40) [-40|215] "degC" Vector__XXX
 SG_ IC4_PackTemperatures_5 m6 : 47|8@0+ (1,-40) [-40|215] "degC" Vector__XXX
 SG_ IC4_PackTemperatures_6 m6 : 55|8@0+ (1,-40) [-40|215] "degC" Vector__XXX
 SG_ IC3_PCB_Temperatures m5 : 15|8@0+ (1,-40) [-40|215] "degC" Vector__XXX
 SG_ IC3_InternalTemperature m5 : 23|8@0+ (1,-40) [-40|215] "degC" Vector__XXX
 SG_ IC3_PackTemperatures_1 m4 : 15|8@0+ (1,-40) [-40|215] "degC" Vector__XXX
 SG_ IC3_PackTemperatures_2 m4 : 23|8@0+ (1,-40) [-40|215] "degC" Vector__XXX
 SG_ IC3_PackTemperatures_3 m4 : 31|8@0+ (1,-40) [-40|215] "degC" Vector__XXX
 SG_ IC3_PackTemperatures_4 m4 : 39|8@0+ (1,-40) [-40|215] "degC" Vector__XXX
 SG_ IC3_PackTemperatures_5 m4 : 47|8@0+ (1,-40) [-40|215] "degC" Vector__XXX
 SG_ IC3_PackTemperatures_6 m4 : 55|8@0+ (1,-40) [-40|215] "degC" Vector__XXX
 SG_ IC2_PCB_Temperatures m3 : 15|8@0+ (1,-40) [-40|215] "degC" Vector__XXX
 SG_ IC2_InternalTemperature m3 : 23|8@0+ (1,-40) [-40|215] "degC" Vector__XXX
 SG_ IC2_PackTemperatures_1 m2 : 15|8@0+ (1,-40) [-40|215] "degC" Vector__XXX
 SG_ IC2_PackTemperatures_2 m2 : 23|8@0+ (1,-40) [-40|215] "degC" Vector__XXX
 SG_ IC2_PackTemperatures_3 m2 : 31|8@0+ (1,-40) [-40|215] "degC" Vector__XXX
 SG_ IC2_PackTemperatures_4 m2 : 39|8@0+ (1,-40) [-40|215] "degC" Vector__XXX
 SG_ IC2_PackTemperatures_5 m2 : 47|8@0+ (1,-40) [-40|215] "degC" Vector__XXX
 SG_ IC2_PackTemperatures_6 m2 : 55|8@0+ (1,-40) [-40|215] "degC" Vector__XXX
 SG_ IC1_PCB_Temperatures m1 : 15|8@0+ (1,-40) [-40|215] "degC" Vector__XXX
 SG_ IC1_InternalTemperature m1 : 23|8@0+ (1,-40) [-40|215] "degC" Vector__XXX
 SG_ IC1_PackTemperatures_1 m0 : 15|8@0+ (1,-40) [-40|215] "degC" Vector__XXX
 SG_ IC1_PackTemperatures_2 m0 : 23|8@0+ (1,-40) [-40|215] "degC" Vector__XXX
 SG_ IC1_PackTemperatures_3 m0 : 31|8@0+ (1,-40) [-40|215] "degC" Vector__XXX
 SG_ IC1_PackTemperatures_4 m0 : 39|8@0+ (1,-40) [-40|215] "degC" Vector__XXX
 SG_ IC1_PackTemperatures_5 m0 : 47|8@0+ (1,-40) [-40|215] "degC" Vector__XXX
 SG_ IC1_PackTemperatures_6 m0 : 55|8@0+ (1,-40) [-40|215] "degC" Vector__XXX
 SG_ CSC13_IndexTemps M : 7|8@0+ (1,0) [0|255] "" Vector__XXX

BO_ 2551054337 CSC14_CELL_TEMPS: 8 CSC14
 SG_ IC4_PCB_Temperatures m7 : 15|8@0+ (1,-40) [-40|215] "degC" Vector__XXX
 SG_ IC4_InternalTemperature m7 : 23|8@0+ (1,-40) [-40|215] "degC" Vector__XXX
 SG_ IC4_PackTemperatures_1 m6 : 15|8@0+ (1,-40) [-40|215] "degC" Vector__XXX
 SG_ IC4_PackTemperatures_2 m6 : 23|8@0+ (1,-40) [-40|215] "degC" Vector__XXX
 SG_ IC4_PackTemperatures_3 m6 : 31|8@0+ (1,-40) [-40|215] "degC" Vector__XXX
 SG_ IC4_PackTemperatures_4 m6 : 39|8@0+ (1,-40) [-40|215] "degC" Vector__XXX
 SG_ IC4_PackTemperatures_5 m6 : 47|8@0+ (1,-40) [-40|215] "degC" Vector__XXX
 SG_ IC4_PackTemperatures_6 m6 : 55|8@0+ (1,-40) [-40|215] "degC" Vector__XXX
 SG_ IC3_PCB_Temperatures m5 : 15|8@0+ (1,-40) [-40|215] "degC" Vector__XXX
 SG_ IC3_InternalTemperature m5 : 23|8@0+ (1,-40) [-40|215] "degC" Vector__XXX
 SG_ IC3_PackTemperatures_1 m4 : 15|8@0+ (1,-40) [-40|215] "degC" Vector__XXX
 SG_ IC3_PackTemperatures_2 m4 : 23|8@0+ (1,-40) [-40|215] "degC" Vector__XXX
 SG_ IC3_PackTemperatures_3 m4 : 31|8@0+ (1,-40) [-40|215] "degC" Vector__XXX
 SG_ IC3_PackTemperatures_4 m4 : 39|8@0+ (1,-40) [-40|215] "degC" Vector__XXX
 SG_ IC3_PackTemperatures_5 m4 : 47|8@0+ (1,-40) [-40|215] "degC" Vector__XXX
 SG_ IC3_PackTemperatures_6 m4 : 55|8@0+ (1,-40) [-40|215] "degC" Vector__XXX
 SG_ IC2_PCB_Temperatures m3 : 15|8@0+ (1,-40) [-40|215] "degC" Vector__XXX
 SG_ IC2_InternalTemperature m3 : 23|8@0+ (1,-40) [-40|215] "degC" Vector__XXX
 SG_ IC2_PackTemperatures_1 m2 : 15|8@0+ (1,-40) [-40|215] "degC" Vector__XXX
 SG_ IC2_PackTemperatures_2 m2 : 23|8@0+ (1,-40) [-40|215] "degC" Vector__XXX
 SG_ IC2_PackTemperatures_3 m2 : 31|8@0+ (1,-40) [-40|215] "degC" Vector__XXX
 SG_ IC2_PackTemperatures_4 m2 : 39|8@0+ (1,-40) [-40|215] "degC" Vector__XXX
 SG_ IC2_PackTemperatures_5 m2 : 47|8@0+ (1,-40) [-40|215] "degC" Vector__XXX
 SG_ IC2_PackTemperatures_6 m2 : 55|8@0+ (1,-40) [-40|215] "degC" Vector__XXX
 SG_ IC1_PCB_Temperatures m1 : 15|8@0+ (1,-40) [-40|215] "degC" Vector__XXX
 SG_ IC1_InternalTemperature m1 : 23|8@0+ (1,-40) [-40|215] "degC" Vector__XXX
 SG_ IC1_PackTemperatures_1 m0 : 15|8@0+ (1,-40) [-40|215] "degC" Vector__XXX
 SG_ IC1_PackTemperatures_2 m0 : 23|8@0+ (1,-40) [-40|215] "degC" Vector__XXX
 SG_ IC1_PackTemperatures_3 m0 : 31|8@0+ (1,-40) [-40|215] "degC" Vector__XXX
 SG_ IC1_PackTemperatures_4 m0 : 39|8@0+ (1,-40) [-40|215] "degC" Vector__XXX
 SG_ IC1_PackTemperatures_5 m0 : 47|8@0+ (1,-40) [-40|215] "degC" Vector__XXX
 SG_ IC1_PackTemperatures_6 m0 : 55|8@0+ (1,-40) [-40|215] "degC" Vector__XXX
 SG_ CSC14_IndexTemps M : 7|8@0+ (1,0) [0|255] "" Vector__XXX

BO_ 2551119873 CSC15_CELL_TEMPS: 8 CSC15
 SG_ IC4_PCB_Temperatures m7 : 15|8@0+ (1,-40) [-40|215] "degC" Vector__XXX
 SG_ IC4_InternalTemperature m7 : 23|8@0+ (1,-40) [-40|215] "degC" Vector__XXX
 SG_ IC4_PackTemperatures_1 m6 : 15|8@0+ (1,-40) [-40|215] "degC" Vector__XXX
 SG_ IC4_PackTemperatures_2 m6 : 23|8@0+ (1,-40) [-40|215] "degC" Vector__XXX
 SG_ IC4_PackTemperatures_3 m6 : 31|8@0+ (1,-40) [-40|215] "degC" Vector__XXX
 SG_ IC4_PackTemperatures_4 m6 : 39|8@0+ (1,-40) [-40|215] "degC" Vector__XXX
 SG_ IC4_PackTemperatures_5 m6 : 47|8@0+ (1,-40) [-40|215] "degC" Vector__XXX
 SG_ IC4_PackTemperatures_6 m6 : 55|8@0+ (1,-40) [-40|215] "degC" Vector__XXX
 SG_ IC3_PCB_Temperatures m5 : 15|8@0+ (1,-40) [-40|215] "degC" Vector__XXX
 SG_ IC3_InternalTemperature m5 : 23|8@0+ (1,-40) [-40|215] "degC" Vector__XXX
 SG_ IC3_PackTemperatures_1 m4 : 15|8@0+ (1,-40) [-40|215] "degC" Vector__XXX
 SG_ IC3_PackTemperatures_2 m4 : 23|8@0+ (1,-40) [-40|215] "degC" Vector__XXX
 SG_ IC3_PackTemperatures_3 m4 : 31|8@0+ (1,-40) [-40|215] "degC" Vector__XXX
 SG_ IC3_PackTemperatures_4 m4 : 39|8@0+ (1,-40) [-40|215] "degC" Vector__XXX
 SG_ IC3_PackTemperatures_5 m4 : 47|8@0+ (1,-40) [-40|215] "degC" Vector__XXX
 SG_ IC3_PackTemperatures_6 m4 : 55|8@0+ (1,-40) [-40|215] "degC" Vector__XXX
 SG_ IC2_PCB_Temperatures m3 : 15|8@0+ (1,-40) [-40|215] "degC" Vector__XXX
 SG_ IC2_InternalTemperature m3 : 23|8@0+ (1,-40) [-40|215] "degC" Vector__XXX
 SG_ IC2_PackTemperatures_1 m2 : 15|8@0+ (1,-40) [-40|215] "degC" Vector__XXX
 SG_ IC2_PackTemperatures_2 m2 : 23|8@0+ (1,-40) [-40|215] "degC" Vector__XXX
 SG_ IC2_PackTemperatures_3 m2 : 31|8@0+ (1,-40) [-40|215] "degC" Vector__XXX
 SG_ IC2_PackTemperatures_4 m2 : 39|8@0+ (1,-40) [-40|215] "degC" Vector__XXX
 SG_ IC2_PackTemperatures_5 m2 : 47|8@0+ (1,-40) [-40|215] "degC" Vector__XXX
 SG_ IC2_PackTemperatures_6 m2 : 55|8@0+ (1,-40) [-40|215] "degC" Vector__XXX
 SG_ IC1_PCB_Temperatures m1 : 15|8@0+ (1,-40) [-40|215] "degC" Vector__XXX
 SG_ IC1_InternalTemperature m1 : 23|8@0+ (1,-40) [-40|215] "degC" Vector__XXX
 SG_ IC1_PackTemperatures_1 m0 : 15|8@0+ (1,-40) [-40|215] "degC" Vector__XXX
 SG_ IC1_PackTemperatures_2 m0 : 23|8@0+ (1,-40) [-40|215] "degC" Vector__XXX
 SG_ IC1_PackTemperatures_3 m0 : 31|8@0+ (1,-40) [-40|215] "degC" Vector__XXX
 SG_ IC1_PackTemperatures_4 m0 : 39|8@0+ (1,-40) [-40|215] "degC" Vector__XXX
 SG_ IC1_PackTemperatures_5 m0 : 47|8@0+ (1,-40) [-40|215] "degC" Vector__XXX
 SG_ IC1_PackTemperatures_6 m0 : 55|8@0+ (1,-40) [-40|215] "degC" Vector__XXX
 SG_ CSC15_IndexTemps M : 7|8@0+ (1,0) [0|255] "" Vector__XXX

BO_ 2550202370 CSC01_CIDs_FAULTS: 8 CSC01
 SG_ IC4_IDLE_MODE_FLT m3 : 24|1@0+ (1,0) [0|0] "" Vector__XXX
 SG_ IC4_AN_OPEN_FLT m3 : 39|1@0+ (1,0) [0|0] "" Vector__XXX
 SG_ IC4_GPIO_SHORT_FLT m3 : 38|1@0+ (1,0) [0|0] "" Vector__XXX
 SG_ IC4_CB_SHORT_FLT m3 : 37|1@0+ (1,0) [0|0] "" Vector__XXX
 SG_ IC4_CB_OPEN_FLT m3 : 36|1@0+ (1,0) [0|0] "" Vector__XXX
 SG_ IC4_OSC_ERR_FLT m3 : 35|1@0+ (1,0) [0|0] "" Vector__XXX
 SG_ IC4_DED_ERR_FLT m3 : 34|1@0+ (1,0) [0|0] "" Vector__XXX
 SG_ IC4_FUSE_ERR_FLT m3 : 33|1@0+ (1,0) [0|0] "" Vector__XXX
 SG_ IC4_VCOM_OV_FLT m3 : 16|1@0+ (1,0) [0|0] "" Vector__XXX
 SG_ IC4_VCOM_UV_FLT m3 : 31|1@0+ (1,0) [0|0] "" Vector__XXX
 SG_ IC4_VANA_OV_FLT m3 : 30|1@0+ (1,0) [0|0] "" Vector__XXX
 SG_ IC4_VANA_UV_FLT m3 : 29|1@0+ (1,0) [0|0] "" Vector__XXX
 SG_ IC4_ADC1_B_FLT m3 : 28|1@0+ (1,0) [0|0] "" Vector__XXX
 SG_ IC4_ADC1_A_FLT m3 : 27|1@0+ (1,0) [0|0] "" Vector__XXX
 SG_ IC4_GND_LOSS_FLT m3 : 26|1@0+ (1,0) [0|0] "" Vector__XXX
 SG_ IC4_IC_TSD_FLT m3 : 25|1@0+ (1,0) [0|0] "" Vector__XXX
 SG_ IC4_GPIO0_WUP_FLT m3 : 23|1@0+ (1,0) [0|0] "" Vector__XXX
 SG_ IC4_IS_OL_FLT m3 : 22|1@0+ (1,0) [0|0] "" Vector__XXX
 SG_ IC4_IS_OC_FLT m3 : 21|1@0+ (1,0) [0|0] "" Vector__XXX
 SG_ IC4_AN_OT_FLT m3 : 20|1@0+ (1,0) [0|0] "" Vector__XXX
 SG_ IC4_AN_UT_FLT m3 : 19|1@0+ (1,0) [0|0] "" Vector__XXX
 SG_ IC4_CT_OV_FLT m3 : 18|1@0+ (1,0) [0|0] "" Vector__XXX
 SG_ IC4_CT_UV_FLT m3 : 17|1@0+ (1,0) [0|0] "" Vector__XXX
 SG_ IC4_POR m3 : 15|1@0+ (1,0) [0|0] "" Vector__XXX
 SG_ IC4_RESET_FLT m3 : 14|1@0+ (1,0) [0|0] "" Vector__XXX
 SG_ IC4_COM_ERR_OVR_FLT m3 : 13|1@0+ (1,0) [0|0] "" Vector__XXX
 SG_ IC4_VPWR_OV_FLT m3 : 12|1@0+ (1,0) [0|0] "" Vector__XXX
 SG_ IC4_VPWR_LV_FLT m3 : 11|1@0+ (1,0) [0|0] "" Vector__XXX
 SG_ IC4_COM_LOSS_FLT m3 : 10|1@0+ (1,0) [0|0] "" Vector__XXX
 SG_ IC4_COM_ERR_FLT m3 : 9|1@0+ (1,0) [0|0] "" Vector__XXX
 SG_ IC4_CSB_WUP_FLT m3 : 8|1@0+ (1,0) [0|0] "" Vector__XXX
 SG_ IC3_IDLE_MODE_FLT m2 : 24|1@0+ (1,0) [0|0] "" Vector__XXX
 SG_ IC3_AN_OPEN_FLT m2 : 39|1@0+ (1,0) [0|0] "" Vector__XXX
 SG_ IC3_GPIO_SHORT_FLT m2 : 38|1@0+ (1,0) [0|0] "" Vector__XXX
 SG_ IC3_CB_SHORT_FLT m2 : 37|1@0+ (1,0) [0|0] "" Vector__XXX
 SG_ IC3_CB_OPEN_FLT m2 : 36|1@0+ (1,0) [0|0] "" Vector__XXX
 SG_ IC3_OSC_ERR_FLT m2 : 35|1@0+ (1,0) [0|0] "" Vector__XXX
 SG_ IC3_DED_ERR_FLT m2 : 34|1@0+ (1,0) [0|0] "" Vector__XXX
 SG_ IC3_FUSE_ERR_FLT m2 : 33|1@0+ (1,0) [0|0] "" Vector__XXX
 SG_ IC3_VCOM_OV_FLT m2 : 16|1@0+ (1,0) [0|0] "" Vector__XXX
 SG_ IC3_VCOM_UV_FLT m2 : 31|1@0+ (1,0) [0|0] "" Vector__XXX
 SG_ IC3_VANA_OV_FLT m2 : 30|1@0+ (1,0) [0|0] "" Vector__XXX
 SG_ IC3_VANA_UV_FLT m2 : 29|1@0+ (1,0) [0|0] "" Vector__XXX
 SG_ IC3_ADC1_B_FLT m2 : 28|1@0+ (1,0) [0|0] "" Vector__XXX
 SG_ IC3_ADC1_A_FLT m2 : 27|1@0+ (1,0) [0|0] "" Vector__XXX
 SG_ IC3_GND_LOSS_FLT m2 : 26|1@0+ (1,0) [0|0] "" Vector__XXX
 SG_ IC3_IC_TSD_FLT m2 : 25|1@0+ (1,0) [0|0] "" Vector__XXX
 SG_ IC3_GPIO0_WUP_FLT m2 : 23|1@0+ (1,0) [0|0] "" Vector__XXX
 SG_ IC3_IS_OL_FLT m2 : 22|1@0+ (1,0) [0|0] "" Vector__XXX
 SG_ IC3_IS_OC_FLT m2 : 21|1@0+ (1,0) [0|0] "" Vector__XXX
 SG_ IC3_AN_OT_FLT m2 : 20|1@0+ (1,0) [0|0] "" Vector__XXX
 SG_ IC3_AN_UT_FLT m2 : 19|1@0+ (1,0) [0|0] "" Vector__XXX
 SG_ IC3_CT_OV_FLT m2 : 18|1@0+ (1,0) [0|0] "" Vector__XXX
 SG_ IC3_CT_UV_FLT m2 : 17|1@0+ (1,0) [0|0] "" Vector__XXX
 SG_ IC3_POR m2 : 15|1@0+ (1,0) [0|0] "" Vector__XXX
 SG_ IC3_RESET_FLT m2 : 14|1@0+ (1,0) [0|0] "" Vector__XXX
 SG_ IC3_COM_ERR_OVR_FLT m2 : 13|1@0+ (1,0) [0|0] "" Vector__XXX
 SG_ IC3_VPWR_OV_FLT m2 : 12|1@0+ (1,0) [0|0] "" Vector__XXX
 SG_ IC3_VPWR_LV_FLT m2 : 11|1@0+ (1,0) [0|0] "" Vector__XXX
 SG_ IC3_COM_LOSS_FLT m2 : 10|1@0+ (1,0) [0|0] "" Vector__XXX
 SG_ IC3_COM_ERR_FLT m2 : 9|1@0+ (1,0) [0|0] "" Vector__XXX
 SG_ IC3_CSB_WUP_FLT m2 : 8|1@0+ (1,0) [0|0] "" Vector__XXX
 SG_ IC2_IDLE_MODE_FLT m1 : 24|1@0+ (1,0) [0|0] "" Vector__XXX
 SG_ IC2_AN_OPEN_FLT m1 : 39|1@0+ (1,0) [0|0] "" Vector__XXX
 SG_ IC2_GPIO_SHORT_FLT m1 : 38|1@0+ (1,0) [0|0] "" Vector__XXX
 SG_ IC2_CB_SHORT_FLT m1 : 37|1@0+ (1,0) [0|0] "" Vector__XXX
 SG_ IC2_CB_OPEN_FLT m1 : 36|1@0+ (1,0) [0|0] "" Vector__XXX
 SG_ IC2_OSC_ERR_FLT m1 : 35|1@0+ (1,0) [0|0] "" Vector__XXX
 SG_ IC2_DED_ERR_FLT m1 : 34|1@0+ (1,0) [0|0] "" Vector__XXX
 SG_ IC2_FUSE_ERR_FLT m1 : 33|1@0+ (1,0) [0|0] "" Vector__XXX
 SG_ IC2_VCOM_OV_FLT m1 : 16|1@0+ (1,0) [0|0] "" Vector__XXX
 SG_ IC2_VCOM_UV_FLT m1 : 31|1@0+ (1,0) [0|0] "" Vector__XXX
 SG_ IC2_VANA_OV_FLT m1 : 30|1@0+ (1,0) [0|0] "" Vector__XXX
 SG_ IC2_VANA_UV_FLT m1 : 29|1@0+ (1,0) [0|0] "" Vector__XXX
 SG_ IC2_ADC1_B_FLT m1 : 28|1@0+ (1,0) [0|0] "" Vector__XXX
 SG_ IC2_ADC1_A_FLT m1 : 27|1@0+ (1,0) [0|0] "" Vector__XXX
 SG_ IC2_GND_LOSS_FLT m1 : 26|1@0+ (1,0) [0|0] "" Vector__XXX
 SG_ IC2_IC_TSD_FLT m1 : 25|1@0+ (1,0) [0|0] "" Vector__XXX
 SG_ IC2_GPIO0_WUP_FLT m1 : 23|1@0+ (1,0) [0|0] "" Vector__XXX
 SG_ IC2_IS_OL_FLT m1 : 22|1@0+ (1,0) [0|0] "" Vector__XXX
 SG_ IC2_IS_OC_FLT m1 : 21|1@0+ (1,0) [0|0] "" Vector__XXX
 SG_ IC2_AN_OT_FLT m1 : 20|1@0+ (1,0) [0|0] "" Vector__XXX
 SG_ IC2_AN_UT_FLT m1 : 19|1@0+ (1,0) [0|0] "" Vector__XXX
 SG_ IC2_CT_OV_FLT m1 : 18|1@0+ (1,0) [0|0] "" Vector__XXX
 SG_ IC2_CT_UV_FLT m1 : 17|1@0+ (1,0) [0|0] "" Vector__XXX
 SG_ IC2_POR m1 : 15|1@0+ (1,0) [0|0] "" Vector__XXX
 SG_ IC2_RESET_FLT m1 : 14|1@0+ (1,0) [0|0] "" Vector__XXX
 SG_ IC2_COM_ERR_OVR_FLT m1 : 13|1@0+ (1,0) [0|0] "" Vector__XXX
 SG_ IC2_VPWR_OV_FLT m1 : 12|1@0+ (1,0) [0|0] "" Vector__XXX
 SG_ IC2_VPWR_LV_FLT m1 : 11|1@0+ (1,0) [0|0] "" Vector__XXX
 SG_ IC2_COM_LOSS_FLT m1 : 10|1@0+ (1,0) [0|0] "" Vector__XXX
 SG_ IC2_COM_ERR_FLT m1 : 9|1@0+ (1,0) [0|0] "" Vector__XXX
 SG_ IC2_CSB_WUP_FLT m1 : 8|1@0+ (1,0) [0|0] "" Vector__XXX
 SG_ IC1_IDLE_MODE_FLT m0 : 24|1@0+ (1,0) [0|0] "" Vector__XXX
 SG_ IC1_AN_OPEN_FLT m0 : 39|1@0+ (1,0) [0|0] "" Vector__XXX
 SG_ IC1_GPIO_SHORT_FLT m0 : 38|1@0+ (1,0) [0|0] "" Vector__XXX
 SG_ IC1_CB_SHORT_FLT m0 : 37|1@0+ (1,0) [0|0] "" Vector__XXX
 SG_ IC1_CB_OPEN_FLT m0 : 36|1@0+ (1,0) [0|0] "" Vector__XXX
 SG_ IC1_OSC_ERR_FLT m0 : 35|1@0+ (1,0) [0|0] "" Vector__XXX
 SG_ IC1_DED_ERR_FLT m0 : 34|1@0+ (1,0) [0|0] "" Vector__XXX
 SG_ IC1_FUSE_ERR_FLT m0 : 33|1@0+ (1,0) [0|0] "" Vector__XXX
 SG_ IC1_VCOM_OV_FLT m0 : 16|1@0+ (1,0) [0|0] "" Vector__XXX
 SG_ IC1_VCOM_UV_FLT m0 : 31|1@0+ (1,0) [0|0] "" Vector__XXX
 SG_ IC1_VANA_OV_FLT m0 : 30|1@0+ (1,0) [0|0] "" Vector__XXX
 SG_ IC1_VANA_UV_FLT m0 : 29|1@0+ (1,0) [0|0] "" Vector__XXX
 SG_ IC1_ADC1_B_FLT m0 : 28|1@0+ (1,0) [0|0] "" Vector__XXX
 SG_ IC1_ADC1_A_FLT m0 : 27|1@0+ (1,0) [0|0] "" Vector__XXX
 SG_ IC1_GND_LOSS_FLT m0 : 26|1@0+ (1,0) [0|0] "" Vector__XXX
 SG_ IC1_IC_TSD_FLT m0 : 25|1@0+ (1,0) [0|0] "" Vector__XXX
 SG_ IC1_GPIO0_WUP_FLT m0 : 23|1@0+ (1,0) [0|0] "" Vector__XXX
 SG_ IC1_IS_OL_FLT m0 : 22|1@0+ (1,0) [0|0] "" Vector__XXX
 SG_ IC1_IS_OC_FLT m0 : 21|1@0+ (1,0) [0|0] "" Vector__XXX
 SG_ IC1_AN_OT_FLT m0 : 20|1@0+ (1,0) [0|0] "" Vector__XXX
 SG_ IC1_AN_UT_FLT m0 : 19|1@0+ (1,0) [0|0] "" Vector__XXX
 SG_ IC1_CT_OV_FLT m0 : 18|1@0+ (1,0) [0|0] "" Vector__XXX
 SG_ IC1_CT_UV_FLT m0 : 17|1@0+ (1,0) [0|0] "" Vector__XXX
 SG_ IC1_POR m0 : 15|1@0+ (1,0) [0|0] "" Vector__XXX
 SG_ IC1_RESET_FLT m0 : 14|1@0+ (1,0) [0|0] "" Vector__XXX
 SG_ IC1_COM_ERR_OVR_FLT m0 : 13|1@0+ (1,0) [0|0] "" Vector__XXX
 SG_ IC1_VPWR_OV_FLT m0 : 12|1@0+ (1,0) [0|0] "" Vector__XXX
 SG_ IC1_VPWR_LV_FLT m0 : 11|1@0+ (1,0) [0|0] "" Vector__XXX
 SG_ IC1_COM_LOSS_FLT m0 : 10|1@0+ (1,0) [0|0] "" Vector__XXX
 SG_ IC1_COM_ERR_FLT m0 : 9|1@0+ (1,0) [0|0] "" Vector__XXX
 SG_ IC1_CSB_WUP_FLT m0 : 8|1@0+ (1,0) [0|0] "" Vector__XXX
 SG_ CSC01_IndexFaults M : 7|8@0+ (1,0) [0|255] "" Vector__XXX

BO_ 2550267906 CSC02_CIDs_FAULTS: 8 CSC02
 SG_ IC4_IDLE_MODE_FLT m3 : 24|1@0+ (1,0) [0|0] "" Vector__XXX
 SG_ IC4_AN_OPEN_FLT m3 : 39|1@0+ (1,0) [0|0] "" Vector__XXX
 SG_ IC4_GPIO_SHORT_FLT m3 : 38|1@0+ (1,0) [0|0] "" Vector__XXX
 SG_ IC4_CB_SHORT_FLT m3 : 37|1@0+ (1,0) [0|0] "" Vector__XXX
 SG_ IC4_CB_OPEN_FLT m3 : 36|1@0+ (1,0) [0|0] "" Vector__XXX
 SG_ IC4_OSC_ERR_FLT m3 : 35|1@0+ (1,0) [0|0] "" Vector__XXX
 SG_ IC4_DED_ERR_FLT m3 : 34|1@0+ (1,0) [0|0] "" Vector__XXX
 SG_ IC4_FUSE_ERR_FLT m3 : 33|1@0+ (1,0) [0|0] "" Vector__XXX
 SG_ IC4_VCOM_OV_FLT m3 : 16|1@0+ (1,0) [0|0] "" Vector__XXX
 SG_ IC4_VCOM_UV_FLT m3 : 31|1@0+ (1,0) [0|0] "" Vector__XXX
 SG_ IC4_VANA_OV_FLT m3 : 30|1@0+ (1,0) [0|0] "" Vector__XXX
 SG_ IC4_VANA_UV_FLT m3 : 29|1@0+ (1,0) [0|0] "" Vector__XXX
 SG_ IC4_ADC1_B_FLT m3 : 28|1@0+ (1,0) [0|0] "" Vector__XXX
 SG_ IC4_ADC1_A_FLT m3 : 27|1@0+ (1,0) [0|0] "" Vector__XXX
 SG_ IC4_GND_LOSS_FLT m3 : 26|1@0+ (1,0) [0|0] "" Vector__XXX
 SG_ IC4_IC_TSD_FLT m3 : 25|1@0+ (1,0) [0|0] "" Vector__XXX
 SG_ IC4_GPIO0_WUP_FLT m3 : 23|1@0+ (1,0) [0|0] "" Vector__XXX
 SG_ IC4_IS_OL_FLT m3 : 22|1@0+ (1,0) [0|0] "" Vector__XXX
 SG_ IC4_IS_OC_FLT m3 : 21|1@0+ (1,0) [0|0] "" Vector__XXX
 SG_ IC4_AN_OT_FLT m3 : 20|1@0+ (1,0) [0|0] "" Vector__XXX
 SG_ IC4_AN_UT_FLT m3 : 19|1@0+ (1,0) [0|0] "" Vector__XXX
 SG_ IC4_CT_OV_FLT m3 : 18|1@0+ (1,0) [0|0] "" Vector__XXX
 SG_ IC4_CT_UV_FLT m3 : 17|1@0+ (1,0) [0|0] "" Vector__XXX
 SG_ IC4_POR m3 : 15|1@0+ (1,0) [0|0] "" Vector__XXX
 SG_ IC4_RESET_FLT m3 : 14|1@0+ (1,0) [0|0] "" Vector__XXX
 SG_ IC4_COM_ERR_OVR_FLT m3 : 13|1@0+ (1,0) [0|0] "" Vector__XXX
 SG_ IC4_VPWR_OV_FLT m3 : 12|1@0+ (1,0) [0|0] "" Vector__XXX
 SG_ IC4_VPWR_LV_FLT m3 : 11|1@0+ (1,0) [0|0] "" Vector__XXX
 SG_ IC4_COM_LOSS_FLT m3 : 10|1@0+ (1,0) [0|0] "" Vector__XXX
 SG_ IC4_COM_ERR_FLT m3 : 9|1@0+ (1,0) [0|0] "" Vector__XXX
 SG_ IC4_CSB_WUP_FLT m3 : 8|1@0+ (1,0) [0|0] "" Vector__XXX
 SG_ IC3_IDLE_MODE_FLT m2 : 24|1@0+ (1,0) [0|0] "" Vector__XXX
 SG_ IC3_AN_OPEN_FLT m2 : 39|1@0+ (1,0) [0|0] "" Vector__XXX
 SG_ IC3_GPIO_SHORT_FLT m2 : 38|1@0+ (1,0) [0|0] "" Vector__XXX
 SG_ IC3_CB_SHORT_FLT m2 : 37|1@0+ (1,0) [0|0] "" Vector__XXX
 SG_ IC3_CB_OPEN_FLT m2 : 36|1@0+ (1,0) [0|0] "" Vector__XXX
 SG_ IC3_OSC_ERR_FLT m2 : 35|1@0+ (1,0) [0|0] "" Vector__XXX
 SG_ IC3_DED_ERR_FLT m2 : 34|1@0+ (1,0) [0|0] "" Vector__XXX
 SG_ IC3_FUSE_ERR_FLT m2 : 33|1@0+ (1,0) [0|0] "" Vector__XXX
 SG_ IC3_VCOM_OV_FLT m2 : 16|1@0+ (1,0) [0|0] "" Vector__XXX
 SG_ IC3_VCOM_UV_FLT m2 : 31|1@0+ (1,0) [0|0] "" Vector__XXX
 SG_ IC3_VANA_OV_FLT m2 : 30|1@0+ (1,0) [0|0] "" Vector__XXX
 SG_ IC3_VANA_UV_FLT m2 : 29|1@0+ (1,0) [0|0] "" Vector__XXX
 SG_ IC3_ADC1_B_FLT m2 : 28|1@0+ (1,0) [0|0] "" Vector__XXX
 SG_ IC3_ADC1_A_FLT m2 : 27|1@0+ (1,0) [0|0] "" Vector__XXX
 SG_ IC3_GND_LOSS_FLT m2 : 26|1@0+ (1,0) [0|0] "" Vector__XXX
 SG_ IC3_IC_TSD_FLT m2 : 25|1@0+ (1,0) [0|0] "" Vector__XXX
 SG_ IC3_GPIO0_WUP_FLT m2 : 23|1@0+ (1,0) [0|0] "" Vector__XXX
 SG_ IC3_IS_OL_FLT m2 : 22|1@0+ (1,0) [0|0] "" Vector__XXX
 SG_ IC3_IS_OC_FLT m2 : 21|1@0+ (1,0) [0|0] "" Vector__XXX
 SG_ IC3_AN_OT_FLT m2 : 20|1@0+ (1,0) [0|0] "" Vector__XXX
 SG_ IC3_AN_UT_FLT m2 : 19|1@0+ (1,0) [0|0] "" Vector__XXX
 SG_ IC3_CT_OV_FLT m2 : 18|1@0+ (1,0) [0|0] "" Vector__XXX
 SG_ IC3_CT_UV_FLT m2 : 17|1@0+ (1,0) [0|0] "" Vector__XXX
 SG_ IC3_POR m2 : 15|1@0+ (1,0) [0|0] "" Vector__XXX
 SG_ IC3_RESET_FLT m2 : 14|1@0+ (1,0) [0|0] "" Vector__XXX
 SG_ IC3_COM_ERR_OVR_FLT m2 : 13|1@0+ (1,0) [0|0] "" Vector__XXX
 SG_ IC3_VPWR_OV_FLT m2 : 12|1@0+ (1,0) [0|0] "" Vector__XXX
 SG_ IC3_VPWR_LV_FLT m2 : 11|1@0+ (1,0) [0|0] "" Vector__XXX
 SG_ IC3_COM_LOSS_FLT m2 : 10|1@0+ (1,0) [0|0] "" Vector__XXX
 SG_ IC3_COM_ERR_FLT m2 : 9|1@0+ (1,0) [0|0] "" Vector__XXX
 SG_ IC3_CSB_WUP_FLT m2 : 8|1@0+ (1,0) [0|0] "" Vector__XXX
 SG_ IC2_IDLE_MODE_FLT m1 : 24|1@0+ (1,0) [0|0] "" Vector__XXX
 SG_ IC2_AN_OPEN_FLT m1 : 39|1@0+ (1,0) [0|0] "" Vector__XXX
 SG_ IC2_GPIO_SHORT_FLT m1 : 38|1@0+ (1,0) [0|0] "" Vector__XXX
 SG_ IC2_CB_SHORT_FLT m1 : 37|1@0+ (1,0) [0|0] "" Vector__XXX
 SG_ IC2_CB_OPEN_FLT m1 : 36|1@0+ (1,0) [0|0] "" Vector__XXX
 SG_ IC2_OSC_ERR_FLT m1 : 35|1@0+ (1,0) [0|0] "" Vector__XXX
 SG_ IC2_DED_ERR_FLT m1 : 34|1@0+ (1,0) [0|0] "" Vector__XXX
 SG_ IC2_FUSE_ERR_FLT m1 : 33|1@0+ (1,0) [0|0] "" Vector__XXX
 SG_ IC2_VCOM_OV_FLT m1 : 16|1@0+ (1,0) [0|0] "" Vector__XXX
 SG_ IC2_VCOM_UV_FLT m1 : 31|1@0+ (1,0) [0|0] "" Vector__XXX
 SG_ IC2_VANA_OV_FLT m1 : 30|1@0+ (1,0) [0|0] "" Vector__XXX
 SG_ IC2_VANA_UV_FLT m1 : 29|1@0+ (1,0) [0|0] "" Vector__XXX
 SG_ IC2_ADC1_B_FLT m1 : 28|1@0+ (1,0) [0|0] "" Vector__XXX
 SG_ IC2_ADC1_A_FLT m1 : 27|1@0+ (1,0) [0|0] "" Vector__XXX
 SG_ IC2_GND_LOSS_FLT m1 : 26|1@0+ (1,0) [0|0] "" Vector__XXX
 SG_ IC2_IC_TSD_FLT m1 : 25|1@0+ (1,0) [0|0] "" Vector__XXX
 SG_ IC2_GPIO0_WUP_FLT m1 : 23|1@0+ (1,0) [0|0] "" Vector__XXX
 SG_ IC2_IS_OL_FLT m1 : 22|1@0+ (1,0) [0|0] "" Vector__XXX
 SG_ IC2_IS_OC_FLT m1 : 21|1@0+ (1,0) [0|0] "" Vector__XXX
 SG_ IC2_AN_OT_FLT m1 : 20|1@0+ (1,0) [0|0] "" Vector__XXX
 SG_ IC2_AN_UT_FLT m1 : 19|1@0+ (1,0) [0|0] "" Vector__XXX
 SG_ IC2_CT_OV_FLT m1 : 18|1@0+ (1,0) [0|0] "" Vector__XXX
 SG_ IC2_CT_UV_FLT m1 : 17|1@0+ (1,0) [0|0] "" Vector__XXX
 SG_ IC2_POR m1 : 15|1@0+ (1,0) [0|0] "" Vector__XXX
 SG_ IC2_RESET_FLT m1 : 14|1@0+ (1,0) [0|0] "" Vector__XXX
 SG_ IC2_COM_ERR_OVR_FLT m1 : 13|1@0+ (1,0) [0|0] "" Vector__XXX
 SG_ IC2_VPWR_OV_FLT m1 : 12|1@0+ (1,0) [0|0] "" Vector__XXX
 SG_ IC2_VPWR_LV_FLT m1 : 11|1@0+ (1,0) [0|0] "" Vector__XXX
 SG_ IC2_COM_LOSS_FLT m1 : 10|1@0+ (1,0) [0|0] "" Vector__XXX
 SG_ IC2_COM_ERR_FLT m1 : 9|1@0+ (1,0) [0|0] "" Vector__XXX
 SG_ IC2_CSB_WUP_FLT m1 : 8|1@0+ (1,0) [0|0] "" Vector__XXX
 SG_ IC1_IDLE_MODE_FLT m0 : 24|1@0+ (1,0) [0|0] "" Vector__XXX
 SG_ IC1_AN_OPEN_FLT m0 : 39|1@0+ (1,0) [0|0] "" Vector__XXX
 SG_ IC1_GPIO_SHORT_FLT m0 : 38|1@0+ (1,0) [0|0] "" Vector__XXX
 SG_ IC1_CB_SHORT_FLT m0 : 37|1@0+ (1,0) [0|0] "" Vector__XXX
 SG_ IC1_CB_OPEN_FLT m0 : 36|1@0+ (1,0) [0|0] "" Vector__XXX
 SG_ IC1_OSC_ERR_FLT m0 : 35|1@0+ (1,0) [0|0] "" Vector__XXX
 SG_ IC1_DED_ERR_FLT m0 : 34|1@0+ (1,0) [0|0] "" Vector__XXX
 SG_ IC1_FUSE_ERR_FLT m0 : 33|1@0+ (1,0) [0|0] "" Vector__XXX
 SG_ IC1_VCOM_OV_FLT m0 : 16|1@0+ (1,0) [0|0] "" Vector__XXX
 SG_ IC1_VCOM_UV_FLT m0 : 31|1@0+ (1,0) [0|0] "" Vector__XXX
 SG_ IC1_VANA_OV_FLT m0 : 30|1@0+ (1,0) [0|0] "" Vector__XXX
 SG_ IC1_VANA_UV_FLT m0 : 29|1@0+ (1,0) [0|0] "" Vector__XXX
 SG_ IC1_ADC1_B_FLT m0 : 28|1@0+ (1,0) [0|0] "" Vector__XXX
 SG_ IC1_ADC1_A_FLT m0 : 27|1@0+ (1,0) [0|0] "" Vector__XXX
 SG_ IC1_GND_LOSS_FLT m0 : 26|1@0+ (1,0) [0|0] "" Vector__XXX
 SG_ IC1_IC_TSD_FLT m0 : 25|1@0+ (1,0) [0|0] "" Vector__XXX
 SG_ IC1_GPIO0_WUP_FLT m0 : 23|1@0+ (1,0) [0|0] "" Vector__XXX
 SG_ IC1_IS_OL_FLT m0 : 22|1@0+ (1,0) [0|0] "" Vector__XXX
 SG_ IC1_IS_OC_FLT m0 : 21|1@0+ (1,0) [0|0] "" Vector__XXX
 SG_ IC1_AN_OT_FLT m0 : 20|1@0+ (1,0) [0|0] "" Vector__XXX
 SG_ IC1_AN_UT_FLT m0 : 19|1@0+ (1,0) [0|0] "" Vector__XXX
 SG_ IC1_CT_OV_FLT m0 : 18|1@0+ (1,0) [0|0] "" Vector__XXX
 SG_ IC1_CT_UV_FLT m0 : 17|1@0+ (1,0) [0|0] "" Vector__XXX
 SG_ IC1_POR m0 : 15|1@0+ (1,0) [0|0] "" Vector__XXX
 SG_ IC1_RESET_FLT m0 : 14|1@0+ (1,0) [0|0] "" Vector__XXX
 SG_ IC1_COM_ERR_OVR_FLT m0 : 13|1@0+ (1,0) [0|0] "" Vector__XXX
 SG_ IC1_VPWR_OV_FLT m0 : 12|1@0+ (1,0) [0|0] "" Vector__XXX
 SG_ IC1_VPWR_LV_FLT m0 : 11|1@0+ (1,0) [0|0] "" Vector__XXX
 SG_ IC1_COM_LOSS_FLT m0 : 10|1@0+ (1,0) [0|0] "" Vector__XXX
 SG_ IC1_COM_ERR_FLT m0 : 9|1@0+ (1,0) [0|0] "" Vector__XXX
 SG_ IC1_CSB_WUP_FLT m0 : 8|1@0+ (1,0) [0|0] "" Vector__XXX
 SG_ CSC02_IndexFaults M : 7|8@0+ (1,0) [0|255] "" Vector__XXX

BO_ 2550333442 CSC03_CIDs_FAULTS: 8 CSC03
 SG_ IC4_IDLE_MODE_FLT m3 : 24|1@0+ (1,0) [0|0] "" Vector__XXX
 SG_ IC4_AN_OPEN_FLT m3 : 39|1@0+ (1,0) [0|0] "" Vector__XXX
 SG_ IC4_GPIO_SHORT_FLT m3 : 38|1@0+ (1,0) [0|0] "" Vector__XXX
 SG_ IC4_CB_SHORT_FLT m3 : 37|1@0+ (1,0) [0|0] "" Vector__XXX
 SG_ IC4_CB_OPEN_FLT m3 : 36|1@0+ (1,0) [0|0] "" Vector__XXX
 SG_ IC4_OSC_ERR_FLT m3 : 35|1@0+ (1,0) [0|0] "" Vector__XXX
 SG_ IC4_DED_ERR_FLT m3 : 34|1@0+ (1,0) [0|0] "" Vector__XXX
 SG_ IC4_FUSE_ERR_FLT m3 : 33|1@0+ (1,0) [0|0] "" Vector__XXX
 SG_ IC4_VCOM_OV_FLT m3 : 16|1@0+ (1,0) [0|0] "" Vector__XXX
 SG_ IC4_VCOM_UV_FLT m3 : 31|1@0+ (1,0) [0|0] "" Vector__XXX
 SG_ IC4_VANA_OV_FLT m3 : 30|1@0+ (1,0) [0|0] "" Vector__XXX
 SG_ IC4_VANA_UV_FLT m3 : 29|1@0+ (1,0) [0|0] "" Vector__XXX
 SG_ IC4_ADC1_B_FLT m3 : 28|1@0+ (1,0) [0|0] "" Vector__XXX
 SG_ IC4_ADC1_A_FLT m3 : 27|1@0+ (1,0) [0|0] "" Vector__XXX
 SG_ IC4_GND_LOSS_FLT m3 : 26|1@0+ (1,0) [0|0] "" Vector__XXX
 SG_ IC4_IC_TSD_FLT m3 : 25|1@0+ (1,0) [0|0] "" Vector__XXX
 SG_ IC4_GPIO0_WUP_FLT m3 : 23|1@0+ (1,0) [0|0] "" Vector__XXX
 SG_ IC4_IS_OL_FLT m3 : 22|1@0+ (1,0) [0|0] "" Vector__XXX
 SG_ IC4_IS_OC_FLT m3 : 21|1@0+ (1,0) [0|0] "" Vector__XXX
 SG_ IC4_AN_OT_FLT m3 : 20|1@0+ (1,0) [0|0] "" Vector__XXX
 SG_ IC4_AN_UT_FLT m3 : 19|1@0+ (1,0) [0|0] "" Vector__XXX
 SG_ IC4_CT_OV_FLT m3 : 18|1@0+ (1,0) [0|0] "" Vector__XXX
 SG_ IC4_CT_UV_FLT m3 : 17|1@0+ (1,0) [0|0] "" Vector__XXX
 SG_ IC4_POR m3 : 15|1@0+ (1,0) [0|0] "" Vector__XXX
 SG_ IC4_RESET_FLT m3 : 14|1@0+ (1,0) [0|0] "" Vector__XXX
 SG_ IC4_COM_ERR_OVR_FLT m3 : 13|1@0+ (1,0) [0|0] "" Vector__XXX
 SG_ IC4_VPWR_OV_FLT m3 : 12|1@0+ (1,0) [0|0] "" Vector__XXX
 SG_ IC4_VPWR_LV_FLT m3 : 11|1@0+ (1,0) [0|0] "" Vector__XXX
 SG_ IC4_COM_LOSS_FLT m3 : 10|1@0+ (1,0) [0|0] "" Vector__XXX
 SG_ IC4_COM_ERR_FLT m3 : 9|1@0+ (1,0) [0|0] "" Vector__XXX
 SG_ IC4_CSB_WUP_FLT m3 : 8|1@0+ (1,0) [0|0] "" Vector__XXX
 SG_ IC3_IDLE_MODE_FLT m2 : 24|1@0+ (1,0) [0|0] "" Vector__XXX
 SG_ IC3_AN_OPEN_FLT m2 : 39|1@0+ (1,0) [0|0] "" Vector__XXX
 SG_ IC3_GPIO_SHORT_FLT m2 : 38|1@0+ (1,0) [0|0] "" Vector__XXX
 SG_ IC3_CB_SHORT_FLT m2 : 37|1@0+ (1,0) [0|0] "" Vector__XXX
 SG_ IC3_CB_OPEN_FLT m2 : 36|1@0+ (1,0) [0|0] "" Vector__XXX
 SG_ IC3_OSC_ERR_FLT m2 : 35|1@0+ (1,0) [0|0] "" Vector__XXX
 SG_ IC3_DED_ERR_FLT m2 : 34|1@0+ (1,0) [0|0] "" Vector__XXX
 SG_ IC3_FUSE_ERR_FLT m2 : 33|1@0+ (1,0) [0|0] "" Vector__XXX
 SG_ IC3_VCOM_OV_FLT m2 : 16|1@0+ (1,0) [0|0] "" Vector__XXX
 SG_ IC3_VCOM_UV_FLT m2 : 31|1@0+ (1,0) [0|0] "" Vector__XXX
 SG_ IC3_VANA_OV_FLT m2 : 30|1@0+ (1,0) [0|0] "" Vector__XXX
 SG_ IC3_VANA_UV_FLT m2 : 29|1@0+ (1,0) [0|0] "" Vector__XXX
 SG_ IC3_ADC1_B_FLT m2 : 28|1@0+ (1,0) [0|0] "" Vector__XXX
 SG_ IC3_ADC1_A_FLT m2 : 27|1@0+ (1,0) [0|0] "" Vector__XXX
 SG_ IC3_GND_LOSS_FLT m2 : 26|1@0+ (1,0) [0|0] "" Vector__XXX
 SG_ IC3_IC_TSD_FLT m2 : 25|1@0+ (1,0) [0|0] "" Vector__XXX
 SG_ IC3_GPIO0_WUP_FLT m2 : 23|1@0+ (1,0) [0|0] "" Vector__XXX
 SG_ IC3_IS_OL_FLT m2 : 22|1@0+ (1,0) [0|0] "" Vector__XXX
 SG_ IC3_IS_OC_FLT m2 : 21|1@0+ (1,0) [0|0] "" Vector__XXX
 SG_ IC3_AN_OT_FLT m2 : 20|1@0+ (1,0) [0|0] "" Vector__XXX
 SG_ IC3_AN_UT_FLT m2 : 19|1@0+ (1,0) [0|0] "" Vector__XXX
 SG_ IC3_CT_OV_FLT m2 : 18|1@0+ (1,0) [0|0] "" Vector__XXX
 SG_ IC3_CT_UV_FLT m2 : 17|1@0+ (1,0) [0|0] "" Vector__XXX
 SG_ IC3_POR m2 : 15|1@0+ (1,0) [0|0] "" Vector__XXX
 SG_ IC3_RESET_FLT m2 : 14|1@0+ (1,0) [0|0] "" Vector__XXX
 SG_ IC3_COM_ERR_OVR_FLT m2 : 13|1@0+ (1,0) [0|0] "" Vector__XXX
 SG_ IC3_VPWR_OV_FLT m2 : 12|1@0+ (1,0) [0|0] "" Vector__XXX
 SG_ IC3_VPWR_LV_FLT m2 : 11|1@0+ (1,0) [0|0] "" Vector__XXX
 SG_ IC3_COM_LOSS_FLT m2 : 10|1@0+ (1,0) [0|0] "" Vector__XXX
 SG_ IC3_COM_ERR_FLT m2 : 9|1@0+ (1,0) [0|0] "" Vector__XXX
 SG_ IC3_CSB_WUP_FLT m2 : 8|1@0+ (1,0) [0|0] "" Vector__XXX
 SG_ IC2_IDLE_MODE_FLT m1 : 24|1@0+ (1,0) [0|0] "" Vector__XXX
 SG_ IC2_AN_OPEN_FLT m1 : 39|1@0+ (1,0) [0|0] "" Vector__XXX
 SG_ IC2_GPIO_SHORT_FLT m1 : 38|1@0+ (1,0) [0|0] "" Vector__XXX
 SG_ IC2_CB_SHORT_FLT m1 : 37|1@0+ (1,0) [0|0] "" Vector__XXX
 SG_ IC2_CB_OPEN_FLT m1 : 36|1@0+ (1,0) [0|0] "" Vector__XXX
 SG_ IC2_OSC_ERR_FLT m1 : 35|1@0+ (1,0) [0|0] "" Vector__XXX
 SG_ IC2_DED_ERR_FLT m1 : 34|1@0+ (1,0) [0|0] "" Vector__XXX
 SG_ IC2_FUSE_ERR_FLT m1 : 33|1@0+ (1,0) [0|0] "" Vector__XXX
 SG_ IC2_VCOM_OV_FLT m1 : 16|1@0+ (1,0) [0|0] "" Vector__XXX
 SG_ IC2_VCOM_UV_FLT m1 : 31|1@0+ (1,0) [0|0] "" Vector__XXX
 SG_ IC2_VANA_OV_FLT m1 : 30|1@0+ (1,0) [0|0] "" Vector__XXX
 SG_ IC2_VANA_UV_FLT m1 : 29|1@0+ (1,0) [0|0] "" Vector__XXX
 SG_ IC2_ADC1_B_FLT m1 : 28|1@0+ (1,0) [0|0] "" Vector__XXX
 SG_ IC2_ADC1_A_FLT m1 : 27|1@0+ (1,0) [0|0] "" Vector__XXX
 SG_ IC2_GND_LOSS_FLT m1 : 26|1@0+ (1,0) [0|0] "" Vector__XXX
 SG_ IC2_IC_TSD_FLT m1 : 25|1@0+ (1,0) [0|0] "" Vector__XXX
 SG_ IC2_GPIO0_WUP_FLT m1 : 23|1@0+ (1,0) [0|0] "" Vector__XXX
 SG_ IC2_IS_OL_FLT m1 : 22|1@0+ (1,0) [0|0] "" Vector__XXX
 SG_ IC2_IS_OC_FLT m1 : 21|1@0+ (1,0) [0|0] "" Vector__XXX
 SG_ IC2_AN_OT_FLT m1 : 20|1@0+ (1,0) [0|0] "" Vector__XXX
 SG_ IC2_AN_UT_FLT m1 : 19|1@0+ (1,0) [0|0] "" Vector__XXX
 SG_ IC2_CT_OV_FLT m1 : 18|1@0+ (1,0) [0|0] "" Vector__XXX
 SG_ IC2_CT_UV_FLT m1 : 17|1@0+ (1,0) [0|0] "" Vector__XXX
 SG_ IC2_POR m1 : 15|1@0+ (1,0) [0|0] "" Vector__XXX
 SG_ IC2_RESET_FLT m1 : 14|1@0+ (1,0) [0|0] "" Vector__XXX
 SG_ IC2_COM_ERR_OVR_FLT m1 : 13|1@0+ (1,0) [0|0] "" Vector__XXX
 SG_ IC2_VPWR_OV_FLT m1 : 12|1@0+ (1,0) [0|0] "" Vector__XXX
 SG_ IC2_VPWR_LV_FLT m1 : 11|1@0+ (1,0) [0|0] "" Vector__XXX
 SG_ IC2_COM_LOSS_FLT m1 : 10|1@0+ (1,0) [0|0] "" Vector__XXX
 SG_ IC2_COM_ERR_FLT m1 : 9|1@0+ (1,0) [0|0] "" Vector__XXX
 SG_ IC2_CSB_WUP_FLT m1 : 8|1@0+ (1,0) [0|0] "" Vector__XXX
 SG_ IC1_IDLE_MODE_FLT m0 : 24|1@0+ (1,0) [0|0] "" Vector__XXX
 SG_ IC1_AN_OPEN_FLT m0 : 39|1@0+ (1,0) [0|0] "" Vector__XXX
 SG_ IC1_GPIO_SHORT_FLT m0 : 38|1@0+ (1,0) [0|0] "" Vector__XXX
 SG_ IC1_CB_SHORT_FLT m0 : 37|1@0+ (1,0) [0|0] "" Vector__XXX
 SG_ IC1_CB_OPEN_FLT m0 : 36|1@0+ (1,0) [0|0] "" Vector__XXX
 SG_ IC1_OSC_ERR_FLT m0 : 35|1@0+ (1,0) [0|0] "" Vector__XXX
 SG_ IC1_DED_ERR_FLT m0 : 34|1@0+ (1,0) [0|0] "" Vector__XXX
 SG_ IC1_FUSE_ERR_FLT m0 : 33|1@0+ (1,0) [0|0] "" Vector__XXX
 SG_ IC1_VCOM_OV_FLT m0 : 16|1@0+ (1,0) [0|0] "" Vector__XXX
 SG_ IC1_VCOM_UV_FLT m0 : 31|1@0+ (1,0) [0|0] "" Vector__XXX
 SG_ IC1_VANA_OV_FLT m0 : 30|1@0+ (1,0) [0|0] "" Vector__XXX
 SG_ IC1_VANA_UV_FLT m0 : 29|1@0+ (1,0) [0|0] "" Vector__XXX
 SG_ IC1_ADC1_B_FLT m0 : 28|1@0+ (1,0) [0|0] "" Vector__XXX
 SG_ IC1_ADC1_A_FLT m0 : 27|1@0+ (1,0) [0|0] "" Vector__XXX
 SG_ IC1_GND_LOSS_FLT m0 : 26|1@0+ (1,0) [0|0] "" Vector__XXX
 SG_ IC1_IC_TSD_FLT m0 : 25|1@0+ (1,0) [0|0] "" Vector__XXX
 SG_ IC1_GPIO0_WUP_FLT m0 : 23|1@0+ (1,0) [0|0] "" Vector__XXX
 SG_ IC1_IS_OL_FLT m0 : 22|1@0+ (1,0) [0|0] "" Vector__XXX
 SG_ IC1_IS_OC_FLT m0 : 21|1@0+ (1,0) [0|0] "" Vector__XXX
 SG_ IC1_AN_OT_FLT m0 : 20|1@0+ (1,0) [0|0] "" Vector__XXX
 SG_ IC1_AN_UT_FLT m0 : 19|1@0+ (1,0) [0|0] "" Vector__XXX
 SG_ IC1_CT_OV_FLT m0 : 18|1@0+ (1,0) [0|0] "" Vector__XXX
 SG_ IC1_CT_UV_FLT m0 : 17|1@0+ (1,0) [0|0] "" Vector__XXX
 SG_ IC1_POR m0 : 15|1@0+ (1,0) [0|0] "" Vector__XXX
 SG_ IC1_RESET_FLT m0 : 14|1@0+ (1,0) [0|0] "" Vector__XXX
 SG_ IC1_COM_ERR_OVR_FLT m0 : 13|1@0+ (1,0) [0|0] "" Vector__XXX
 SG_ IC1_VPWR_OV_FLT m0 : 12|1@0+ (1,0) [0|0] "" Vector__XXX
 SG_ IC1_VPWR_LV_FLT m0 : 11|1@0+ (1,0) [0|0] "" Vector__XXX
 SG_ IC1_COM_LOSS_FLT m0 : 10|1@0+ (1,0) [0|0] "" Vector__XXX
 SG_ IC1_COM_ERR_FLT m0 : 9|1@0+ (1,0) [0|0] "" Vector__XXX
 SG_ IC1_CSB_WUP_FLT m0 : 8|1@0+ (1,0) [0|0] "" Vector__XXX
 SG_ CSC03_IndexFaults M : 7|8@0+ (1,0) [0|255] "" Vector__XXX

BO_ 2550398978 CSC04_CIDs_FAULTS: 8 CSC04
 SG_ IC4_IDLE_MODE_FLT m3 : 24|1@0+ (1,0) [0|0] "" Vector__XXX
 SG_ IC4_AN_OPEN_FLT m3 : 39|1@0+ (1,0) [0|0] "" Vector__XXX
 SG_ IC4_GPIO_SHORT_FLT m3 : 38|1@0+ (1,0) [0|0] "" Vector__XXX
 SG_ IC4_CB_SHORT_FLT m3 : 37|1@0+ (1,0) [0|0] "" Vector__XXX
 SG_ IC4_CB_OPEN_FLT m3 : 36|1@0+ (1,0) [0|0] "" Vector__XXX
 SG_ IC4_OSC_ERR_FLT m3 : 35|1@0+ (1,0) [0|0] "" Vector__XXX
 SG_ IC4_DED_ERR_FLT m3 : 34|1@0+ (1,0) [0|0] "" Vector__XXX
 SG_ IC4_FUSE_ERR_FLT m3 : 33|1@0+ (1,0) [0|0] "" Vector__XXX
 SG_ IC4_VCOM_OV_FLT m3 : 16|1@0+ (1,0) [0|0] "" Vector__XXX
 SG_ IC4_VCOM_UV_FLT m3 : 31|1@0+ (1,0) [0|0] "" Vector__XXX
 SG_ IC4_VANA_OV_FLT m3 : 30|1@0+ (1,0) [0|0] "" Vector__XXX
 SG_ IC4_VANA_UV_FLT m3 : 29|1@0+ (1,0) [0|0] "" Vector__XXX
 SG_ IC4_ADC1_B_FLT m3 : 28|1@0+ (1,0) [0|0] "" Vector__XXX
 SG_ IC4_ADC1_A_FLT m3 : 27|1@0+ (1,0) [0|0] "" Vector__XXX
 SG_ IC4_GND_LOSS_FLT m3 : 26|1@0+ (1,0) [0|0] "" Vector__XXX
 SG_ IC4_IC_TSD_FLT m3 : 25|1@0+ (1,0) [0|0] "" Vector__XXX
 SG_ IC4_GPIO0_WUP_FLT m3 : 23|1@0+ (1,0) [0|0] "" Vector__XXX
 SG_ IC4_IS_OL_FLT m3 : 22|1@0+ (1,0) [0|0] "" Vector__XXX
 SG_ IC4_IS_OC_FLT m3 : 21|1@0+ (1,0) [0|0] "" Vector__XXX
 SG_ IC4_AN_OT_FLT m3 : 20|1@0+ (1,0) [0|0] "" Vector__XXX
 SG_ IC4_AN_UT_FLT m3 : 19|1@0+ (1,0) [0|0] "" Vector__XXX
 SG_ IC4_CT_OV_FLT m3 : 18|1@0+ (1,0) [0|0] "" Vector__XXX
 SG_ IC4_CT_UV_FLT m3 : 17|1@0+ (1,0) [0|0] "" Vector__XXX
 SG_ IC4_POR m3 : 15|1@0+ (1,0) [0|0] "" Vector__XXX
 SG_ IC4_RESET_FLT m3 : 14|1@0+ (1,0) [0|0] "" Vector__XXX
 SG_ IC4_COM_ERR_OVR_FLT m3 : 13|1@0+ (1,0) [0|0] "" Vector__XXX
 SG_ IC4_VPWR_OV_FLT m3 : 12|1@0+ (1,0) [0|0] "" Vector__XXX
 SG_ IC4_VPWR_LV_FLT m3 : 11|1@0+ (1,0) [0|0] "" Vector__XXX
 SG_ IC4_COM_LOSS_FLT m3 : 10|1@0+ (1,0) [0|0] "" Vector__XXX
 SG_ IC4_COM_ERR_FLT m3 : 9|1@0+ (1,0) [0|0] "" Vector__XXX
 SG_ IC4_CSB_WUP_FLT m3 : 8|1@0+ (1,0) [0|0] "" Vector__XXX
 SG_ IC3_IDLE_MODE_FLT m2 : 24|1@0+ (1,0) [0|0] "" Vector__XXX
 SG_ IC3_AN_OPEN_FLT m2 : 39|1@0+ (1,0) [0|0] "" Vector__XXX
 SG_ IC3_GPIO_SHORT_FLT m2 : 38|1@0+ (1,0) [0|0] "" Vector__XXX
 SG_ IC3_CB_SHORT_FLT m2 : 37|1@0+ (1,0) [0|0] "" Vector__XXX
 SG_ IC3_CB_OPEN_FLT m2 : 36|1@0+ (1,0) [0|0] "" Vector__XXX
 SG_ IC3_OSC_ERR_FLT m2 : 35|1@0+ (1,0) [0|0] "" Vector__XXX
 SG_ IC3_DED_ERR_FLT m2 : 34|1@0+ (1,0) [0|0] "" Vector__XXX
 SG_ IC3_FUSE_ERR_FLT m2 : 33|1@0+ (1,0) [0|0] "" Vector__XXX
 SG_ IC3_VCOM_OV_FLT m2 : 16|1@0+ (1,0) [0|0] "" Vector__XXX
 SG_ IC3_VCOM_UV_FLT m2 : 31|1@0+ (1,0) [0|0] "" Vector__XXX
 SG_ IC3_VANA_OV_FLT m2 : 30|1@0+ (1,0) [0|0] "" Vector__XXX
 SG_ IC3_VANA_UV_FLT m2 : 29|1@0+ (1,0) [0|0] "" Vector__XXX
 SG_ IC3_ADC1_B_FLT m2 : 28|1@0+ (1,0) [0|0] "" Vector__XXX
 SG_ IC3_ADC1_A_FLT m2 : 27|1@0+ (1,0) [0|0] "" Vector__XXX
 SG_ IC3_GND_LOSS_FLT m2 : 26|1@0+ (1,0) [0|0] "" Vector__XXX
 SG_ IC3_IC_TSD_FLT m2 : 25|1@0+ (1,0) [0|0] "" Vector__XXX
 SG_ IC3_GPIO0_WUP_FLT m2 : 23|1@0+ (1,0) [0|0] "" Vector__XXX
 SG_ IC3_IS_OL_FLT m2 : 22|1@0+ (1,0) [0|0] "" Vector__XXX
 SG_ IC3_IS_OC_FLT m2 : 21|1@0+ (1,0) [0|0] "" Vector__XXX
 SG_ IC3_AN_OT_FLT m2 : 20|1@0+ (1,0) [0|0] "" Vector__XXX
 SG_ IC3_AN_UT_FLT m2 : 19|1@0+ (1,0) [0|0] "" Vector__XXX
 SG_ IC3_CT_OV_FLT m2 : 18|1@0+ (1,0) [0|0] "" Vector__XXX
 SG_ IC3_CT_UV_FLT m2 : 17|1@0+ (1,0) [0|0] "" Vector__XXX
 SG_ IC3_POR m2 : 15|1@0+ (1,0) [0|0] "" Vector__XXX
 SG_ IC3_RESET_FLT m2 : 14|1@0+ (1,0) [0|0] "" Vector__XXX
 SG_ IC3_COM_ERR_OVR_FLT m2 : 13|1@0+ (1,0) [0|0] "" Vector__XXX
 SG_ IC3_VPWR_OV_FLT m2 : 12|1@0+ (1,0) [0|0] "" Vector__XXX
 SG_ IC3_VPWR_LV_FLT m2 : 11|1@0+ (1,0) [0|0] "" Vector__XXX
 SG_ IC3_COM_LOSS_FLT m2 : 10|1@0+ (1,0) [0|0] "" Vector__XXX
 SG_ IC3_COM_ERR_FLT m2 : 9|1@0+ (1,0) [0|0] "" Vector__XXX
 SG_ IC3_CSB_WUP_FLT m2 : 8|1@0+ (1,0) [0|0] "" Vector__XXX
 SG_ IC2_IDLE_MODE_FLT m1 : 24|1@0+ (1,0) [0|0] "" Vector__XXX
 SG_ IC2_AN_OPEN_FLT m1 : 39|1@0+ (1,0) [0|0] "" Vector__XXX
 SG_ IC2_GPIO_SHORT_FLT m1 : 38|1@0+ (1,0) [0|0] "" Vector__XXX
 SG_ IC2_CB_SHORT_FLT m1 : 37|1@0+ (1,0) [0|0] "" Vector__XXX
 SG_ IC2_CB_OPEN_FLT m1 : 36|1@0+ (1,0) [0|0] "" Vector__XXX
 SG_ IC2_OSC_ERR_FLT m1 : 35|1@0+ (1,0) [0|0] "" Vector__XXX
 SG_ IC2_DED_ERR_FLT m1 : 34|1@0+ (1,0) [0|0] "" Vector__XXX
 SG_ IC2_FUSE_ERR_FLT m1 : 33|1@0+ (1,0) [0|0] "" Vector__XXX
 SG_ IC2_VCOM_OV_FLT m1 : 16|1@0+ (1,0) [0|0] "" Vector__XXX
 SG_ IC2_VCOM_UV_FLT m1 : 31|1@0+ (1,0) [0|0] "" Vector__XXX
 SG_ IC2_VANA_OV_FLT m1 : 30|1@0+ (1,0) [0|0] "" Vector__XXX
 SG_ IC2_VANA_UV_FLT m1 : 29|1@0+ (1,0) [0|0] "" Vector__XXX
 SG_ IC2_ADC1_B_FLT m1 : 28|1@0+ (1,0) [0|0] "" Vector__XXX
 SG_ IC2_ADC1_A_FLT m1 : 27|1@0+ (1,0) [0|0] "" Vector__XXX
 SG_ IC2_GND_LOSS_FLT m1 : 26|1@0+ (1,0) [0|0] "" Vector__XXX
 SG_ IC2_IC_TSD_FLT m1 : 25|1@0+ (1,0) [0|0] "" Vector__XXX
 SG_ IC2_GPIO0_WUP_FLT m1 : 23|1@0+ (1,0) [0|0] "" Vector__XXX
 SG_ IC2_IS_OL_FLT m1 : 22|1@0+ (1,0) [0|0] "" Vector__XXX
 SG_ IC2_IS_OC_FLT m1 : 21|1@0+ (1,0) [0|0] "" Vector__XXX
 SG_ IC2_AN_OT_FLT m1 : 20|1@0+ (1,0) [0|0] "" Vector__XXX
 SG_ IC2_AN_UT_FLT m1 : 19|1@0+ (1,0) [0|0] "" Vector__XXX
 SG_ IC2_CT_OV_FLT m1 : 18|1@0+ (1,0) [0|0] "" Vector__XXX
 SG_ IC2_CT_UV_FLT m1 : 17|1@0+ (1,0) [0|0] "" Vector__XXX
 SG_ IC2_POR m1 : 15|1@0+ (1,0) [0|0] "" Vector__XXX
 SG_ IC2_RESET_FLT m1 : 14|1@0+ (1,0) [0|0] "" Vector__XXX
 SG_ IC2_COM_ERR_OVR_FLT m1 : 13|1@0+ (1,0) [0|0] "" Vector__XXX
 SG_ IC2_VPWR_OV_FLT m1 : 12|1@0+ (1,0) [0|0] "" Vector__XXX
 SG_ IC2_VPWR_LV_FLT m1 : 11|1@0+ (1,0) [0|0] "" Vector__XXX
 SG_ IC2_COM_LOSS_FLT m1 : 10|1@0+ (1,0) [0|0] "" Vector__XXX
 SG_ IC2_COM_ERR_FLT m1 : 9|1@0+ (1,0) [0|0] "" Vector__XXX
 SG_ IC2_CSB_WUP_FLT m1 : 8|1@0+ (1,0) [0|0] "" Vector__XXX
 SG_ IC1_IDLE_MODE_FLT m0 : 24|1@0+ (1,0) [0|0] "" Vector__XXX
 SG_ IC1_AN_OPEN_FLT m0 : 39|1@0+ (1,0) [0|0] "" Vector__XXX
 SG_ IC1_GPIO_SHORT_FLT m0 : 38|1@0+ (1,0) [0|0] "" Vector__XXX
 SG_ IC1_CB_SHORT_FLT m0 : 37|1@0+ (1,0) [0|0] "" Vector__XXX
 SG_ IC1_CB_OPEN_FLT m0 : 36|1@0+ (1,0) [0|0] "" Vector__XXX
 SG_ IC1_OSC_ERR_FLT m0 : 35|1@0+ (1,0) [0|0] "" Vector__XXX
 SG_ IC1_DED_ERR_FLT m0 : 34|1@0+ (1,0) [0|0] "" Vector__XXX
 SG_ IC1_FUSE_ERR_FLT m0 : 33|1@0+ (1,0) [0|0] "" Vector__XXX
 SG_ IC1_VCOM_OV_FLT m0 : 16|1@0+ (1,0) [0|0] "" Vector__XXX
 SG_ IC1_VCOM_UV_FLT m0 : 31|1@0+ (1,0) [0|0] "" Vector__XXX
 SG_ IC1_VANA_OV_FLT m0 : 30|1@0+ (1,0) [0|0] "" Vector__XXX
 SG_ IC1_VANA_UV_FLT m0 : 29|1@0+ (1,0) [0|0] "" Vector__XXX
 SG_ IC1_ADC1_B_FLT m0 : 28|1@0+ (1,0) [0|0] "" Vector__XXX
 SG_ IC1_ADC1_A_FLT m0 : 27|1@0+ (1,0) [0|0] "" Vector__XXX
 SG_ IC1_GND_LOSS_FLT m0 : 26|1@0+ (1,0) [0|0] "" Vector__XXX
 SG_ IC1_IC_TSD_FLT m0 : 25|1@0+ (1,0) [0|0] "" Vector__XXX
 SG_ IC1_GPIO0_WUP_FLT m0 : 23|1@0+ (1,0) [0|0] "" Vector__XXX
 SG_ IC1_IS_OL_FLT m0 : 22|1@0+ (1,0) [0|0] "" Vector__XXX
 SG_ IC1_IS_OC_FLT m0 : 21|1@0+ (1,0) [0|0] "" Vector__XXX
 SG_ IC1_AN_OT_FLT m0 : 20|1@0+ (1,0) [0|0] "" Vector__XXX
 SG_ IC1_AN_UT_FLT m0 : 19|1@0+ (1,0) [0|0] "" Vector__XXX
 SG_ IC1_CT_OV_FLT m0 : 18|1@0+ (1,0) [0|0] "" Vector__XXX
 SG_ IC1_CT_UV_FLT m0 : 17|1@0+ (1,0) [0|0] "" Vector__XXX
 SG_ IC1_POR m0 : 15|1@0+ (1,0) [0|0] "" Vector__XXX
 SG_ IC1_RESET_FLT m0 : 14|1@0+ (1,0) [0|0] "" Vector__XXX
 SG_ IC1_COM_ERR_OVR_FLT m0 : 13|1@0+ (1,0) [0|0] "" Vector__XXX
 SG_ IC1_VPWR_OV_FLT m0 : 12|1@0+ (1,0) [0|0] "" Vector__XXX
 SG_ IC1_VPWR_LV_FLT m0 : 11|1@0+ (1,0) [0|0] "" Vector__XXX
 SG_ IC1_COM_LOSS_FLT m0 : 10|1@0+ (1,0) [0|0] "" Vector__XXX
 SG_ IC1_COM_ERR_FLT m0 : 9|1@0+ (1,0) [0|0] "" Vector__XXX
 SG_ IC1_CSB_WUP_FLT m0 : 8|1@0+ (1,0) [0|0] "" Vector__XXX
 SG_ CSC04_IndexFaults M : 7|8@0+ (1,0) [0|255] "" Vector__XXX

BO_ 2550464514 CSC05_CIDs_FAULTS: 8 CSC05
 SG_ IC4_IDLE_MODE_FLT m3 : 24|1@0+ (1,0) [0|0] "" Vector__XXX
 SG_ IC4_AN_OPEN_FLT m3 : 39|1@0+ (1,0) [0|0] "" Vector__XXX
 SG_ IC4_GPIO_SHORT_FLT m3 : 38|1@0+ (1,0) [0|0] "" Vector__XXX
 SG_ IC4_CB_SHORT_FLT m3 : 37|1@0+ (1,0) [0|0] "" Vector__XXX
 SG_ IC4_CB_OPEN_FLT m3 : 36|1@0+ (1,0) [0|0] "" Vector__XXX
 SG_ IC4_OSC_ERR_FLT m3 : 35|1@0+ (1,0) [0|0] "" Vector__XXX
 SG_ IC4_DED_ERR_FLT m3 : 34|1@0+ (1,0) [0|0] "" Vector__XXX
 SG_ IC4_FUSE_ERR_FLT m3 : 33|1@0+ (1,0) [0|0] "" Vector__XXX
 SG_ IC4_VCOM_OV_FLT m3 : 16|1@0+ (1,0) [0|0] "" Vector__XXX
 SG_ IC4_VCOM_UV_FLT m3 : 31|1@0+ (1,0) [0|0] "" Vector__XXX
 SG_ IC4_VANA_OV_FLT m3 : 30|1@0+ (1,0) [0|0] "" Vector__XXX
 SG_ IC4_VANA_UV_FLT m3 : 29|1@0+ (1,0) [0|0] "" Vector__XXX
 SG_ IC4_ADC1_B_FLT m3 : 28|1@0+ (1,0) [0|0] "" Vector__XXX
 SG_ IC4_ADC1_A_FLT m3 : 27|1@0+ (1,0) [0|0] "" Vector__XXX
 SG_ IC4_GND_LOSS_FLT m3 : 26|1@0+ (1,0) [0|0] "" Vector__XXX
 SG_ IC4_IC_TSD_FLT m3 : 25|1@0+ (1,0) [0|0] "" Vector__XXX
 SG_ IC4_GPIO0_WUP_FLT m3 : 23|1@0+ (1,0) [0|0] "" Vector__XXX
 SG_ IC4_IS_OL_FLT m3 : 22|1@0+ (1,0) [0|0] "" Vector__XXX
 SG_ IC4_IS_OC_FLT m3 : 21|1@0+ (1,0) [0|0] "" Vector__XXX
 SG_ IC4_AN_OT_FLT m3 : 20|1@0+ (1,0) [0|0] "" Vector__XXX
 SG_ IC4_AN_UT_FLT m3 : 19|1@0+ (1,0) [0|0] "" Vector__XXX
 SG_ IC4_CT_OV_FLT m3 : 18|1@0+ (1,0) [0|0] "" Vector__XXX
 SG_ IC4_CT_UV_FLT m3 : 17|1@0+ (1,0) [0|0] "" Vector__XXX
 SG_ IC4_POR m3 : 15|1@0+ (1,0) [0|0] "" Vector__XXX
 SG_ IC4_RESET_FLT m3 : 14|1@0+ (1,0) [0|0] "" Vector__XXX
 SG_ IC4_COM_ERR_OVR_FLT m3 : 13|1@0+ (1,0) [0|0] "" Vector__XXX
 SG_ IC4_VPWR_OV_FLT m3 : 12|1@0+ (1,0) [0|0] "" Vector__XXX
 SG_ IC4_VPWR_LV_FLT m3 : 11|1@0+ (1,0) [0|0] "" Vector__XXX
 SG_ IC4_COM_LOSS_FLT m3 : 10|1@0+ (1,0) [0|0] "" Vector__XXX
 SG_ IC4_COM_ERR_FLT m3 : 9|1@0+ (1,0) [0|0] "" Vector__XXX
 SG_ IC4_CSB_WUP_FLT m3 : 8|1@0+ (1,0) [0|0] "" Vector__XXX
 SG_ IC3_IDLE_MODE_FLT m2 : 24|1@0+ (1,0) [0|0] "" Vector__XXX
 SG_ IC3_AN_OPEN_FLT m2 : 39|1@0+ (1,0) [0|0] "" Vector__XXX
 SG_ IC3_GPIO_SHORT_FLT m2 : 38|1@0+ (1,0) [0|0] "" Vector__XXX
 SG_ IC3_CB_SHORT_FLT m2 : 37|1@0+ (1,0) [0|0] "" Vector__XXX
 SG_ IC3_CB_OPEN_FLT m2 : 36|1@0+ (1,0) [0|0] "" Vector__XXX
 SG_ IC3_OSC_ERR_FLT m2 : 35|1@0+ (1,0) [0|0] "" Vector__XXX
 SG_ IC3_DED_ERR_FLT m2 : 34|1@0+ (1,0) [0|0] "" Vector__XXX
 SG_ IC3_FUSE_ERR_FLT m2 : 33|1@0+ (1,0) [0|0] "" Vector__XXX
 SG_ IC3_VCOM_OV_FLT m2 : 16|1@0+ (1,0) [0|0] "" Vector__XXX
 SG_ IC3_VCOM_UV_FLT m2 : 31|1@0+ (1,0) [0|0] "" Vector__XXX
 SG_ IC3_VANA_OV_FLT m2 : 30|1@0+ (1,0) [0|0] "" Vector__XXX
 SG_ IC3_VANA_UV_FLT m2 : 29|1@0+ (1,0) [0|0] "" Vector__XXX
 SG_ IC3_ADC1_B_FLT m2 : 28|1@0+ (1,0) [0|0] "" Vector__XXX
 SG_ IC3_ADC1_A_FLT m2 : 27|1@0+ (1,0) [0|0] "" Vector__XXX
 SG_ IC3_GND_LOSS_FLT m2 : 26|1@0+ (1,0) [0|0] "" Vector__XXX
 SG_ IC3_IC_TSD_FLT m2 : 25|1@0+ (1,0) [0|0] "" Vector__XXX
 SG_ IC3_GPIO0_WUP_FLT m2 : 23|1@0+ (1,0) [0|0] "" Vector__XXX
 SG_ IC3_IS_OL_FLT m2 : 22|1@0+ (1,0) [0|0] "" Vector__XXX
 SG_ IC3_IS_OC_FLT m2 : 21|1@0+ (1,0) [0|0] "" Vector__XXX
 SG_ IC3_AN_OT_FLT m2 : 20|1@0+ (1,0) [0|0] "" Vector__XXX
 SG_ IC3_AN_UT_FLT m2 : 19|1@0+ (1,0) [0|0] "" Vector__XXX
 SG_ IC3_CT_OV_FLT m2 : 18|1@0+ (1,0) [0|0] "" Vector__XXX
 SG_ IC3_CT_UV_FLT m2 : 17|1@0+ (1,0) [0|0] "" Vector__XXX
 SG_ IC3_POR m2 : 15|1@0+ (1,0) [0|0] "" Vector__XXX
 SG_ IC3_RESET_FLT m2 : 14|1@0+ (1,0) [0|0] "" Vector__XXX
 SG_ IC3_COM_ERR_OVR_FLT m2 : 13|1@0+ (1,0) [0|0] "" Vector__XXX
 SG_ IC3_VPWR_OV_FLT m2 : 12|1@0+ (1,0) [0|0] "" Vector__XXX
 SG_ IC3_VPWR_LV_FLT m2 : 11|1@0+ (1,0) [0|0] "" Vector__XXX
 SG_ IC3_COM_LOSS_FLT m2 : 10|1@0+ (1,0) [0|0] "" Vector__XXX
 SG_ IC3_COM_ERR_FLT m2 : 9|1@0+ (1,0) [0|0] "" Vector__XXX
 SG_ IC3_CSB_WUP_FLT m2 : 8|1@0+ (1,0) [0|0] "" Vector__XXX
 SG_ IC2_IDLE_MODE_FLT m1 : 24|1@0+ (1,0) [0|0] "" Vector__XXX
 SG_ IC2_AN_OPEN_FLT m1 : 39|1@0+ (1,0) [0|0] "" Vector__XXX
 SG_ IC2_GPIO_SHORT_FLT m1 : 38|1@0+ (1,0) [0|0] "" Vector__XXX
 SG_ IC2_CB_SHORT_FLT m1 : 37|1@0+ (1,0) [0|0] "" Vector__XXX
 SG_ IC2_CB_OPEN_FLT m1 : 36|1@0+ (1,0) [0|0] "" Vector__XXX
 SG_ IC2_OSC_ERR_FLT m1 : 35|1@0+ (1,0) [0|0] "" Vector__XXX
 SG_ IC2_DED_ERR_FLT m1 : 34|1@0+ (1,0) [0|0] "" Vector__XXX
 SG_ IC2_FUSE_ERR_FLT m1 : 33|1@0+ (1,0) [0|0] "" Vector__XXX
 SG_ IC2_VCOM_OV_FLT m1 : 16|1@0+ (1,0) [0|0] "" Vector__XXX
 SG_ IC2_VCOM_UV_FLT m1 : 31|1@0+ (1,0) [0|0] "" Vector__XXX
 SG_ IC2_VANA_OV_FLT m1 : 30|1@0+ (1,0) [0|0] "" Vector__XXX
 SG_ IC2_VANA_UV_FLT m1 : 29|1@0+ (1,0) [0|0] "" Vector__XXX
 SG_ IC2_ADC1_B_FLT m1 : 28|1@0+ (1,0) [0|0] "" Vector__XXX
 SG_ IC2_ADC1_A_FLT m1 : 27|1@0+ (1,0) [0|0] "" Vector__XXX
 SG_ IC2_GND_LOSS_FLT m1 : 26|1@0+ (1,0) [0|0] "" Vector__XXX
 SG_ IC2_IC_TSD_FLT m1 : 25|1@0+ (1,0) [0|0] "" Vector__XXX
 SG_ IC2_GPIO0_WUP_FLT m1 : 23|1@0+ (1,0) [0|0] "" Vector__XXX
 SG_ IC2_IS_OL_FLT m1 : 22|1@0+ (1,0) [0|0] "" Vector__XXX
 SG_ IC2_IS_OC_FLT m1 : 21|1@0+ (1,0) [0|0] "" Vector__XXX
 SG_ IC2_AN_OT_FLT m1 : 20|1@0+ (1,0) [0|0] "" Vector__XXX
 SG_ IC2_AN_UT_FLT m1 : 19|1@0+ (1,0) [0|0] "" Vector__XXX
 SG_ IC2_CT_OV_FLT m1 : 18|1@0+ (1,0) [0|0] "" Vector__XXX
 SG_ IC2_CT_UV_FLT m1 : 17|1@0+ (1,0) [0|0] "" Vector__XXX
 SG_ IC2_POR m1 : 15|1@0+ (1,0) [0|0] "" Vector__XXX
 SG_ IC2_RESET_FLT m1 : 14|1@0+ (1,0) [0|0] "" Vector__XXX
 SG_ IC2_COM_ERR_OVR_FLT m1 : 13|1@0+ (1,0) [0|0] "" Vector__XXX
 SG_ IC2_VPWR_OV_FLT m1 : 12|1@0+ (1,0) [0|0] "" Vector__XXX
 SG_ IC2_VPWR_LV_FLT m1 : 11|1@0+ (1,0) [0|0] "" Vector__XXX
 SG_ IC2_COM_LOSS_FLT m1 : 10|1@0+ (1,0) [0|0] "" Vector__XXX
 SG_ IC2_COM_ERR_FLT m1 : 9|1@0+ (1,0) [0|0] "" Vector__XXX
 SG_ IC2_CSB_WUP_FLT m1 : 8|1@0+ (1,0) [0|0] "" Vector__XXX
 SG_ IC1_IDLE_MODE_FLT m0 : 24|1@0+ (1,0) [0|0] "" Vector__XXX
 SG_ IC1_AN_OPEN_FLT m0 : 39|1@0+ (1,0) [0|0] "" Vector__XXX
 SG_ IC1_GPIO_SHORT_FLT m0 : 38|1@0+ (1,0) [0|0] "" Vector__XXX
 SG_ IC1_CB_SHORT_FLT m0 : 37|1@0+ (1,0) [0|0] "" Vector__XXX
 SG_ IC1_CB_OPEN_FLT m0 : 36|1@0+ (1,0) [0|0] "" Vector__XXX
 SG_ IC1_OSC_ERR_FLT m0 : 35|1@0+ (1,0) [0|0] "" Vector__XXX
 SG_ IC1_DED_ERR_FLT m0 : 34|1@0+ (1,0) [0|0] "" Vector__XXX
 SG_ IC1_FUSE_ERR_FLT m0 : 33|1@0+ (1,0) [0|0] "" Vector__XXX
 SG_ IC1_VCOM_OV_FLT m0 : 16|1@0+ (1,0) [0|0] "" Vector__XXX
 SG_ IC1_VCOM_UV_FLT m0 : 31|1@0+ (1,0) [0|0] "" Vector__XXX
 SG_ IC1_VANA_OV_FLT m0 : 30|1@0+ (1,0) [0|0] "" Vector__XXX
 SG_ IC1_VANA_UV_FLT m0 : 29|1@0+ (1,0) [0|0] "" Vector__XXX
 SG_ IC1_ADC1_B_FLT m0 : 28|1@0+ (1,0) [0|0] "" Vector__XXX
 SG_ IC1_ADC1_A_FLT m0 : 27|1@0+ (1,0) [0|0] "" Vector__XXX
 SG_ IC1_GND_LOSS_FLT m0 : 26|1@0+ (1,0) [0|0] "" Vector__XXX
 SG_ IC1_IC_TSD_FLT m0 : 25|1@0+ (1,0) [0|0] "" Vector__XXX
 SG_ IC1_GPIO0_WUP_FLT m0 : 23|1@0+ (1,0) [0|0] "" Vector__XXX
 SG_ IC1_IS_OL_FLT m0 : 22|1@0+ (1,0) [0|0] "" Vector__XXX
 SG_ IC1_IS_OC_FLT m0 : 21|1@0+ (1,0) [0|0] "" Vector__XXX
 SG_ IC1_AN_OT_FLT m0 : 20|1@0+ (1,0) [0|0] "" Vector__XXX
 SG_ IC1_AN_UT_FLT m0 : 19|1@0+ (1,0) [0|0] "" Vector__XXX
 SG_ IC1_CT_OV_FLT m0 : 18|1@0+ (1,0) [0|0] "" Vector__XXX
 SG_ IC1_CT_UV_FLT m0 : 17|1@0+ (1,0) [0|0] "" Vector__XXX
 SG_ IC1_POR m0 : 15|1@0+ (1,0) [0|0] "" Vector__XXX
 SG_ IC1_RESET_FLT m0 : 14|1@0+ (1,0) [0|0] "" Vector__XXX
 SG_ IC1_COM_ERR_OVR_FLT m0 : 13|1@0+ (1,0) [0|0] "" Vector__XXX
 SG_ IC1_VPWR_OV_FLT m0 : 12|1@0+ (1,0) [0|0] "" Vector__XXX
 SG_ IC1_VPWR_LV_FLT m0 : 11|1@0+ (1,0) [0|0] "" Vector__XXX
 SG_ IC1_COM_LOSS_FLT m0 : 10|1@0+ (1,0) [0|0] "" Vector__XXX
 SG_ IC1_COM_ERR_FLT m0 : 9|1@0+ (1,0) [0|0] "" Vector__XXX
 SG_ IC1_CSB_WUP_FLT m0 : 8|1@0+ (1,0) [0|0] "" Vector__XXX
 SG_ CSC05_IndexFaults M : 7|8@0+ (1,0) [0|255] "" Vector__XXX

BO_ 2550530050 CSC06_CIDs_FAULTS: 8 CSC06
 SG_ IC4_IDLE_MODE_FLT m3 : 24|1@0+ (1,0) [0|0] "" Vector__XXX
 SG_ IC4_AN_OPEN_FLT m3 : 39|1@0+ (1,0) [0|0] "" Vector__XXX
 SG_ IC4_GPIO_SHORT_FLT m3 : 38|1@0+ (1,0) [0|0] "" Vector__XXX
 SG_ IC4_CB_SHORT_FLT m3 : 37|1@0+ (1,0) [0|0] "" Vector__XXX
 SG_ IC4_CB_OPEN_FLT m3 : 36|1@0+ (1,0) [0|0] "" Vector__XXX
 SG_ IC4_OSC_ERR_FLT m3 : 35|1@0+ (1,0) [0|0] "" Vector__XXX
 SG_ IC4_DED_ERR_FLT m3 : 34|1@0+ (1,0) [0|0] "" Vector__XXX
 SG_ IC4_FUSE_ERR_FLT m3 : 33|1@0+ (1,0) [0|0] "" Vector__XXX
 SG_ IC4_VCOM_OV_FLT m3 : 16|1@0+ (1,0) [0|0] "" Vector__XXX
 SG_ IC4_VCOM_UV_FLT m3 : 31|1@0+ (1,0) [0|0] "" Vector__XXX
 SG_ IC4_VANA_OV_FLT m3 : 30|1@0+ (1,0) [0|0] "" Vector__XXX
 SG_ IC4_VANA_UV_FLT m3 : 29|1@0+ (1,0) [0|0] "" Vector__XXX
 SG_ IC4_ADC1_B_FLT m3 : 28|1@0+ (1,0) [0|0] "" Vector__XXX
 SG_ IC4_ADC1_A_FLT m3 : 27|1@0+ (1,0) [0|0] "" Vector__XXX
 SG_ IC4_GND_LOSS_FLT m3 : 26|1@0+ (1,0) [0|0] "" Vector__XXX
 SG_ IC4_IC_TSD_FLT m3 : 25|1@0+ (1,0) [0|0] "" Vector__XXX
 SG_ IC4_GPIO0_WUP_FLT m3 : 23|1@0+ (1,0) [0|0] "" Vector__XXX
 SG_ IC4_IS_OL_FLT m3 : 22|1@0+ (1,0) [0|0] "" Vector__XXX
 SG_ IC4_IS_OC_FLT m3 : 21|1@0+ (1,0) [0|0] "" Vector__XXX
 SG_ IC4_AN_OT_FLT m3 : 20|1@0+ (1,0) [0|0] "" Vector__XXX
 SG_ IC4_AN_UT_FLT m3 : 19|1@0+ (1,0) [0|0] "" Vector__XXX
 SG_ IC4_CT_OV_FLT m3 : 18|1@0+ (1,0) [0|0] "" Vector__XXX
 SG_ IC4_CT_UV_FLT m3 : 17|1@0+ (1,0) [0|0] "" Vector__XXX
 SG_ IC4_POR m3 : 15|1@0+ (1,0) [0|0] "" Vector__XXX
 SG_ IC4_RESET_FLT m3 : 14|1@0+ (1,0) [0|0] "" Vector__XXX
 SG_ IC4_COM_ERR_OVR_FLT m3 : 13|1@0+ (1,0) [0|0] "" Vector__XXX
 SG_ IC4_VPWR_OV_FLT m3 : 12|1@0+ (1,0) [0|0] "" Vector__XXX
 SG_ IC4_VPWR_LV_FLT m3 : 11|1@0+ (1,0) [0|0] "" Vector__XXX
 SG_ IC4_COM_LOSS_FLT m3 : 10|1@0+ (1,0) [0|0] "" Vector__XXX
 SG_ IC4_COM_ERR_FLT m3 : 9|1@0+ (1,0) [0|0] "" Vector__XXX
 SG_ IC4_CSB_WUP_FLT m3 : 8|1@0+ (1,0) [0|0] "" Vector__XXX
 SG_ IC3_IDLE_MODE_FLT m2 : 24|1@0+ (1,0) [0|0] "" Vector__XXX
 SG_ IC3_AN_OPEN_FLT m2 : 39|1@0+ (1,0) [0|0] "" Vector__XXX
 SG_ IC3_GPIO_SHORT_FLT m2 : 38|1@0+ (1,0) [0|0] "" Vector__XXX
 SG_ IC3_CB_SHORT_FLT m2 : 37|1@0+ (1,0) [0|0] "" Vector__XXX
 SG_ IC3_CB_OPEN_FLT m2 : 36|1@0+ (1,0) [0|0] "" Vector__XXX
 SG_ IC3_OSC_ERR_FLT m2 : 35|1@0+ (1,0) [0|0] "" Vector__XXX
 SG_ IC3_DED_ERR_FLT m2 : 34|1@0+ (1,0) [0|0] "" Vector__XXX
 SG_ IC3_FUSE_ERR_FLT m2 : 33|1@0+ (1,0) [0|0] "" Vector__XXX
 SG_ IC3_VCOM_OV_FLT m2 : 16|1@0+ (1,0) [0|0] "" Vector__XXX
 SG_ IC3_VCOM_UV_FLT m2 : 31|1@0+ (1,0) [0|0] "" Vector__XXX
 SG_ IC3_VANA_OV_FLT m2 : 30|1@0+ (1,0) [0|0] "" Vector__XXX
 SG_ IC3_VANA_UV_FLT m2 : 29|1@0+ (1,0) [0|0] "" Vector__XXX
 SG_ IC3_ADC1_B_FLT m2 : 28|1@0+ (1,0) [0|0] "" Vector__XXX
 SG_ IC3_ADC1_A_FLT m2 : 27|1@0+ (1,0) [0|0] "" Vector__XXX
 SG_ IC3_GND_LOSS_FLT m2 : 26|1@0+ (1,0) [0|0] "" Vector__XXX
 SG_ IC3_IC_TSD_FLT m2 : 25|1@0+ (1,0) [0|0] "" Vector__XXX
 SG_ IC3_GPIO0_WUP_FLT m2 : 23|1@0+ (1,0) [0|0] "" Vector__XXX
 SG_ IC3_IS_OL_FLT m2 : 22|1@0+ (1,0) [0|0] "" Vector__XXX
 SG_ IC3_IS_OC_FLT m2 : 21|1@0+ (1,0) [0|0] "" Vector__XXX
 SG_ IC3_AN_OT_FLT m2 : 20|1@0+ (1,0) [0|0] "" Vector__XXX
 SG_ IC3_AN_UT_FLT m2 : 19|1@0+ (1,0) [0|0] "" Vector__XXX
 SG_ IC3_CT_OV_FLT m2 : 18|1@0+ (1,0) [0|0] "" Vector__XXX
 SG_ IC3_CT_UV_FLT m2 : 17|1@0+ (1,0) [0|0] "" Vector__XXX
 SG_ IC3_POR m2 : 15|1@0+ (1,0) [0|0] "" Vector__XXX
 SG_ IC3_RESET_FLT m2 : 14|1@0+ (1,0) [0|0] "" Vector__XXX
 SG_ IC3_COM_ERR_OVR_FLT m2 : 13|1@0+ (1,0) [0|0] "" Vector__XXX
 SG_ IC3_VPWR_OV_FLT m2 : 12|1@0+ (1,0) [0|0] "" Vector__XXX
 SG_ IC3_VPWR_LV_FLT m2 : 11|1@0+ (1,0) [0|0] "" Vector__XXX
 SG_ IC3_COM_LOSS_FLT m2 : 10|1@0+ (1,0) [0|0] "" Vector__XXX
 SG_ IC3_COM_ERR_FLT m2 : 9|1@0+ (1,0) [0|0] "" Vector__XXX
 SG_ IC3_CSB_WUP_FLT m2 : 8|1@0+ (1,0) [0|0] "" Vector__XXX
 SG_ IC2_IDLE_MODE_FLT m1 : 24|1@0+ (1,0) [0|0] "" Vector__XXX
 SG_ IC2_AN_OPEN_FLT m1 : 39|1@0+ (1,0) [0|0] "" Vector__XXX
 SG_ IC2_GPIO_SHORT_FLT m1 : 38|1@0+ (1,0) [0|0] "" Vector__XXX
 SG_ IC2_CB_SHORT_FLT m1 : 37|1@0+ (1,0) [0|0] "" Vector__XXX
 SG_ IC2_CB_OPEN_FLT m1 : 36|1@0+ (1,0) [0|0] "" Vector__XXX
 SG_ IC2_OSC_ERR_FLT m1 : 35|1@0+ (1,0) [0|0] "" Vector__XXX
 SG_ IC2_DED_ERR_FLT m1 : 34|1@0+ (1,0) [0|0] "" Vector__XXX
 SG_ IC2_FUSE_ERR_FLT m1 : 33|1@0+ (1,0) [0|0] "" Vector__XXX
 SG_ IC2_VCOM_OV_FLT m1 : 16|1@0+ (1,0) [0|0] "" Vector__XXX
 SG_ IC2_VCOM_UV_FLT m1 : 31|1@0+ (1,0) [0|0] "" Vector__XXX
 SG_ IC2_VANA_OV_FLT m1 : 30|1@0+ (1,0) [0|0] "" Vector__XXX
 SG_ IC2_VANA_UV_FLT m1 : 29|1@0+ (1,0) [0|0] "" Vector__XXX
 SG_ IC2_ADC1_B_FLT m1 : 28|1@0+ (1,0) [0|0] "" Vector__XXX
 SG_ IC2_ADC1_A_FLT m1 : 27|1@0+ (1,0) [0|0] "" Vector__XXX
 SG_ IC2_GND_LOSS_FLT m1 : 26|1@0+ (1,0) [0|0] "" Vector__XXX
 SG_ IC2_IC_TSD_FLT m1 : 25|1@0+ (1,0) [0|0] "" Vector__XXX
 SG_ IC2_GPIO0_WUP_FLT m1 : 23|1@0+ (1,0) [0|0] "" Vector__XXX
 SG_ IC2_IS_OL_FLT m1 : 22|1@0+ (1,0) [0|0] "" Vector__XXX
 SG_ IC2_IS_OC_FLT m1 : 21|1@0+ (1,0) [0|0] "" Vector__XXX
 SG_ IC2_AN_OT_FLT m1 : 20|1@0+ (1,0) [0|0] "" Vector__XXX
 SG_ IC2_AN_UT_FLT m1 : 19|1@0+ (1,0) [0|0] "" Vector__XXX
 SG_ IC2_CT_OV_FLT m1 : 18|1@0+ (1,0) [0|0] "" Vector__XXX
 SG_ IC2_CT_UV_FLT m1 : 17|1@0+ (1,0) [0|0] "" Vector__XXX
 SG_ IC2_POR m1 : 15|1@0+ (1,0) [0|0] "" Vector__XXX
 SG_ IC2_RESET_FLT m1 : 14|1@0+ (1,0) [0|0] "" Vector__XXX
 SG_ IC2_COM_ERR_OVR_FLT m1 : 13|1@0+ (1,0) [0|0] "" Vector__XXX
 SG_ IC2_VPWR_OV_FLT m1 : 12|1@0+ (1,0) [0|0] "" Vector__XXX
 SG_ IC2_VPWR_LV_FLT m1 : 11|1@0+ (1,0) [0|0] "" Vector__XXX
 SG_ IC2_COM_LOSS_FLT m1 : 10|1@0+ (1,0) [0|0] "" Vector__XXX
 SG_ IC2_COM_ERR_FLT m1 : 9|1@0+ (1,0) [0|0] "" Vector__XXX
 SG_ IC2_CSB_WUP_FLT m1 : 8|1@0+ (1,0) [0|0] "" Vector__XXX
 SG_ IC1_IDLE_MODE_FLT m0 : 24|1@0+ (1,0) [0|0] "" Vector__XXX
 SG_ IC1_AN_OPEN_FLT m0 : 39|1@0+ (1,0) [0|0] "" Vector__XXX
 SG_ IC1_GPIO_SHORT_FLT m0 : 38|1@0+ (1,0) [0|0] "" Vector__XXX
 SG_ IC1_CB_SHORT_FLT m0 : 37|1@0+ (1,0) [0|0] "" Vector__XXX
 SG_ IC1_CB_OPEN_FLT m0 : 36|1@0+ (1,0) [0|0] "" Vector__XXX
 SG_ IC1_OSC_ERR_FLT m0 : 35|1@0+ (1,0) [0|0] "" Vector__XXX
 SG_ IC1_DED_ERR_FLT m0 : 34|1@0+ (1,0) [0|0] "" Vector__XXX
 SG_ IC1_FUSE_ERR_FLT m0 : 33|1@0+ (1,0) [0|0] "" Vector__XXX
 SG_ IC1_VCOM_OV_FLT m0 : 16|1@0+ (1,0) [0|0] "" Vector__XXX
 SG_ IC1_VCOM_UV_FLT m0 : 31|1@0+ (1,0) [0|0] "" Vector__XXX
 SG_ IC1_VANA_OV_FLT m0 : 30|1@0+ (1,0) [0|0] "" Vector__XXX
 SG_ IC1_VANA_UV_FLT m0 : 29|1@0+ (1,0) [0|0] "" Vector__XXX
 SG_ IC1_ADC1_B_FLT m0 : 28|1@0+ (1,0) [0|0] "" Vector__XXX
 SG_ IC1_ADC1_A_FLT m0 : 27|1@0+ (1,0) [0|0] "" Vector__XXX
 SG_ IC1_GND_LOSS_FLT m0 : 26|1@0+ (1,0) [0|0] "" Vector__XXX
 SG_ IC1_IC_TSD_FLT m0 : 25|1@0+ (1,0) [0|0] "" Vector__XXX
 SG_ IC1_GPIO0_WUP_FLT m0 : 23|1@0+ (1,0) [0|0] "" Vector__XXX
 SG_ IC1_IS_OL_FLT m0 : 22|1@0+ (1,0) [0|0] "" Vector__XXX
 SG_ IC1_IS_OC_FLT m0 : 21|1@0+ (1,0) [0|0] "" Vector__XXX
 SG_ IC1_AN_OT_FLT m0 : 20|1@0+ (1,0) [0|0] "" Vector__XXX
 SG_ IC1_AN_UT_FLT m0 : 19|1@0+ (1,0) [0|0] "" Vector__XXX
 SG_ IC1_CT_OV_FLT m0 : 18|1@0+ (1,0) [0|0] "" Vector__XXX
 SG_ IC1_CT_UV_FLT m0 : 17|1@0+ (1,0) [0|0] "" Vector__XXX
 SG_ IC1_POR m0 : 15|1@0+ (1,0) [0|0] "" Vector__XXX
 SG_ IC1_RESET_FLT m0 : 14|1@0+ (1,0) [0|0] "" Vector__XXX
 SG_ IC1_COM_ERR_OVR_FLT m0 : 13|1@0+ (1,0) [0|0] "" Vector__XXX
 SG_ IC1_VPWR_OV_FLT m0 : 12|1@0+ (1,0) [0|0] "" Vector__XXX
 SG_ IC1_VPWR_LV_FLT m0 : 11|1@0+ (1,0) [0|0] "" Vector__XXX
 SG_ IC1_COM_LOSS_FLT m0 : 10|1@0+ (1,0) [0|0] "" Vector__XXX
 SG_ IC1_COM_ERR_FLT m0 : 9|1@0+ (1,0) [0|0] "" Vector__XXX
 SG_ IC1_CSB_WUP_FLT m0 : 8|1@0+ (1,0) [0|0] "" Vector__XXX
 SG_ CSC06_IndexFaults M : 7|8@0+ (1,0) [0|255] "" Vector__XXX

BO_ 2550595586 CSC07_CIDs_FAULTS: 8 CSC07
 SG_ IC4_IDLE_MODE_FLT m3 : 24|1@0+ (1,0) [0|0] "" Vector__XXX
 SG_ IC4_AN_OPEN_FLT m3 : 39|1@0+ (1,0) [0|0] "" Vector__XXX
 SG_ IC4_GPIO_SHORT_FLT m3 : 38|1@0+ (1,0) [0|0] "" Vector__XXX
 SG_ IC4_CB_SHORT_FLT m3 : 37|1@0+ (1,0) [0|0] "" Vector__XXX
 SG_ IC4_CB_OPEN_FLT m3 : 36|1@0+ (1,0) [0|0] "" Vector__XXX
 SG_ IC4_OSC_ERR_FLT m3 : 35|1@0+ (1,0) [0|0] "" Vector__XXX
 SG_ IC4_DED_ERR_FLT m3 : 34|1@0+ (1,0) [0|0] "" Vector__XXX
 SG_ IC4_FUSE_ERR_FLT m3 : 33|1@0+ (1,0) [0|0] "" Vector__XXX
 SG_ IC4_VCOM_OV_FLT m3 : 16|1@0+ (1,0) [0|0] "" Vector__XXX
 SG_ IC4_VCOM_UV_FLT m3 : 31|1@0+ (1,0) [0|0] "" Vector__XXX
 SG_ IC4_VANA_OV_FLT m3 : 30|1@0+ (1,0) [0|0] "" Vector__XXX
 SG_ IC4_VANA_UV_FLT m3 : 29|1@0+ (1,0) [0|0] "" Vector__XXX
 SG_ IC4_ADC1_B_FLT m3 : 28|1@0+ (1,0) [0|0] "" Vector__XXX
 SG_ IC4_ADC1_A_FLT m3 : 27|1@0+ (1,0) [0|0] "" Vector__XXX
 SG_ IC4_GND_LOSS_FLT m3 : 26|1@0+ (1,0) [0|0] "" Vector__XXX
 SG_ IC4_IC_TSD_FLT m3 : 25|1@0+ (1,0) [0|0] "" Vector__XXX
 SG_ IC4_GPIO0_WUP_FLT m3 : 23|1@0+ (1,0) [0|0] "" Vector__XXX
 SG_ IC4_IS_OL_FLT m3 : 22|1@0+ (1,0) [0|0] "" Vector__XXX
 SG_ IC4_IS_OC_FLT m3 : 21|1@0+ (1,0) [0|0] "" Vector__XXX
 SG_ IC4_AN_OT_FLT m3 : 20|1@0+ (1,0) [0|0] "" Vector__XXX
 SG_ IC4_AN_UT_FLT m3 : 19|1@0+ (1,0) [0|0] "" Vector__XXX
 SG_ IC4_CT_OV_FLT m3 : 18|1@0+ (1,0) [0|0] "" Vector__XXX
 SG_ IC4_CT_UV_FLT m3 : 17|1@0+ (1,0) [0|0] "" Vector__XXX
 SG_ IC4_POR m3 : 15|1@0+ (1,0) [0|0] "" Vector__XXX
 SG_ IC4_RESET_FLT m3 : 14|1@0+ (1,0) [0|0] "" Vector__XXX
 SG_ IC4_COM_ERR_OVR_FLT m3 : 13|1@0+ (1,0) [0|0] "" Vector__XXX
 SG_ IC4_VPWR_OV_FLT m3 : 12|1@0+ (1,0) [0|0] "" Vector__XXX
 SG_ IC4_VPWR_LV_FLT m3 : 11|1@0+ (1,0) [0|0] "" Vector__XXX
 SG_ IC4_COM_LOSS_FLT m3 : 10|1@0+ (1,0) [0|0] "" Vector__XXX
 SG_ IC4_COM_ERR_FLT m3 : 9|1@0+ (1,0) [0|0] "" Vector__XXX
 SG_ IC4_CSB_WUP_FLT m3 : 8|1@0+ (1,0) [0|0] "" Vector__XXX
 SG_ IC3_IDLE_MODE_FLT m2 : 24|1@0+ (1,0) [0|0] "" Vector__XXX
 SG_ IC3_AN_OPEN_FLT m2 : 39|1@0+ (1,0) [0|0] "" Vector__XXX
 SG_ IC3_GPIO_SHORT_FLT m2 : 38|1@0+ (1,0) [0|0] "" Vector__XXX
 SG_ IC3_CB_SHORT_FLT m2 : 37|1@0+ (1,0) [0|0] "" Vector__XXX
 SG_ IC3_CB_OPEN_FLT m2 : 36|1@0+ (1,0) [0|0] "" Vector__XXX
 SG_ IC3_OSC_ERR_FLT m2 : 35|1@0+ (1,0) [0|0] "" Vector__XXX
 SG_ IC3_DED_ERR_FLT m2 : 34|1@0+ (1,0) [0|0] "" Vector__XXX
 SG_ IC3_FUSE_ERR_FLT m2 : 33|1@0+ (1,0) [0|0] "" Vector__XXX
 SG_ IC3_VCOM_OV_FLT m2 : 16|1@0+ (1,0) [0|0] "" Vector__XXX
 SG_ IC3_VCOM_UV_FLT m2 : 31|1@0+ (1,0) [0|0] "" Vector__XXX
 SG_ IC3_VANA_OV_FLT m2 : 30|1@0+ (1,0) [0|0] "" Vector__XXX
 SG_ IC3_VANA_UV_FLT m2 : 29|1@0+ (1,0) [0|0] "" Vector__XXX
 SG_ IC3_ADC1_B_FLT m2 : 28|1@0+ (1,0) [0|0] "" Vector__XXX
 SG_ IC3_ADC1_A_FLT m2 : 27|1@0+ (1,0) [0|0] "" Vector__XXX
 SG_ IC3_GND_LOSS_FLT m2 : 26|1@0+ (1,0) [0|0] "" Vector__XXX
 SG_ IC3_IC_TSD_FLT m2 : 25|1@0+ (1,0) [0|0] "" Vector__XXX
 SG_ IC3_GPIO0_WUP_FLT m2 : 23|1@0+ (1,0) [0|0] "" Vector__XXX
 SG_ IC3_IS_OL_FLT m2 : 22|1@0+ (1,0) [0|0] "" Vector__XXX
 SG_ IC3_IS_OC_FLT m2 : 21|1@0+ (1,0) [0|0] "" Vector__XXX
 SG_ IC3_AN_OT_FLT m2 : 20|1@0+ (1,0) [0|0] "" Vector__XXX
 SG_ IC3_AN_UT_FLT m2 : 19|1@0+ (1,0) [0|0] "" Vector__XXX
 SG_ IC3_CT_OV_FLT m2 : 18|1@0+ (1,0) [0|0] "" Vector__XXX
 SG_ IC3_CT_UV_FLT m2 : 17|1@0+ (1,0) [0|0] "" Vector__XXX
 SG_ IC3_POR m2 : 15|1@0+ (1,0) [0|0] "" Vector__XXX
 SG_ IC3_RESET_FLT m2 : 14|1@0+ (1,0) [0|0] "" Vector__XXX
 SG_ IC3_COM_ERR_OVR_FLT m2 : 13|1@0+ (1,0) [0|0] "" Vector__XXX
 SG_ IC3_VPWR_OV_FLT m2 : 12|1@0+ (1,0) [0|0] "" Vector__XXX
 SG_ IC3_VPWR_LV_FLT m2 : 11|1@0+ (1,0) [0|0] "" Vector__XXX
 SG_ IC3_COM_LOSS_FLT m2 : 10|1@0+ (1,0) [0|0] "" Vector__XXX
 SG_ IC3_COM_ERR_FLT m2 : 9|1@0+ (1,0) [0|0] "" Vector__XXX
 SG_ IC3_CSB_WUP_FLT m2 : 8|1@0+ (1,0) [0|0] "" Vector__XXX
 SG_ IC2_IDLE_MODE_FLT m1 : 24|1@0+ (1,0) [0|0] "" Vector__XXX
 SG_ IC2_AN_OPEN_FLT m1 : 39|1@0+ (1,0) [0|0] "" Vector__XXX
 SG_ IC2_GPIO_SHORT_FLT m1 : 38|1@0+ (1,0) [0|0] "" Vector__XXX
 SG_ IC2_CB_SHORT_FLT m1 : 37|1@0+ (1,0) [0|0] "" Vector__XXX
 SG_ IC2_CB_OPEN_FLT m1 : 36|1@0+ (1,0) [0|0] "" Vector__XXX
 SG_ IC2_OSC_ERR_FLT m1 : 35|1@0+ (1,0) [0|0] "" Vector__XXX
 SG_ IC2_DED_ERR_FLT m1 : 34|1@0+ (1,0) [0|0] "" Vector__XXX
 SG_ IC2_FUSE_ERR_FLT m1 : 33|1@0+ (1,0) [0|0] "" Vector__XXX
 SG_ IC2_VCOM_OV_FLT m1 : 16|1@0+ (1,0) [0|0] "" Vector__XXX
 SG_ IC2_VCOM_UV_FLT m1 : 31|1@0+ (1,0) [0|0] "" Vector__XXX
 SG_ IC2_VANA_OV_FLT m1 : 30|1@0+ (1,0) [0|0] "" Vector__XXX
 SG_ IC2_VANA_UV_FLT m1 : 29|1@0+ (1,0) [0|0] "" Vector__XXX
 SG_ IC2_ADC1_B_FLT m1 : 28|1@0+ (1,0) [0|0] "" Vector__XXX
 SG_ IC2_ADC1_A_FLT m1 : 27|1@0+ (1,0) [0|0] "" Vector__XXX
 SG_ IC2_GND_LOSS_FLT m1 : 26|1@0+ (1,0) [0|0] "" Vector__XXX
 SG_ IC2_IC_TSD_FLT m1 : 25|1@0+ (1,0) [0|0] "" Vector__XXX
 SG_ IC2_GPIO0_WUP_FLT m1 : 23|1@0+ (1,0) [0|0] "" Vector__XXX
 SG_ IC2_IS_OL_FLT m1 : 22|1@0+ (1,0) [0|0] "" Vector__XXX
 SG_ IC2_IS_OC_FLT m1 : 21|1@0+ (1,0) [0|0] "" Vector__XXX
 SG_ IC2_AN_OT_FLT m1 : 20|1@0+ (1,0) [0|0] "" Vector__XXX
 SG_ IC2_AN_UT_FLT m1 : 19|1@0+ (1,0) [0|0] "" Vector__XXX
 SG_ IC2_CT_OV_FLT m1 : 18|1@0+ (1,0) [0|0] "" Vector__XXX
 SG_ IC2_CT_UV_FLT m1 : 17|1@0+ (1,0) [0|0] "" Vector__XXX
 SG_ IC2_POR m1 : 15|1@0+ (1,0) [0|0] "" Vector__XXX
 SG_ IC2_RESET_FLT m1 : 14|1@0+ (1,0) [0|0] "" Vector__XXX
 SG_ IC2_COM_ERR_OVR_FLT m1 : 13|1@0+ (1,0) [0|0] "" Vector__XXX
 SG_ IC2_VPWR_OV_FLT m1 : 12|1@0+ (1,0) [0|0] "" Vector__XXX
 SG_ IC2_VPWR_LV_FLT m1 : 11|1@0+ (1,0) [0|0] "" Vector__XXX
 SG_ IC2_COM_LOSS_FLT m1 : 10|1@0+ (1,0) [0|0] "" Vector__XXX
 SG_ IC2_COM_ERR_FLT m1 : 9|1@0+ (1,0) [0|0] "" Vector__XXX
 SG_ IC2_CSB_WUP_FLT m1 : 8|1@0+ (1,0) [0|0] "" Vector__XXX
 SG_ IC1_IDLE_MODE_FLT m0 : 24|1@0+ (1,0) [0|0] "" Vector__XXX
 SG_ IC1_AN_OPEN_FLT m0 : 39|1@0+ (1,0) [0|0] "" Vector__XXX
 SG_ IC1_GPIO_SHORT_FLT m0 : 38|1@0+ (1,0) [0|0] "" Vector__XXX
 SG_ IC1_CB_SHORT_FLT m0 : 37|1@0+ (1,0) [0|0] "" Vector__XXX
 SG_ IC1_CB_OPEN_FLT m0 : 36|1@0+ (1,0) [0|0] "" Vector__XXX
 SG_ IC1_OSC_ERR_FLT m0 : 35|1@0+ (1,0) [0|0] "" Vector__XXX
 SG_ IC1_DED_ERR_FLT m0 : 34|1@0+ (1,0) [0|0] "" Vector__XXX
 SG_ IC1_FUSE_ERR_FLT m0 : 33|1@0+ (1,0) [0|0] "" Vector__XXX
 SG_ IC1_VCOM_OV_FLT m0 : 16|1@0+ (1,0) [0|0] "" Vector__XXX
 SG_ IC1_VCOM_UV_FLT m0 : 31|1@0+ (1,0) [0|0] "" Vector__XXX
 SG_ IC1_VANA_OV_FLT m0 : 30|1@0+ (1,0) [0|0] "" Vector__XXX
 SG_ IC1_VANA_UV_FLT m0 : 29|1@0+ (1,0) [0|0] "" Vector__XXX
 SG_ IC1_ADC1_B_FLT m0 : 28|1@0+ (1,0) [0|0] "" Vector__XXX
 SG_ IC1_ADC1_A_FLT m0 : 27|1@0+ (1,0) [0|0] "" Vector__XXX
 SG_ IC1_GND_LOSS_FLT m0 : 26|1@0+ (1,0) [0|0] "" Vector__XXX
 SG_ IC1_IC_TSD_FLT m0 : 25|1@0+ (1,0) [0|0] "" Vector__XXX
 SG_ IC1_GPIO0_WUP_FLT m0 : 23|1@0+ (1,0) [0|0] "" Vector__XXX
 SG_ IC1_IS_OL_FLT m0 : 22|1@0+ (1,0) [0|0] "" Vector__XXX
 SG_ IC1_IS_OC_FLT m0 : 21|1@0+ (1,0) [0|0] "" Vector__XXX
 SG_ IC1_AN_OT_FLT m0 : 20|1@0+ (1,0) [0|0] "" Vector__XXX
 SG_ IC1_AN_UT_FLT m0 : 19|1@0+ (1,0) [0|0] "" Vector__XXX
 SG_ IC1_CT_OV_FLT m0 : 18|1@0+ (1,0) [0|0] "" Vector__XXX
 SG_ IC1_CT_UV_FLT m0 : 17|1@0+ (1,0) [0|0] "" Vector__XXX
 SG_ IC1_POR m0 : 15|1@0+ (1,0) [0|0] "" Vector__XXX
 SG_ IC1_RESET_FLT m0 : 14|1@0+ (1,0) [0|0] "" Vector__XXX
 SG_ IC1_COM_ERR_OVR_FLT m0 : 13|1@0+ (1,0) [0|0] "" Vector__XXX
 SG_ IC1_VPWR_OV_FLT m0 : 12|1@0+ (1,0) [0|0] "" Vector__XXX
 SG_ IC1_VPWR_LV_FLT m0 : 11|1@0+ (1,0) [0|0] "" Vector__XXX
 SG_ IC1_COM_LOSS_FLT m0 : 10|1@0+ (1,0) [0|0] "" Vector__XXX
 SG_ IC1_COM_ERR_FLT m0 : 9|1@0+ (1,0) [0|0] "" Vector__XXX
 SG_ IC1_CSB_WUP_FLT m0 : 8|1@0+ (1,0) [0|0] "" Vector__XXX
 SG_ CSC07_IndexFaults M : 7|8@0+ (1,0) [0|255] "" Vector__XXX

BO_ 2550661122 CSC08_CIDs_FAULTS: 8 CSC08
 SG_ IC4_IDLE_MODE_FLT m3 : 24|1@0+ (1,0) [0|0] "" Vector__XXX
 SG_ IC4_AN_OPEN_FLT m3 : 39|1@0+ (1,0) [0|0] "" Vector__XXX
 SG_ IC4_GPIO_SHORT_FLT m3 : 38|1@0+ (1,0) [0|0] "" Vector__XXX
 SG_ IC4_CB_SHORT_FLT m3 : 37|1@0+ (1,0) [0|0] "" Vector__XXX
 SG_ IC4_CB_OPEN_FLT m3 : 36|1@0+ (1,0) [0|0] "" Vector__XXX
 SG_ IC4_OSC_ERR_FLT m3 : 35|1@0+ (1,0) [0|0] "" Vector__XXX
 SG_ IC4_DED_ERR_FLT m3 : 34|1@0+ (1,0) [0|0] "" Vector__XXX
 SG_ IC4_FUSE_ERR_FLT m3 : 33|1@0+ (1,0) [0|0] "" Vector__XXX
 SG_ IC4_VCOM_OV_FLT m3 : 16|1@0+ (1,0) [0|0] "" Vector__XXX
 SG_ IC4_VCOM_UV_FLT m3 : 31|1@0+ (1,0) [0|0] "" Vector__XXX
 SG_ IC4_VANA_OV_FLT m3 : 30|1@0+ (1,0) [0|0] "" Vector__XXX
 SG_ IC4_VANA_UV_FLT m3 : 29|1@0+ (1,0) [0|0] "" Vector__XXX
 SG_ IC4_ADC1_B_FLT m3 : 28|1@0+ (1,0) [0|0] "" Vector__XXX
 SG_ IC4_ADC1_A_FLT m3 : 27|1@0+ (1,0) [0|0] "" Vector__XXX
 SG_ IC4_GND_LOSS_FLT m3 : 26|1@0+ (1,0) [0|0] "" Vector__XXX
 SG_ IC4_IC_TSD_FLT m3 : 25|1@0+ (1,0) [0|0] "" Vector__XXX
 SG_ IC4_GPIO0_WUP_FLT m3 : 23|1@0+ (1,0) [0|0] "" Vector__XXX
 SG_ IC4_IS_OL_FLT m3 : 22|1@0+ (1,0) [0|0] "" Vector__XXX
 SG_ IC4_IS_OC_FLT m3 : 21|1@0+ (1,0) [0|0] "" Vector__XXX
 SG_ IC4_AN_OT_FLT m3 : 20|1@0+ (1,0) [0|0] "" Vector__XXX
 SG_ IC4_AN_UT_FLT m3 : 19|1@0+ (1,0) [0|0] "" Vector__XXX
 SG_ IC4_CT_OV_FLT m3 : 18|1@0+ (1,0) [0|0] "" Vector__XXX
 SG_ IC4_CT_UV_FLT m3 : 17|1@0+ (1,0) [0|0] "" Vector__XXX
 SG_ IC4_POR m3 : 15|1@0+ (1,0) [0|0] "" Vector__XXX
 SG_ IC4_RESET_FLT m3 : 14|1@0+ (1,0) [0|0] "" Vector__XXX
 SG_ IC4_COM_ERR_OVR_FLT m3 : 13|1@0+ (1,0) [0|0] "" Vector__XXX
 SG_ IC4_VPWR_OV_FLT m3 : 12|1@0+ (1,0) [0|0] "" Vector__XXX
 SG_ IC4_VPWR_LV_FLT m3 : 11|1@0+ (1,0) [0|0] "" Vector__XXX
 SG_ IC4_COM_LOSS_FLT m3 : 10|1@0+ (1,0) [0|0] "" Vector__XXX
 SG_ IC4_COM_ERR_FLT m3 : 9|1@0+ (1,0) [0|0] "" Vector__XXX
 SG_ IC4_CSB_WUP_FLT m3 : 8|1@0+ (1,0) [0|0] "" Vector__XXX
 SG_ IC3_IDLE_MODE_FLT m2 : 24|1@0+ (1,0) [0|0] "" Vector__XXX
 SG_ IC3_AN_OPEN_FLT m2 : 39|1@0+ (1,0) [0|0] "" Vector__XXX
 SG_ IC3_GPIO_SHORT_FLT m2 : 38|1@0+ (1,0) [0|0] "" Vector__XXX
 SG_ IC3_CB_SHORT_FLT m2 : 37|1@0+ (1,0) [0|0] "" Vector__XXX
 SG_ IC3_CB_OPEN_FLT m2 : 36|1@0+ (1,0) [0|0] "" Vector__XXX
 SG_ IC3_OSC_ERR_FLT m2 : 35|1@0+ (1,0) [0|0] "" Vector__XXX
 SG_ IC3_DED_ERR_FLT m2 : 34|1@0+ (1,0) [0|0] "" Vector__XXX
 SG_ IC3_FUSE_ERR_FLT m2 : 33|1@0+ (1,0) [0|0] "" Vector__XXX
 SG_ IC3_VCOM_OV_FLT m2 : 16|1@0+ (1,0) [0|0] "" Vector__XXX
 SG_ IC3_VCOM_UV_FLT m2 : 31|1@0+ (1,0) [0|0] "" Vector__XXX
 SG_ IC3_VANA_OV_FLT m2 : 30|1@0+ (1,0) [0|0] "" Vector__XXX
 SG_ IC3_VANA_UV_FLT m2 : 29|1@0+ (1,0) [0|0] "" Vector__XXX
 SG_ IC3_ADC1_B_FLT m2 : 28|1@0+ (1,0) [0|0] "" Vector__XXX
 SG_ IC3_ADC1_A_FLT m2 : 27|1@0+ (1,0) [0|0] "" Vector__XXX
 SG_ IC3_GND_LOSS_FLT m2 : 26|1@0+ (1,0) [0|0] "" Vector__XXX
 SG_ IC3_IC_TSD_FLT m2 : 25|1@0+ (1,0) [0|0] "" Vector__XXX
 SG_ IC3_GPIO0_WUP_FLT m2 : 23|1@0+ (1,0) [0|0] "" Vector__XXX
 SG_ IC3_IS_OL_FLT m2 : 22|1@0+ (1,0) [0|0] "" Vector__XXX
 SG_ IC3_IS_OC_FLT m2 : 21|1@0+ (1,0) [0|0] "" Vector__XXX
 SG_ IC3_AN_OT_FLT m2 : 20|1@0+ (1,0) [0|0] "" Vector__XXX
 SG_ IC3_AN_UT_FLT m2 : 19|1@0+ (1,0) [0|0] "" Vector__XXX
 SG_ IC3_CT_OV_FLT m2 : 18|1@0+ (1,0) [0|0] "" Vector__XXX
 SG_ IC3_CT_UV_FLT m2 : 17|1@0+ (1,0) [0|0] "" Vector__XXX
 SG_ IC3_POR m2 : 15|1@0+ (1,0) [0|0] "" Vector__XXX
 SG_ IC3_RESET_FLT m2 : 14|1@0+ (1,0) [0|0] "" Vector__XXX
 SG_ IC3_COM_ERR_OVR_FLT m2 : 13|1@0+ (1,0) [0|0] "" Vector__XXX
 SG_ IC3_VPWR_OV_FLT m2 : 12|1@0+ (1,0) [0|0] "" Vector__XXX
 SG_ IC3_VPWR_LV_FLT m2 : 11|1@0+ (1,0) [0|0] "" Vector__XXX
 SG_ IC3_COM_LOSS_FLT m2 : 10|1@0+ (1,0) [0|0] "" Vector__XXX
 SG_ IC3_COM_ERR_FLT m2 : 9|1@0+ (1,0) [0|0] "" Vector__XXX
 SG_ IC3_CSB_WUP_FLT m2 : 8|1@0+ (1,0) [0|0] "" Vector__XXX
 SG_ IC2_IDLE_MODE_FLT m1 : 24|1@0+ (1,0) [0|0] "" Vector__XXX
 SG_ IC2_AN_OPEN_FLT m1 : 39|1@0+ (1,0) [0|0] "" Vector__XXX
 SG_ IC2_GPIO_SHORT_FLT m1 : 38|1@0+ (1,0) [0|0] "" Vector__XXX
 SG_ IC2_CB_SHORT_FLT m1 : 37|1@0+ (1,0) [0|0] "" Vector__XXX
 SG_ IC2_CB_OPEN_FLT m1 : 36|1@0+ (1,0) [0|0] "" Vector__XXX
 SG_ IC2_OSC_ERR_FLT m1 : 35|1@0+ (1,0) [0|0] "" Vector__XXX
 SG_ IC2_DED_ERR_FLT m1 : 34|1@0+ (1,0) [0|0] "" Vector__XXX
 SG_ IC2_FUSE_ERR_FLT m1 : 33|1@0+ (1,0) [0|0] "" Vector__XXX
 SG_ IC2_VCOM_OV_FLT m1 : 16|1@0+ (1,0) [0|0] "" Vector__XXX
 SG_ IC2_VCOM_UV_FLT m1 : 31|1@0+ (1,0) [0|0] "" Vector__XXX
 SG_ IC2_VANA_OV_FLT m1 : 30|1@0+ (1,0) [0|0] "" Vector__XXX
 SG_ IC2_VANA_UV_FLT m1 : 29|1@0+ (1,0) [0|0] "" Vector__XXX
 SG_ IC2_ADC1_B_FLT m1 : 28|1@0+ (1,0) [0|0] "" Vector__XXX
 SG_ IC2_ADC1_A_FLT m1 : 27|1@0+ (1,0) [0|0] "" Vector__XXX
 SG_ IC2_GND_LOSS_FLT m1 : 26|1@0+ (1,0) [0|0] "" Vector__XXX
 SG_ IC2_IC_TSD_FLT m1 : 25|1@0+ (1,0) [0|0] "" Vector__XXX
 SG_ IC2_GPIO0_WUP_FLT m1 : 23|1@0+ (1,0) [0|0] "" Vector__XXX
 SG_ IC2_IS_OL_FLT m1 : 22|1@0+ (1,0) [0|0] "" Vector__XXX
 SG_ IC2_IS_OC_FLT m1 : 21|1@0+ (1,0) [0|0] "" Vector__XXX
 SG_ IC2_AN_OT_FLT m1 : 20|1@0+ (1,0) [0|0] "" Vector__XXX
 SG_ IC2_AN_UT_FLT m1 : 19|1@0+ (1,0) [0|0] "" Vector__XXX
 SG_ IC2_CT_OV_FLT m1 : 18|1@0+ (1,0) [0|0] "" Vector__XXX
 SG_ IC2_CT_UV_FLT m1 : 17|1@0+ (1,0) [0|0] "" Vector__XXX
 SG_ IC2_POR m1 : 15|1@0+ (1,0) [0|0] "" Vector__XXX
 SG_ IC2_RESET_FLT m1 : 14|1@0+ (1,0) [0|0] "" Vector__XXX
 SG_ IC2_COM_ERR_OVR_FLT m1 : 13|1@0+ (1,0) [0|0] "" Vector__XXX
 SG_ IC2_VPWR_OV_FLT m1 : 12|1@0+ (1,0) [0|0] "" Vector__XXX
 SG_ IC2_VPWR_LV_FLT m1 : 11|1@0+ (1,0) [0|0] "" Vector__XXX
 SG_ IC2_COM_LOSS_FLT m1 : 10|1@0+ (1,0) [0|0] "" Vector__XXX
 SG_ IC2_COM_ERR_FLT m1 : 9|1@0+ (1,0) [0|0] "" Vector__XXX
 SG_ IC2_CSB_WUP_FLT m1 : 8|1@0+ (1,0) [0|0] "" Vector__XXX
 SG_ IC1_IDLE_MODE_FLT m0 : 24|1@0+ (1,0) [0|0] "" Vector__XXX
 SG_ IC1_AN_OPEN_FLT m0 : 39|1@0+ (1,0) [0|0] "" Vector__XXX
 SG_ IC1_GPIO_SHORT_FLT m0 : 38|1@0+ (1,0) [0|0] "" Vector__XXX
 SG_ IC1_CB_SHORT_FLT m0 : 37|1@0+ (1,0) [0|0] "" Vector__XXX
 SG_ IC1_CB_OPEN_FLT m0 : 36|1@0+ (1,0) [0|0] "" Vector__XXX
 SG_ IC1_OSC_ERR_FLT m0 : 35|1@0+ (1,0) [0|0] "" Vector__XXX
 SG_ IC1_DED_ERR_FLT m0 : 34|1@0+ (1,0) [0|0] "" Vector__XXX
 SG_ IC1_FUSE_ERR_FLT m0 : 33|1@0+ (1,0) [0|0] "" Vector__XXX
 SG_ IC1_VCOM_OV_FLT m0 : 16|1@0+ (1,0) [0|0] "" Vector__XXX
 SG_ IC1_VCOM_UV_FLT m0 : 31|1@0+ (1,0) [0|0] "" Vector__XXX
 SG_ IC1_VANA_OV_FLT m0 : 30|1@0+ (1,0) [0|0] "" Vector__XXX
 SG_ IC1_VANA_UV_FLT m0 : 29|1@0+ (1,0) [0|0] "" Vector__XXX
 SG_ IC1_ADC1_B_FLT m0 : 28|1@0+ (1,0) [0|0] "" Vector__XXX
 SG_ IC1_ADC1_A_FLT m0 : 27|1@0+ (1,0) [0|0] "" Vector__XXX
 SG_ IC1_GND_LOSS_FLT m0 : 26|1@0+ (1,0) [0|0] "" Vector__XXX
 SG_ IC1_IC_TSD_FLT m0 : 25|1@0+ (1,0) [0|0] "" Vector__XXX
 SG_ IC1_GPIO0_WUP_FLT m0 : 23|1@0+ (1,0) [0|0] "" Vector__XXX
 SG_ IC1_IS_OL_FLT m0 : 22|1@0+ (1,0) [0|0] "" Vector__XXX
 SG_ IC1_IS_OC_FLT m0 : 21|1@0+ (1,0) [0|0] "" Vector__XXX
 SG_ IC1_AN_OT_FLT m0 : 20|1@0+ (1,0) [0|0] "" Vector__XXX
 SG_ IC1_AN_UT_FLT m0 : 19|1@0+ (1,0) [0|0] "" Vector__XXX
 SG_ IC1_CT_OV_FLT m0 : 18|1@0+ (1,0) [0|0] "" Vector__XXX
 SG_ IC1_CT_UV_FLT m0 : 17|1@0+ (1,0) [0|0] "" Vector__XXX
 SG_ IC1_POR m0 : 15|1@0+ (1,0) [0|0] "" Vector__XXX
 SG_ IC1_RESET_FLT m0 : 14|1@0+ (1,0) [0|0] "" Vector__XXX
 SG_ IC1_COM_ERR_OVR_FLT m0 : 13|1@0+ (1,0) [0|0] "" Vector__XXX
 SG_ IC1_VPWR_OV_FLT m0 : 12|1@0+ (1,0) [0|0] "" Vector__XXX
 SG_ IC1_VPWR_LV_FLT m0 : 11|1@0+ (1,0) [0|0] "" Vector__XXX
 SG_ IC1_COM_LOSS_FLT m0 : 10|1@0+ (1,0) [0|0] "" Vector__XXX
 SG_ IC1_COM_ERR_FLT m0 : 9|1@0+ (1,0) [0|0] "" Vector__XXX
 SG_ IC1_CSB_WUP_FLT m0 : 8|1@0+ (1,0) [0|0] "" Vector__XXX
 SG_ CSC08_IndexFaults M : 7|8@0+ (1,0) [0|255] "" Vector__XXX

BA_DEF_  "BusType" STRING ;
BA_DEF_DEF_  "BusType" "CAN";
VAL_ 2550202368 CSC01_IndexCell 19 "Cell_55_56" 18 "Cell_52_54" 17 "Cell_49_51" 16 "Cell_46_48" 15 "Cell_43_45" 14 "Cell_41_42" 13 "Cell_38_40" 12 "Cell_35_37" 11 "Cell_32_34" 10 "Cell_29_31" 9 "Cell_27_28" 8 "Cell_24_26" 7 "Cell_21_23" 6 "Cell_18_20" 5 "Cell_15_17" 4 "Cell_13_14" 3 "Cell_10_12" 2 "Cell_7_9" 1 "Cell_4_6" 0 "Cell_1_3" ;
VAL_ 2550267904 CSC02_IndexCell 19 "Cell_55_56" 18 "Cell_52_54" 17 "Cell_49_51" 16 "Cell_46_48" 15 "Cell_43_45" 14 "Cell_41_42" 13 "Cell_38_40" 12 "Cell_35_37" 11 "Cell_32_34" 10 "Cell_29_31" 9 "Cell_27_28" 8 "Cell_24_26" 7 "Cell_21_23" 6 "Cell_18_20" 5 "Cell_15_17" 4 "Cell_13_14" 3 "Cell_10_12" 2 "Cell_7_9" 1 "Cell_4_6" 0 "Cell_1_3" ;
VAL_ 2550333440 CSC03_IndexCell 19 "Cell_55_56" 18 "Cell_52_54" 17 "Cell_49_51" 16 "Cell_46_48" 15 "Cell_43_45" 14 "Cell_41_42" 13 "Cell_38_40" 12 "Cell_35_37" 11 "Cell_32_34" 10 "Cell_29_31" 9 "Cell_27_28" 8 "Cell_24_26" 7 "Cell_21_23" 6 "Cell_18_20" 5 "Cell_15_17" 4 "Cell_13_14" 3 "Cell_10_12" 2 "Cell_7_9" 1 "Cell_4_6" 0 "Cell_1_3" ;
VAL_ 2550398976 CSC04_IndexCell 19 "Cell_55_56" 18 "Cell_52_54" 17 "Cell_49_51" 16 "Cell_46_48" 15 "Cell_43_45" 14 "Cell_41_42" 13 "Cell_38_40" 12 "Cell_35_37" 11 "Cell_32_34" 10 "Cell_29_31" 9 "Cell_27_28" 8 "Cell_24_26" 7 "Cell_21_23" 6 "Cell_18_20" 5 "Cell_15_17" 4 "Cell_13_14" 3 "Cell_10_12" 2 "Cell_7_9" 1 "Cell_4_6" 0 "Cell_1_3" ;
VAL_ 2550464512 CSC05_IndexCell 19 "Cell_55_56" 18 "Cell_52_54" 17 "Cell_49_51" 16 "Cell_46_48" 15 "Cell_43_45" 14 "Cell_41_42" 13 "Cell_38_40" 12 "Cell_35_37" 11 "Cell_32_34" 10 "Cell_29_31" 9 "Cell_27_28" 8 "Cell_24_26" 7 "Cell_21_23" 6 "Cell_18_20" 5 "Cell_15_17" 4 "Cell_13_14" 3 "Cell_10_12" 2 "Cell_7_9" 1 "Cell_4_6" 0 "Cell_1_3" ;
VAL_ 2550530048 CSC06_IndexCell 19 "Cell_55_56" 18 "Cell_52_54" 17 "Cell_49_51" 16 "Cell_46_48" 15 "Cell_43_45" 14 "Cell_41_42" 13 "Cell_38_40" 12 "Cell_35_37" 11 "Cell_32_34" 10 "Cell_29_31" 9 "Cell_27_28" 8 "Cell_24_26" 7 "Cell_21_23" 6 "Cell_18_20" 5 "Cell_15_17" 4 "Cell_13_14" 3 "Cell_10_12" 2 "Cell_7_9" 1 "Cell_4_6" 0 "Cell_1_3" ;
VAL_ 2550595584 CSC07_IndexCell 19 "Cell_55_56" 18 "Cell_52_54" 17 "Cell_49_51" 16 "Cell_46_48" 15 "Cell_43_45" 14 "Cell_41_42" 13 "Cell_38_40" 12 "Cell_35_37" 11 "Cell_32_34" 10 "Cell_29_31" 9 "Cell_27_28" 8 "Cell_24_26" 7 "Cell_21_23" 6 "Cell_18_20" 5 "Cell_15_17" 4 "Cell_13_14" 3 "Cell_10_12" 2 "Cell_7_9" 1 "Cell_4_6" 0 "Cell_1_3" ;
VAL_ 2550661120 CSC08_IndexCell 19 "Cell_55_56" 18 "Cell_52_54" 17 "Cell_49_51" 16 "Cell_46_48" 15 "Cell_43_45" 14 "Cell_41_42" 13 "Cell_38_40" 12 "Cell_35_37" 11 "Cell_32_34" 10 "Cell_29_31" 9 "Cell_27_28" 8 "Cell_24_26" 7 "Cell_21_23" 6 "Cell_18_20" 5 "Cell_15_17" 4 "Cell_13_14" 3 "Cell_10_12" 2 "Cell_7_9" 1 "Cell_4_6" 0 "Cell_1_3" ;
VAL_ 2550726656 CSC09_IndexCell 19 "Cell_55_56" 18 "Cell_52_54" 17 "Cell_49_51" 16 "Cell_46_48" 15 "Cell_43_45" 14 "Cell_41_42" 13 "Cell_38_40" 12 "Cell_35_37" 11 "Cell_32_34" 10 "Cell_29_31" 9 "Cell_27_28" 8 "Cell_24_26" 7 "Cell_21_23" 6 "Cell_18_20" 5 "Cell_15_17" 4 "Cell_13_14" 3 "Cell_10_12" 2 "Cell_7_9" 1 "Cell_4_6" 0 "Cell_1_3" ;
VAL_ 2550792192 CSC10_IndexCell 19 "Cell_55_56" 18 "Cell_52_54" 17 "Cell_49_51" 16 "Cell_46_48" 15 "Cell_43_45" 14 "Cell_41_42" 13 "Cell_38_40" 12 "Cell_35_37" 11 "Cell_32_34" 10 "Cell_29_31" 9 "Cell_27_28" 8 "Cell_24_26" 7 "Cell_21_23" 6 "Cell_18_20" 5 "Cell_15_17" 4 "Cell_13_14" 3 "Cell_10_12" 2 "Cell_7_9" 1 "Cell_4_6" 0 "Cell_1_3" ;
VAL_ 2550857728 CSC11_IndexCell 19 "Cell_55_56" 18 "Cell_52_54" 17 "Cell_49_51" 16 "Cell_46_48" 15 "Cell_43_45" 14 "Cell_41_42" 13 "Cell_38_40" 12 "Cell_35_37" 11 "Cell_32_34" 10 "Cell_29_31" 9 "Cell_27_28" 8 "Cell_24_26" 7 "Cell_21_23" 6 "Cell_18_20" 5 "Cell_15_17" 4 "Cell_13_14" 3 "Cell_10_12" 2 "Cell_7_9" 1 "Cell_4_6" 0 "Cell_1_3" ;
VAL_ 2550923264 CSC12_IndexCell 19 "Cell_55_56" 18 "Cell_52_54" 17 "Cell_49_51" 16 "Cell_46_48" 15 "Cell_43_45" 14 "Cell_41_42" 13 "Cell_38_40" 12 "Cell_35_37" 11 "Cell_32_34" 10 "Cell_29_31" 9 "Cell_27_28" 8 "Cell_24_26" 7 "Cell_21_23" 6 "Cell_18_20" 5 "Cell_15_17" 4 "Cell_13_14" 3 "Cell_10_12" 2 "Cell_7_9" 1 "Cell_4_6" 0 "Cell_1_3" ;
VAL_ 2550988800 CSC13_IndexCell 19 "Cell_55_56" 18 "Cell_52_54" 17 "Cell_49_51" 16 "Cell_46_48" 15 "Cell_43_45" 14 "Cell_41_42" 13 "Cell_38_40" 12 "Cell_35_37" 11 "Cell_32_34" 10 "Cell_29_31" 9 "Cell_27_28" 8 "Cell_24_26" 7 "Cell_21_23" 6 "Cell_18_20" 5 "Cell_15_17" 4 "Cell_13_14" 3 "Cell_10_12" 2 "Cell_7_9" 1 "Cell_4_6" 0 "Cell_1_3" ;
VAL_ 2551054336 CSC14_IndexCell 19 "Cell_55_56" 18 "Cell_52_54" 17 "Cell_49_51" 16 "Cell_46_48" 15 "Cell_43_45" 14 "Cell_41_42" 13 "Cell_38_40" 12 "Cell_35_37" 11 "Cell_32_34" 10 "Cell_29_31" 9 "Cell_27_28" 8 "Cell_24_26" 7 "Cell_21_23" 6 "Cell_18_20" 5 "Cell_15_17" 4 "Cell_13_14" 3 "Cell_10_12" 2 "Cell_7_9" 1 "Cell_4_6" 0 "Cell_1_3" ;
VAL_ 2551119872 CSC15_IndexCell 19 "Cell_55_56" 18 "Cell_52_54" 17 "Cell_49_51" 16 "Cell_46_48" 15 "Cell_43_45" 14 "Cell_41_42" 13 "Cell_38_40" 12 "Cell_35_37" 11 "Cell_32_34" 10 "Cell_29_31" 9 "Cell_27_28" 8 "Cell_24_26" 7 "Cell_21_23" 6 "Cell_18_20" 5 "Cell_15_17" 4 "Cell_13_14" 3 "Cell_10_12" 2 "Cell_7_9" 1 "Cell_4_6" 0 "Cell_1_3" ;
VAL_ 2550202369 CSC01_IndexTemps 7 "IC4_Temps_PCB" 6 "IC4_Temps_1_6" 5 "IC3_Temps_PCB" 4 "IC3_Temps_1_6" 3 "IC2_Temps_PCB" 2 "IC2_Temps_1_6" 1 "IC1_Temps_PCB" 0 "IC1_Temps_1_6" ;
VAL_ 2550267905 CSC02_IndexTemps 7 "IC4_Temps_PCB" 6 "IC4_Temps_1_6" 5 "IC3_Temps_PCB" 4 "IC3_Temps_1_6" 3 "IC2_Temps_PCB" 2 "IC2_Temps_1_6" 1 "IC1_Temps_PCB" 0 "IC1_Temps_1_6" ;
VAL_ 2550333441 CSC03_IndexTemps 7 "IC4_Temps_PCB" 6 "IC4_Temps_1_6" 5 "IC3_Temps_PCB" 4 "IC3_Temps_1_6" 3 "IC2_Temps_PCB" 2 "IC2_Temps_1_6" 1 "IC1_Temps_PCB" 0 "IC1_Temps_1_6" ;
VAL_ 2550398977 CSC04_IndexTemps 7 "IC4_Temps_PCB" 6 "IC4_Temps_1_6" 5 "IC3_Temps_PCB" 4 "IC3_Temps_1_6" 3 "IC2_Temps_PCB" 2 "IC2_Temps_1_6" 1 "IC1_Temps_PCB" 0 "IC1_Temps_1_6" ;
VAL_ 2550464513 CSC05_IndexTemps 7 "IC4_Temps_PCB" 6 "IC4_Temps_1_6" 5 "IC3_Temps_PCB" 4 "IC3_Temps_1_6" 3 "IC2_Temps_PCB" 2 "IC2_Temps_1_6" 1 "IC1_Temps_PCB" 0 "IC1_Temps_1_6" ;
VAL_ 2550530049 CSC06_IndexTemps 7 "IC4_Temps_PCB" 6 "IC4_Temps_1_6" 5 "IC3_Temps_PCB" 4 "IC3_Temps_1_6" 3 "IC2_Temps_PCB" 2 "IC2_Temps_1_6" 1 "IC1_Temps_PCB" 0 "IC1_Temps_1_6" ;
VAL_ 2550595585 CSC07_IndexTemps 7 "IC4_Temps_PCB" 6 "IC4_Temps_1_6" 5 "IC3_Temps_PCB" 4 "IC3_Temps_1_6" 3 "IC2_Temps_PCB" 2 "IC2_Temps_1_6" 1 "IC1_Temps_PCB" 0 "IC1_Temps_1_6" ;
VAL_ 2550661121 CSC08_IndexTemps 7 "IC4_Temps_PCB" 6 "IC4_Temps_1_6" 5 "IC3_Temps_PCB" 4 "IC3_Temps_1_6" 3 "IC2_Temps_PCB" 2 "IC2_Temps_1_6" 1 "IC1_Temps_PCB" 0 "IC1_Temps_1_6" ;
VAL_ 2550726657 CSC09_IndexTemps 7 "IC4_Temps_PCB" 6 "IC4_Temps_1_6" 5 "IC3_Temps_PCB" 4 "IC3_Temps_1_6" 3 "IC2_Temps_PCB" 2 "IC2_Temps_1_6" 1 "IC1_Temps_PCB" 0 "IC1_Temps_1_6" ;
VAL_ 2550792193 CSC10_IndexTemps 7 "IC4_Temps_PCB" 6 "IC4_Temps_1_6" 5 "IC3_Temps_PCB" 4 "IC3_Temps_1_6" 3 "IC2_Temps_PCB" 2 "IC2_Temps_1_6" 1 "IC1_Temps_PCB" 0 "IC1_Temps_1_6" ;
VAL_ 2550857729 CSC11_IndexTemps 7 "IC4_Temps_PCB" 6 "IC4_Temps_1_6" 5 "IC3_Temps_PCB" 4 "IC3_Temps_1_6" 3 "IC2_Temps_PCB" 2 "IC2_Temps_1_6" 1 "IC1_Temps_PCB" 0 "IC1_Temps_1_6" ;
VAL_ 2550923265 CSC12_IndexTemps 7 "IC4_Temps_PCB" 6 "IC4_Temps_1_6" 5 "IC3_Temps_PCB" 4 "IC3_Temps_1_6" 3 "IC2_Temps_PCB" 2 "IC2_Temps_1_6" 1 "IC1_Temps_PCB" 0 "IC1_Temps_1_6" ;
VAL_ 2550988801 CSC13_IndexTemps 7 "IC4_Temps_PCB" 6 "IC4_Temps_1_6" 5 "IC3_Temps_PCB" 4 "IC3_Temps_1_6" 3 "IC2_Temps_PCB" 2 "IC2_Temps_1_6" 1 "IC1_Temps_PCB" 0 "IC1_Temps_1_6" ;
VAL_ 2551054337 CSC14_IndexTemps 7 "IC4_Temps_PCB" 6 "IC4_Temps_1_6" 5 "IC3_Temps_PCB" 4 "IC3_Temps_1_6" 3 "IC2_Temps_PCB" 2 "IC2_Temps_1_6" 1 "IC1_Temps_PCB" 0 "IC1_Temps_1_6" ;
VAL_ 2551119873 CSC15_IndexTemps 7 "IC4_Temps_PCB" 6 "IC4_Temps_1_6" 5 "IC3_Temps_PCB" 4 "IC3_Temps_1_6" 3 "IC2_Temps_PCB" 2 "IC2_Temps_1_6" 1 "IC1_Temps_PCB" 0 "IC1_Temps_1_6" ;
VAL_ 2550202370 CSC01_IndexFaults 3 "IC4_Faults" 2 "IC3_Faults" 1 "IC2_Faults" 0 "IC1_Faults" ;
VAL_ 2550267906 CSC02_IndexFaults 3 "IC4_Faults" 2 "IC3_Faults" 1 "IC2_Faults" 0 "IC1_Faults" ;
VAL_ 2550333442 CSC03_IndexFaults 3 "IC4_Faults" 2 "IC3_Faults" 1 "IC2_Faults" 0 "IC1_Faults" ;
VAL_ 2550398978 CSC04_IndexFaults 3 "IC4_Faults" 2 "IC3_Faults" 1 "IC2_Faults" 0 "IC1_Faults" ;
VAL_ 2550464514 CSC05_IndexFaults 3 "IC4_Faults" 2 "IC3_Faults" 1 "IC2_Faults" 0 "IC1_Faults" ;
VAL_ 2550530050 CSC06_IndexFaults 3 "IC4_Faults" 2 "IC3_Faults" 1 "IC2_Faults" 0 "IC1_Faults" ;
VAL_ 2550595586 CSC07_IndexFaults 3 "IC4_Faults" 2 "IC3_Faults" 1 "IC2_Faults" 0 "IC1_Faults" ;
VAL_ 2550661122 CSC08_IndexFaults 3 "IC4_Faults" 2 "IC3_Faults" 1 "IC2_Faults" 0 "IC1_Faults" ;
